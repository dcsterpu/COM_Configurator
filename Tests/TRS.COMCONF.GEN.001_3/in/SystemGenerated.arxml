AUTOSAR XML (schema 4-2-2)
package /RootP_CS
  19 x client server interface:
    IF_ASVD_CScomplement
      operation ASVD_op_complement
        arg In_Step: type=tWORD, direction=IN
        arg Out_Result: type=tBYTE, direction=OUT
    CS_GetFctNetworkStatus
      operation Get
        arg DataIndex: type=tWORD, direction=IN
        arg NetworkStatus: type=tBYTE, direction=OUT
    CS_AlerteIHM
      operation Cmd
        arg Type: type=t_cAlerteIHM, direction=IN
        arg Identifiant: type=t_ALE, direction=IN
    CS_DdeSon
      operation Cmd
        arg Type: type=t_DdeSon, direction=IN
        arg Identifiant: type=t_Sound, direction=IN
    CS_GeneralDiagnosticMonitor
      operation ResetEventDebounceStatus
        arg EventId: type=Dem_EventIdType, direction=IN
        arg DebounceResetStatus: type=Dem_DebounceResetStatusType, direction=IN
      operation ResetEventStatus
        arg EventId: type=Dem_EventIdType, direction=IN
      operation SetEventStatus
        arg EventId: type=Dem_EventIdType, direction=IN
        arg EventStatus: type=Dem_EventStatusType, direction=IN
    CS_Resistance
      operation Get
        arg ResistanceId: type=t_cE, direction=IN
        arg Resistance: type=tWORD, direction=OUT
    CS_Resistance_Dword
      operation Get
        arg ResistanceDwordId: type=t_cE_RESDW, direction=IN
        arg HrResistance: type=tDWORD, direction=OUT
    CS_AlertePOI
      operation Cmd
        arg Type: type=t_cAlertePOI, direction=IN
        arg Identifiant: type=t_Alerte, direction=IN
    CS_VoyantService
      operation Piloter
        arg IdentifiantClient: type=t_cIdVoyServ, direction=IN
        arg Requete: type=t_cPilotageVoyant, direction=IN
    CS_NVDM_WR_APP
      operation NvDM_WrApp_Block
        arg BlockId: type=tWORD, direction=IN
    CS_NVDM_WR_CFGVH
      operation NvDM_WrCfgVh_Block
        arg BlockId: type=tWORD, direction=IN
    IF_RetourStatut
      operation SV_op_EnqueueRetour
        arg Data_RetourStatut_SWC: type=tBYTE, direction=IN
        arg Data_RetourStatut_code: type=tBYTE, direction=IN
    IF_TrasfertRetour
      operation FAN_op_TransfertRetour
        arg Data_RetourStatut_SWC: type=tBYTE, direction=IN
        arg Data_RetourStatut_code: type=tBYTE, direction=IN
    IF_IsTestRunning
      operation SV_op_IsTestRunning
        arg Data_IsTestRunning: type=tLOG, direction=INOUT
    CS_CmdAPC
      operation Set
        arg DiscreteVal: type=tLOG, direction=IN
    CS_CmdPlusCAN1
      operation Set
        arg DiscreteVal: type=tLOG, direction=IN
    CS_CmdPlusCAN2
      operation Set
        arg DiscreteVal: type=tLOG, direction=IN
    CS_CmdPlusLIN
      operation Set
        arg DiscreteVal: type=tLOG, direction=IN
    CS_CmdPlusRCD
      operation Set
        arg DiscreteVal: type=tLOG, direction=IN
package /RootP_SR_Data
  589 x sender receiver interface:
    If_executerPas_ASVD
      data Data_pas_domaine_ASVD: type=tBYTE, init-value=CONST_tBYTE_0x00:0
      data Data_pas_pas_ASVD: type=tBYTE, init-value=CONST_tBYTE_0x00:0
      data Data_pas_test_ASVD: type=tBYTE, init-value=CONST_tBYTE_0x00:0
    SR_App_Eep_Explicit_1
      data Data_6_1: type=tDWORD, init-value=CONST_tDWORD_0:0
      data Data_6_2: type=tWORD, init-value=CONST_tWORD_0:0
      data Data_6_3: type=tBYTE, init-value=CONST_tBYTE_0:0
    SR_App_RAM_Implicit
      data Data_5_1: type=tDWORD, init-value=CONST_tDWORD_0:0
      data Data_5_2: type=tWORD, init-value=CONST_tWORD_0:0
      data Data_5_3: type=tBYTE, init-value=CONST_tBYTE_0:0
    SR_CfgVh_1
      data Data_4_1: type=tDWORD, init-value=CONST_tDWORD_0:0
      data Data_4_2: type=tWORD, init-value=CONST_tWORD_0:0
      data Data_4_3: type=tBYTE, init-value=CONST_tBYTE_0:0
    SR_CfgVh_2
      data Data_3_1: type=tDWORD, init-value=CONST_tDWORD_0:0
      data Data_3_2: type=tWORD, init-value=CONST_tWORD_0:0
      data Data_3_3: type=tBYTE, init-value=CONST_tBYTE_0:0
    SR_AffMenuPrgPem
      data AffMenuPrgPem: type=tLOG, init-value=CONST_tLOG_0:0
    SR_AffMenuReserveZEV
      data AffMenuReserveZEV: type=tLOG, init-value=CONST_tLOG_0:0
    SR_AppuiPushBEPR
      data AppuiPushBEPR: type=tLOG, init-value=CONST_tLOG_0:0
    SR_AppuiPushMPDParHDC
      data AppuiPushMPDParHDC: type=tLOG, init-value=CONST_tLOG_0:0
    SR_AppuiToucheConfigDeVMF
      data AppuiToucheConfigDeVMF: type=tLOG, init-value=CONST_tLOG_0:0
    SR_CondaRealiseePourCAN
      data CondaRealiseePourCAN: type=tBYTE, init-value=CONST_tBYTE_0:0
    SR_DispoDmdMenuPrgPem
      data DispoDmdMenuPrgPem: type=tLOG, init-value=CONST_tLOG_0:0
    SR_DmdDispoDmdMenuReserveZEV
      data DmdDispoDmdMenuReserveZEV: type=tLOG, init-value=CONST_tLOG_0:0
    SR_DmdmCGEPVOffReserveZEV
      data DmdmCGEPVOffReserveZEV: type=tLOG, init-value=CONST_tLOG_0:0
    SR_DmdMenuAccueilCond
      data DmdMenuAccueilCond: type=tLOG, init-value=CONST_tLOG_0:0
    SR_DmdMenuActButee1XVV
      data DmdMenuActButee1XVV: type=tLOG, init-value=CONST_tLOG_0:0
    SR_DmdMenuActButee2XVV
      data DmdMenuActButee2XVV: type=tLOG, init-value=CONST_tLOG_0:0
    SR_DmdMenuActButee3XVV
      data DmdMenuActButee3XVV: type=tLOG, init-value=CONST_tLOG_0:0
    SR_DmdMenuActButee4XVV
      data DmdMenuActButee4XVV: type=tLOG, init-value=CONST_tLOG_0:0
    SR_DmdMenuActButee5XVV
      data DmdMenuActButee5XVV: type=tLOG, init-value=CONST_tLOG_0:0
    SR_DmdMenuActButeeGenXVV
      data DmdMenuActButeeGenXVV: type=tLOG, init-value=CONST_tLOG_0:0
    SR_DmdMenuARCSensNiv
      data DmdMenuARCSensNiv: type=tBILOG, init-value=CONST_tBILOG_2:2
    SR_DmdMenuBAAActivation
      data DmdMenuBAAActivation: type=tLOG, init-value=CONST_tLOG_0:0
    SR_DmdMenuBAAAutolocking
      data DmdMenuBAAAutolocking: type=tLOG, init-value=CONST_tLOG_0:0
    SR_DmdMenuClim_PrecondASAP
      data DmdMenuClim_PrecondASAP: type=tLOG, init-value=CONST_tLOG_0:0
    SR_DmdMenuCLIM_PrecondDi1
      data DmdMenuCLIM_PrecondDi1: type=tLOG, init-value=CONST_tLOG_0:0
    SR_DmdMenuCLIM_PrecondDi2
      data DmdMenuCLIM_PrecondDi2: type=tLOG, init-value=CONST_tLOG_0:0
    SR_DmdMenuCLIM_PrecondDi3
      data DmdMenuCLIM_PrecondDi3: type=tLOG, init-value=CONST_tLOG_0:0
    SR_DmdMenuCLIM_PrecondDi4
      data DmdMenuCLIM_PrecondDi4: type=tLOG, init-value=CONST_tLOG_0:0
    SR_DmdMenuCLIM_PrecondH1
      data DmdMenuCLIM_PrecondH1: type=tWORD, init-value=CONST_tWORD_0:0
    SR_DmdMenuCLIM_PrecondH2
      data DmdMenuCLIM_PrecondH2: type=tWORD, init-value=CONST_tWORD_0:0
    SR_DmdMenuCLIM_PrecondH3
      data DmdMenuCLIM_PrecondH3: type=tWORD, init-value=CONST_tWORD_0:0
    SR_DmdMenuCLIM_PrecondH4
      data DmdMenuCLIM_PrecondH4: type=tWORD, init-value=CONST_tWORD_0:0
    SR_DmdMenuCLIM_PrecondJe1
      data DmdMenuCLIM_PrecondJe1: type=tLOG, init-value=CONST_tLOG_0:0
    SR_DmdMenuCLIM_PrecondJe2
      data DmdMenuCLIM_PrecondJe2: type=tLOG, init-value=CONST_tLOG_0:0
    SR_DmdMenuCLIM_PrecondJe3
      data DmdMenuCLIM_PrecondJe3: type=tLOG, init-value=CONST_tLOG_0:0
    SR_DmdMenuCLIM_PrecondJe4
      data DmdMenuCLIM_PrecondJe4: type=tLOG, init-value=CONST_tLOG_0:0
    SR_DmdMenuCLIM_PrecondLu1
      data DmdMenuCLIM_PrecondLu1: type=tLOG, init-value=CONST_tLOG_0:0
    SR_DmdMenuCLIM_PrecondLu2
      data DmdMenuCLIM_PrecondLu2: type=tLOG, init-value=CONST_tLOG_0:0
    SR_DmdMenuCLIM_PrecondLu3
      data DmdMenuCLIM_PrecondLu3: type=tLOG, init-value=CONST_tLOG_0:0
    SR_DmdMenuCLIM_PrecondLu4
      data DmdMenuCLIM_PrecondLu4: type=tLOG, init-value=CONST_tLOG_0:0
    SR_DmdMenuCLIM_PrecondMa1
      data DmdMenuCLIM_PrecondMa1: type=tLOG, init-value=CONST_tLOG_0:0
    SR_DmdMenuCLIM_PrecondMa2
      data DmdMenuCLIM_PrecondMa2: type=tLOG, init-value=CONST_tLOG_0:0
    SR_DmdMenuCLIM_PrecondMa3
      data DmdMenuCLIM_PrecondMa3: type=tLOG, init-value=CONST_tLOG_0:0
    SR_DmdMenuCLIM_PrecondMa4
      data DmdMenuCLIM_PrecondMa4: type=tLOG, init-value=CONST_tLOG_0:0
    SR_DmdMenuCLIM_PrecondMe1
      data DmdMenuCLIM_PrecondMe1: type=tLOG, init-value=CONST_tLOG_0:0
    SR_DmdMenuCLIM_PrecondMe2
      data DmdMenuCLIM_PrecondMe2: type=tLOG, init-value=CONST_tLOG_0:0
    SR_DmdMenuCLIM_PrecondMe3
      data DmdMenuCLIM_PrecondMe3: type=tLOG, init-value=CONST_tLOG_0:0
    SR_DmdMenuCLIM_PrecondMe4
      data DmdMenuCLIM_PrecondMe4: type=tLOG, init-value=CONST_tLOG_0:0
    SR_DmdMenuCLIM_PrecondOn1
      data DmdMenuCLIM_PrecondOn1: type=tLOG, init-value=CONST_tLOG_0:0
    SR_DmdMenuCLIM_PrecondOn2
      data DmdMenuCLIM_PrecondOn2: type=tLOG, init-value=CONST_tLOG_0:0
    SR_DmdMenuCLIM_PrecondOn3
      data DmdMenuCLIM_PrecondOn3: type=tLOG, init-value=CONST_tLOG_0:0
    SR_DmdMenuCLIM_PrecondOn4
      data DmdMenuCLIM_PrecondOn4: type=tLOG, init-value=CONST_tLOG_0:0
    SR_DmdMenuCLIM_PrecondSa1
      data DmdMenuCLIM_PrecondSa1: type=tLOG, init-value=CONST_tLOG_0:0
    SR_DmdMenuCLIM_PrecondSa2
      data DmdMenuCLIM_PrecondSa2: type=tLOG, init-value=CONST_tLOG_0:0
    SR_DmdMenuCLIM_PrecondSa3
      data DmdMenuCLIM_PrecondSa3: type=tLOG, init-value=CONST_tLOG_0:0
    SR_DmdMenuCLIM_PrecondSa4
      data DmdMenuCLIM_PrecondSa4: type=tLOG, init-value=CONST_tLOG_0:0
    SR_DmdMenuCLIM_PrecondVe1
      data DmdMenuCLIM_PrecondVe1: type=tLOG, init-value=CONST_tLOG_0:0
    SR_DmdMenuCLIM_PrecondVe2
      data DmdMenuCLIM_PrecondVe2: type=tLOG, init-value=CONST_tLOG_0:0
    SR_DmdMenuCLIM_PrecondVe3
      data DmdMenuCLIM_PrecondVe3: type=tLOG, init-value=CONST_tLOG_0:0
    SR_DmdMenuCLIM_PrecondVe4
      data DmdMenuCLIM_PrecondVe4: type=tLOG, init-value=CONST_tLOG_0:0
    SR_DmdMenuCMDM_DAE
      data DmdMenuCMDM_DAE: type=tLOG, init-value=CONST_tLOG_0:0
    SR_DmdMenuCMDM_DAE_4WD
      data DmdMenuCMDM_DAE_4WD: type=tLOG, init-value=CONST_tLOG_0:0
    SR_DmdMenuDAAActivation
      data DmdMenuDAAActivation: type=tLOG, init-value=CONST_tLOG_0:0
    SR_DmdMenuDSG
      data DmdMenuDSG: type=tLOG, init-value=CONST_tLOG_0:0
    SR_DmdMenuEclAccomp
      data DmdMenuEclAccomp: type=tLOG, init-value=CONST_tLOG_0:0
    SR_DmdMenuEclAccompTempo
      data DmdMenuEclAccompTempo: type=tBILOG, init-value=CONST_tBILOG_0:0
    SR_DmdMenuEclAdapt
      data DmdMenuEclAdapt: type=tLOG, init-value=CONST_tLOG_0:0
    SR_DmdMenuEclAmbi
      data DmdMenuEclAmbi: type=tLOG, init-value=CONST_tLOG_0:0
    SR_DmdMenuEclAmbiNiv
      data DmdMenuEclAmbiNiv: type=tBYTE, init-value=CONST_tBYTE_3:3
    SR_DmdMenuEclAuto
      data DmdMenuEclAuto: type=tLOG, init-value=CONST_tLOG_0:0
    SR_DmdMenuEclAutoroute
      data DmdMenuEclAutoroute: type=tLOG, init-value=CONST_tLOG_0:0
    SR_DmdMenuEclCaland
      data DmdMenuEclCaland: type=tLOG, init-value=CONST_tLOG_0:0
    SR_DmdMenuEclDeconda
      data DmdMenuEclDeconda: type=tLOG, init-value=CONST_tLOG_0:0
    SR_DmdMenuEclDecondaTempo
      data DmdMenuEclDecondaTempo: type=tBILOG, init-value=CONST_tBILOG_0:0
    SR_DmdMenuECLI_PPC_ANIM
      data DmdMenuECLI_PPC_ANIM: type=tBYTE, init-value=CONST_tBYTE_0:0
    SR_DmdMenuECLI_PPC_BLOC1
      data DmdMenuECLI_PPC_BLOC1: type=tLOG, init-value=CONST_tLOG_0:0
    SR_DmdMenuECLI_PPC_COL1
      data DmdMenuECLI_PPC_COL1: type=tBYTE, init-value=CONST_tBYTE_0:0
    SR_DmdMenuECLX_AFS
      data DmdMenuECLX_AFS: type=tLOG, init-value=CONST_tLOG_0:0
    SR_DmdMenuECLX_ARS
      data DmdMenuECLX_ARS: type=tLOG, init-value=CONST_tLOG_0:0
    SR_DmdMenuECLX_ECL_CAFR
      data DmdMenuECLX_ECL_CAFR: type=tLOG, init-value=CONST_tLOG_0:0
    SR_DmdMenuEssuiVitMar
      data DmdMenuEssuiVitMar: type=tLOG, init-value=CONST_tLOG_0:0
    SR_DmdMenuFARC
      data DmdMenuFARC: type=tLOG, init-value=CONST_tLOG_0:0
    SR_DmdMenuFeuxDiurne
      data DmdMenuFeuxDiurne: type=tLOG, init-value=CONST_tLOG_0:0
    SR_DmdMenuFSEAuto
      data DmdMenuFSEAuto: type=tLOG, init-value=CONST_tLOG_0:0
    SR_DmdMenuGAV_AMLA
      data DmdMenuGAV_AMLA: type=tLOG, init-value=CONST_tLOG_0:0
    SR_DmdMenuILV
      data DmdMenuILV: type=tLOG, init-value=CONST_tLOG_0:0
    SR_DmdMenuILV_ETSR
      data DmdMenuILV_ETSR: type=tLOG, init-value=CONST_tLOG_0:0
    SR_DmdMenuIMA
      data DmdMenuIMA: type=tLOG, init-value=CONST_tLOG_0:0
    SR_DmdMenuInfoLvvDispo
      data DmdMenuInfoLvvDispo: type=tLOG, init-value=CONST_tLOG_0:0
    SR_DmdMenuInfoParamDispo
      data DmdMenuInfoParamDispo: type=tLOG, init-value=CONST_tLOG_0:0
    SR_DmdMenuInfoPrecondDispo
      data DmdMenuInfoPrecondDispo: type=tLOG, init-value=CONST_tLOG_0:0
    SR_DmdMenuInfoRechargeDispo
      data DmdMenuInfoRechargeDispo: type=tLOG, init-value=CONST_tLOG_0:0
    SR_DmdMenuInfoRvvDispo
      data DmdMenuInfoRvvDispo: type=tLOG, init-value=CONST_tLOG_0:0
    SR_DmdMenuInfoUniteLangueDispo
      data DmdMenuInfoUniteLangueDispo: type=tLOG, init-value=CONST_tLOG_0:0
    SR_DmdMenuInfoXVVDispo
      data DmdMenuInfoXVVDispo: type=tLOG, init-value=CONST_tLOG_0:0
    SR_DmdMenuINV_ADSD
      data DmdMenuINV_ADSD: type=tLOG, init-value=CONST_tLOG_0:0
    SR_DmdMenuLangueVehicule
      data DmdMenuLangueVehicule: type=tBYTE, init-value=CONST_tBYTE_0:0
    SR_DmdMenuMotoVolAr
      data DmdMenuMotoVolAr: type=tLOG, init-value=CONST_tLOG_0:0
    SR_DmdMenuPresenceARC
      data DmdMenuPresenceARC: type=tLOG, init-value=CONST_tLOG_0:0
    SR_DmdMenuPrgHcEnd
      data DmdMenuPrgHcEnd: type=tDWORD, init-value=CONST_tDWORD_0:0
    SR_DmdMenuPrgHcStart
      data DmdMenuPrgHcStart: type=tDWORD, init-value=CONST_tDWORD_0:0
    SR_DmdMenuPrgPemDi
      data DmdMenuPrgPemDi: type=tDWORD, init-value=CONST_tDWORD_0:0
    SR_DmdMenuPrgPemJe
      data DmdMenuPrgPemJe: type=tDWORD, init-value=CONST_tDWORD_0:0
    SR_DmdMenuPrgPemLu
      data DmdMenuPrgPemLu: type=tDWORD, init-value=CONST_tDWORD_0:0
    SR_DmdMenuPrgPemMa
      data DmdMenuPrgPemMa: type=tDWORD, init-value=CONST_tDWORD_0:0
    SR_DmdMenuPrgPemMe
      data DmdMenuPrgPemMe: type=tDWORD, init-value=CONST_tDWORD_0:0
    SR_DmdMenuPrgPemSa
      data DmdMenuPrgPemSa: type=tDWORD, init-value=CONST_tDWORD_0:0
    SR_DmdMenuPrgPemVe
      data DmdMenuPrgPemVe: type=tDWORD, init-value=CONST_tDWORD_0:0
    SR_DmdMenuPRV_MODE
      data DmdMenuPRV_MODE: type=tBYTE, init-value=CONST_tBYTE_0:0
    SR_DmdMenuReserveZEV
      data DmdMenuReserveZEV: type=tBILOG, init-value=CONST_tBILOG_0:0
    SR_DmdMenuRTAB_EnergyRec
      data DmdMenuRTAB_EnergyRec: type=tBYTE, init-value=CONST_tBYTE_0b01:0b01
    SR_DmdMenuRTAB_RechargeHDeb
      data DmdMenuRTAB_RechargeHDeb: type=tWORD, init-value=CONST_tWORD_0:0
    SR_DmdMenuRTAB_TypeRec
      data DmdMenuRTAB_TypeRec: type=tLOG, init-value=CONST_tLOG_0:0
    SR_DmdMenuSelecArriere
      data DmdMenuSelecArriere: type=tLOG, init-value=CONST_tLOG_0:0
    SR_DmdMenuSelecCabine
      data DmdMenuSelecCabine: type=tLOG, init-value=CONST_tLOG_0:0
    SR_DmdMenuSelecOuvPlip
      data DmdMenuSelecOuvPlip: type=tLOG, init-value=CONST_tLOG_0:0
    SR_DmdMenuSelPrgHc
      data DmdMenuSelPrgHc: type=tLOG, init-value=CONST_tLOG_0:0
    SR_DmdMenuSelReserveZEV
      data DmdMenuSelReserveZEV: type=tLOG, init-value=CONST_tLOG_0:0
    SR_DmdMenuSonPoly
      data DmdMenuSonPoly: type=tBILOG, init-value=CONST_tBILOG_0:0
    SR_DmdMenuStatusAAS
      data DmdMenuStatusAAS: type=tLOG, init-value=CONST_tLOG_0:0
    SR_DmdMenuStatusSAM
      data DmdMenuStatusSAM: type=tLOG, init-value=CONST_tLOG_0:0
    SR_DmdMenuTCFG
      data DmdMenuTCFG: type=tBYTE, init-value=CONST_tBYTE_0:0
    SR_DmdMenuUniteConso
      data DmdMenuUniteConso: type=tLOG, init-value=CONST_tLOG_0:0
    SR_DmdMenuUniteDistance
      data DmdMenuUniteDistance: type=tLOG, init-value=CONST_tLOG_0:0
    SR_DmdMenuUniteTemperature
      data DmdMenuUniteTemperature: type=tLOG, init-value=CONST_tLOG_0:0
    SR_DmdMenuUniteVolume
      data DmdMenuUniteVolume: type=tLOG, init-value=CONST_tLOG_0:0
    SR_DmdMenuVAM_ECS_MODE
      data DmdMenuVAM_ECS_MODE: type=tLOG, init-value=CONST_tLOG_0:0
    SR_DmdMenuVitesse1XVV
      data DmdMenuVitesse1XVV: type=tBYTE, init-value=CONST_tBYTE_0:0
    SR_DmdMenuVitesse2XVV
      data DmdMenuVitesse2XVV: type=tBYTE, init-value=CONST_tBYTE_0:0
    SR_DmdMenuVitesse3XVV
      data DmdMenuVitesse3XVV: type=tBYTE, init-value=CONST_tBYTE_0:0
    SR_DmdMenuVitesse4XVV
      data DmdMenuVitesse4XVV: type=tBYTE, init-value=CONST_tBYTE_0:0
    SR_DmdMenuVitesse5XVV
      data DmdMenuVitesse5XVV: type=tBYTE, init-value=CONST_tBYTE_0:0
    SR_DmdMenuVitLvv1
      data DmdMenuVitLvv1: type=tBYTE, init-value=CONST_tBYTE_0:0
    SR_DmdMenuVitLvv2
      data DmdMenuVitLvv2: type=tBYTE, init-value=CONST_tBYTE_0:0
    SR_DmdMenuVitLvv3
      data DmdMenuVitLvv3: type=tBYTE, init-value=CONST_tBYTE_0:0
    SR_DmdMenuVitLvv4
      data DmdMenuVitLvv4: type=tBYTE, init-value=CONST_tBYTE_0:0
    SR_DmdMenuVitLvv5
      data DmdMenuVitLvv5: type=tBYTE, init-value=CONST_tBYTE_0:0
    SR_DmdMenuVitLvv6
      data DmdMenuVitLvv6: type=tBYTE, init-value=CONST_tBYTE_0:0
    SR_DmdMenuVitRvv1
      data DmdMenuVitRvv1: type=tBYTE, init-value=CONST_tBYTE_0:0
    SR_DmdMenuVitRvv2
      data DmdMenuVitRvv2: type=tBYTE, init-value=CONST_tBYTE_0:0
    SR_DmdMenuVitRvv3
      data DmdMenuVitRvv3: type=tBYTE, init-value=CONST_tBYTE_0:0
    SR_DmdMenuVitRvv4
      data DmdMenuVitRvv4: type=tBYTE, init-value=CONST_tBYTE_0:0
    SR_DmdMenuVitRvv5
      data DmdMenuVitRvv5: type=tBYTE, init-value=CONST_tBYTE_0:0
    SR_DmdMenuVitRvv6
      data DmdMenuVitRvv6: type=tBYTE, init-value=CONST_tBYTE_0:0
    SR_DmdMenuVTOR_IRV
      data DmdMenuVTOR_IRV: type=tLOG, init-value=CONST_tLOG_0:0
    SR_EtatPrincipalSEV
      data EtatPrincipalSEV: type=t_SEV, init-value=CONST_t_SEV_0x69:105
    SR_MenuPersoMuet
      data MenuPersoMuet: type=tLOG, init-value=CONST_tLOG_0:0
    SR_PhaseVieLS
      data PhaseVieLS: type=t_cCANLS, init-value=CONST_t_cCANLS_0:0
    SR_RechargeTypeStatus
      data RechargeTypeStatus: type=tBYTE, init-value=CONST_tBYTE_0:0
    SR_ToggleFrame21BRecue
      data ToggleFrame21BRecue: type=tLOG, init-value=CONST_tLOG_0:0  # SR for frame 21B
    SR_ToggleNewFrame15B
      data ToggleNewFrame15B: type=tLOG, init-value=CONST_tLOG_0:0
    SR_ToggleNewFrame19B
      data ToggleNewFrame19B: type=tLOG, init-value=CONST_tLOG_0:0
    SR_ToggleNewFrame1DB
      data ToggleNewFrame1DB: type=tLOG, init-value=CONST_tLOG_0:0
    SR_ToggleNewFrame25B29B
      data ToggleNewFrame25B29B: type=tLOG, init-value=CONST_tLOG_0:0
    SR_ToggleNewFrame2DB
      data ToggleNewFrame2DB: type=tLOG, init-value=CONST_tLOG_0:0
    SR_ButeeXvv1DeMenuPerso
      data ButeeXvv1DeMenuPerso: type=tBYTE, init-value=CONST_tBYTE_0:0
    SR_ButeeXvv2DeMenuPerso
      data ButeeXvv2DeMenuPerso: type=tBYTE, init-value=CONST_tBYTE_0:0
    SR_ButeeXvv3DeMenuPerso
      data ButeeXvv3DeMenuPerso: type=tBYTE, init-value=CONST_tBYTE_0:0
    SR_ButeeXvv4DeMenuPerso
      data ButeeXvv4DeMenuPerso: type=tBYTE, init-value=CONST_tBYTE_0:0
    SR_ButeeXvv5DeMenuPerso
      data ButeeXvv5DeMenuPerso: type=tBYTE, init-value=CONST_tBYTE_0:0
    SR_DdeAccesJDADeVMF
      data DdeAccesJDADeVMF: type=tLOG, init-value=CONST_tLOG_0:0
    SR_DdeAllumPlafDeVMF
      data DdeAllumPlafDeVMF: type=tLOG, init-value=CONST_tLOG_0:0
    SR_DdeBlackPanelDeVMF
      data DdeBlackPanelDeVMF: type=tLOG, init-value=CONST_tLOG_0:0
    SR_DdeCheckTcfg
      data DdeCheckTcfg: type=tLOG, init-value=CONST_tLOG_0:0
    SR_DdeColorisationCMBDeVMF
      data DdeColorisationCMBDeVMF: type=tLOG, init-value=CONST_tLOG_0:0
    SR_DdeConfigToucheDeVMF
      data DdeConfigToucheDeVMF: type=tLOG, init-value=CONST_tLOG_0:0
    SR_DdePersoCMBDeVMF
      data DdePersoCMBDeVMF: type=tLOG, init-value=CONST_tLOG_0:0
    SR_DispoDmdMenuPrecond
      data DispoDmdMenuPrecond: type=tBYTE, init-value=CONST_tWORD_0:0
    SR_DispoDmdMenuRecharge
      data DispoDmdMenuRecharge: type=tBYTE, init-value=CONST_tBYTE_0b01:0b01
    SR_DispoEtatMenuPrgPem
      data DispoEtatMenuPrgPem: type=tLOG, init-value=CONST_tLOG_0:0
    SR_DispoEtatMenuReserveZEV
      data DispoEtatMenuReserveZEV: type=tLOG, init-value=CONST_tLOG_0:0
    SR_DmdmCGEPVReserveZEV
      data DmdmCGEPVReserveZEV: type=tLOG, init-value=CONST_tLOG_0:0
    SR_DmdMenuSelPrgDi
      data DmdMenuSelPrgDi: type=tLOG, init-value=CONST_tLOG_0:0
    SR_DmdMenuSelPrgJe
      data DmdMenuSelPrgJe: type=tLOG, init-value=CONST_tLOG_0:0
    SR_DmdMenuSelPrgLu
      data DmdMenuSelPrgLu: type=tLOG, init-value=CONST_tLOG_0:0
    SR_DmdMenuSelPrgMa
      data DmdMenuSelPrgMa: type=tLOG, init-value=CONST_tLOG_0:0
    SR_DmdMenuSelPrgMe
      data DmdMenuSelPrgMe: type=tLOG, init-value=CONST_tLOG_0:0
    SR_DmdMenuSelPrgSa
      data DmdMenuSelPrgSa: type=tLOG, init-value=CONST_tLOG_0:0
    SR_DmdMenuSelPrgVe
      data DmdMenuSelPrgVe: type=tLOG, init-value=CONST_tLOG_0:0
    SR_DmdmPrgHcEnd
      data DmdmPrgHcEnd: type=tDWORD, init-value=CONST_tDWORD_0:0
    SR_DmdmPrgHcStart
      data DmdmPrgHcStart: type=tDWORD, init-value=CONST_tDWORD_0:0
    SR_DmdmPrgPemDi
      data DmdmPrgPemDi: type=tDWORD, init-value=CONST_tDWORD_0:0
    SR_DmdmPrgPemJe
      data DmdmPrgPemJe: type=tDWORD, init-value=CONST_tDWORD_0:0
    SR_DmdmPrgPemLu
      data DmdmPrgPemLu: type=tDWORD, init-value=CONST_tDWORD_0:0
    SR_DmdmPrgPemMa
      data DmdmPrgPemMa: type=tDWORD, init-value=CONST_tDWORD_0:0
    SR_DmdmPrgPemMe
      data DmdmPrgPemMe: type=tDWORD, init-value=CONST_tDWORD_0:0
    SR_DmdmPrgPemSa
      data DmdmPrgPemSa: type=tDWORD, init-value=CONST_tDWORD_0:0
    SR_DmdmPrgPemVe
      data DmdmPrgPemVe: type=tDWORD, init-value=CONST_tDWORD_0:0
    SR_EclAccompDeMenuPerso
      data EclAccompDeMenuPerso: type=t_cAccomp, init-value=CONST_t_cAccomp_0:0
    SR_EclDecondaDeMenuPerso
      data EclDecondaDeMenuPerso: type=t_cDeconda, init-value=CONST_t_cDeconda_0:0
    SR_EtatMenuAccueilCond
      data EtatMenuAccueilCond: type=tLOG, init-value=CONST_tLOG_0:0
    SR_EtatMenuActButee1XVV
      data EtatMenuActButee1XVV: type=tLOG, init-value=CONST_tLOG_0:0
    SR_EtatMenuActButee2XVV
      data EtatMenuActButee2XVV: type=tLOG, init-value=CONST_tLOG_0:0
    SR_EtatMenuActButee3XVV
      data EtatMenuActButee3XVV: type=tLOG, init-value=CONST_tLOG_0:0
    SR_EtatMenuActButee4XVV
      data EtatMenuActButee4XVV: type=tLOG, init-value=CONST_tLOG_0:0
    SR_EtatMenuActButee5XVV
      data EtatMenuActButee5XVV: type=tLOG, init-value=CONST_tLOG_0:0
    SR_EtatMenuActButeeGenXVV
      data EtatMenuActButeeGenXVV: type=tLOG, init-value=CONST_tLOG_0:0
    SR_EtatMenuARCSensNiv
      data EtatMenuARCSensNiv: type=tBILOG, init-value=CONST_tBILOG_2:2
    SR_EtatMenuBAAActivation
      data EtatMenuBAAActivation: type=tLOG, init-value=CONST_tLOG_0:0
    SR_EtatMenuBAAAutolocking
      data EtatMenuBAAAutolocking: type=tLOG, init-value=CONST_tLOG_0:0
    SR_EtatMenuCLIM_PrecondASAP
      data EtatMenuCLIM_PrecondASAP: type=tLOG, init-value=CONST_tLOG_0:0
    SR_EtatMenuCLIM_PrecondDi1
      data EtatMenuCLIM_PrecondDi1: type=tLOG, init-value=CONST_tLOG_0:0
    SR_EtatMenuCLIM_PrecondDi2
      data EtatMenuCLIM_PrecondDi2: type=tLOG, init-value=CONST_tLOG_0:0
    SR_EtatMenuCLIM_PrecondDi3
      data EtatMenuCLIM_PrecondDi3: type=tLOG, init-value=CONST_tLOG_0:0
    SR_EtatMenuCLIM_PrecondDi4
      data EtatMenuCLIM_PrecondDi4: type=tLOG, init-value=CONST_tLOG_0:0
    SR_EtatMenuCLIM_PrecondH1
      data EtatMenuCLIM_PrecondH1: type=tWORD, init-value=CONST_tWORD_0:0
    SR_EtatMenuCLIM_PrecondH2
      data EtatMenuCLIM_PrecondH2: type=tWORD, init-value=CONST_tWORD_0:0
    SR_EtatMenuCLIM_PrecondH3
      data EtatMenuCLIM_PrecondH3: type=tWORD, init-value=CONST_tWORD_0:0
    SR_EtatMenuCLIM_PrecondH4
      data EtatMenuCLIM_PrecondH4: type=tWORD, init-value=CONST_tWORD_0:0
    SR_EtatMenuCLIM_PrecondJe1
      data EtatMenuCLIM_PrecondJe1: type=tLOG, init-value=CONST_tLOG_0:0
    SR_EtatMenuCLIM_PrecondJe2
      data EtatMenuCLIM_PrecondJe2: type=tLOG, init-value=CONST_tLOG_0:0
    SR_EtatMenuCLIM_PrecondJe3
      data EtatMenuCLIM_PrecondJe3: type=tLOG, init-value=CONST_tLOG_0:0
    SR_EtatMenuCLIM_PrecondJe4
      data EtatMenuCLIM_PrecondJe4: type=tLOG, init-value=CONST_tLOG_0:0
    SR_EtatMenuCLIM_PrecondLu1
      data EtatMenuCLIM_PrecondLu1: type=tLOG, init-value=CONST_tLOG_0:0
    SR_EtatMenuCLIM_PrecondLu2
      data EtatMenuCLIM_PrecondLu2: type=tLOG, init-value=CONST_tLOG_0:0
    SR_EtatMenuCLIM_PrecondLu3
      data EtatMenuCLIM_PrecondLu3: type=tLOG, init-value=CONST_tLOG_0:0
    SR_EtatMenuCLIM_PrecondLu4
      data EtatMenuCLIM_PrecondLu4: type=tLOG, init-value=CONST_tLOG_0:0
    SR_EtatMenuCLIM_PrecondMa1
      data EtatMenuCLIM_PrecondMa1: type=tLOG, init-value=CONST_tLOG_0:0
    SR_EtatMenuCLIM_PrecondMa2
      data EtatMenuCLIM_PrecondMa2: type=tLOG, init-value=CONST_tLOG_0:0
    SR_EtatMenuCLIM_PrecondMa3
      data EtatMenuCLIM_PrecondMa3: type=tLOG, init-value=CONST_tLOG_0:0
    SR_EtatMenuCLIM_PrecondMa4
      data EtatMenuCLIM_PrecondMa4: type=tLOG, init-value=CONST_tLOG_0:0
    SR_EtatMenuCLIM_PrecondMe1
      data EtatMenuCLIM_PrecondMe1: type=tLOG, init-value=CONST_tLOG_0:0
    SR_EtatMenuCLIM_PrecondMe2
      data EtatMenuCLIM_PrecondMe2: type=tLOG, init-value=CONST_tLOG_0:0
    SR_EtatMenuCLIM_PrecondMe3
      data EtatMenuCLIM_PrecondMe3: type=tLOG, init-value=CONST_tLOG_0:0
    SR_EtatMenuCLIM_PrecondMe4
      data EtatMenuCLIM_PrecondMe4: type=tLOG, init-value=CONST_tLOG_0:0
    SR_EtatMenuCLIM_PrecondOn1
      data EtatMenuCLIM_PrecondOn1: type=tLOG, init-value=CONST_tLOG_0:0
    SR_EtatMenuCLIM_PrecondOn2
      data EtatMenuCLIM_PrecondOn2: type=tLOG, init-value=CONST_tLOG_0:0
    SR_EtatMenuCLIM_PrecondOn3
      data EtatMenuCLIM_PrecondOn3: type=tLOG, init-value=CONST_tLOG_0:0
    SR_EtatMenuCLIM_PrecondOn4
      data EtatMenuCLIM_PrecondOn4: type=tLOG, init-value=CONST_tLOG_0:0
    SR_EtatMenuCLIM_PrecondSa1
      data EtatMenuCLIM_PrecondSa1: type=tLOG, init-value=CONST_tLOG_0:0
    SR_EtatMenuCLIM_PrecondSa2
      data EtatMenuCLIM_PrecondSa2: type=tLOG, init-value=CONST_tLOG_0:0
    SR_EtatMenuCLIM_PrecondSa3
      data EtatMenuCLIM_PrecondSa3: type=tLOG, init-value=CONST_tLOG_0:0
    SR_EtatMenuCLIM_PrecondSa4
      data EtatMenuCLIM_PrecondSa4: type=tLOG, init-value=CONST_tLOG_0:0
    SR_EtatMenuCLIM_PrecondVe1
      data EtatMenuCLIM_PrecondVe1: type=tLOG, init-value=CONST_tLOG_0:0
    SR_EtatMenuCLIM_PrecondVe2
      data EtatMenuCLIM_PrecondVe2: type=tLOG, init-value=CONST_tLOG_0:0
    SR_EtatMenuCLIM_PrecondVe3
      data EtatMenuCLIM_PrecondVe3: type=tLOG, init-value=CONST_tLOG_0:0
    SR_EtatMenuCLIM_PrecondVe4
      data EtatMenuCLIM_PrecondVe4: type=tLOG, init-value=CONST_tLOG_0:0
    SR_EtatMenuDAAActivation
      data EtatMenuDAAActivation: type=tLOG, init-value=CONST_tLOG_0:0
    SR_EtatMenuDSG
      data EtatMenuDSG: type=tLOG, init-value=CONST_tLOG_0:0
    SR_EtatMenuEclAccomp
      data EtatMenuEclAccomp: type=tLOG, init-value=CONST_tLOG_0:0
    SR_EtatMenuEclAccompTempo
      data EtatMenuEclAccompTempo: type=tBILOG, init-value=CONST_tBILOG_0:0
    SR_EtatMenuEclAdapt
      data EtatMenuEclAdapt: type=tLOG, init-value=CONST_tLOG_0:0
    SR_EtatMenuEclAmbi
      data EtatMenuEclAmbi: type=tLOG, init-value=CONST_tLOG_0:0
    SR_EtatMenuEclAmbiNiv
      data EtatMenuEclAmbiNiv: type=tBYTE, init-value=CONST_tBYTE_6:6
    SR_EtatMenuEclAuto
      data EtatMenuEclAuto: type=tLOG, init-value=CONST_tLOG_0:0
    SR_EtatMenuEclAutoroute
      data EtatMenuEclAutoroute: type=tLOG, init-value=CONST_tLOG_0:0
    SR_EtatMenuEclCaland
      data EtatMenuEclCaland: type=tLOG, init-value=CONST_tLOG_0:0
    SR_EtatMenuEclDeconda
      data EtatMenuEclDeconda: type=tLOG, init-value=CONST_tLOG_0:0
    SR_EtatMenuEclDecondaTempo
      data EtatMenuEclDecondaTempo: type=tBILOG, init-value=CONST_tBILOG_0:0
    SR_EtatMenuECLI_PPC_ANIM
      data EtatMenuECLI_PPC_ANIM: type=tBYTE, init-value=CONST_tBYTE_0:0
    SR_EtatMenuECLI_PPC_BLOC1
      data EtatMenuECLI_PPC_BLOC1: type=tLOG, init-value=CONST_tLOG_0:0
    SR_EtatMenuECLI_PPC_COL1
      data EtatMenuECLI_PPC_COL1: type=tBYTE, init-value=CONST_tBYTE_0:0
    SR_EtatMenuECLX_AFS
      data EtatMenuECLX_AFS: type=tLOG, init-value=CONST_tLOG_0:0
    SR_EtatMenuECLX_ARS
      data EtatMenuECLX_ARS: type=tLOG, init-value=CONST_tLOG_0:0
    SR_EtatMenuECLX_ECL_CAFR
      data EtatMenuECLX_ECL_CAFR: type=tLOG, init-value=CONST_tLOG_0:0
    SR_EtatMenuEssuiVitMar
      data EtatMenuEssuiVitMar: type=tLOG, init-value=CONST_tLOG_0:0
    SR_EtatMenuFARC
      data EtatMenuFARC: type=tLOG, init-value=CONST_tLOG_0:0
    SR_EtatMenuFeuxDiurne
      data EtatMenuFeuxDiurne: type=tLOG, init-value=CONST_tLOG_0:0
    SR_EtatMenuFSEAuto
      data EtatMenuFSEAuto: type=tLOG, init-value=CONST_tLOG_0:0
    SR_EtatMenuGAV_AMLA
      data EtatMenuGAV_AMLA: type=tLOG, init-value=CONST_tLOG_0:0
    SR_EtatMenuILV
      data EtatMenuILV: type=tLOG, init-value=CONST_tLOG_0:0
    SR_EtatMenuILV_ETSR
      data EtatMenuILV_ETSR: type=tLOG, init-value=CONST_tLOG_0:0
    SR_EtatMenuIMA
      data EtatMenuIMA: type=tLOG, init-value=CONST_tLOG_0:0
    SR_EtatMenuInfoParamDispo
      data EtatMenuInfoParamDispo: type=tLOG, init-value=CONST_tLOG_0:0
    SR_EtatMenuInfoUniteLangueDispo
      data EtatMenuInfoUniteLangueDispo: type=tLOG, init-value=CONST_tLOG_0:0
    SR_EtatMenuInfoVitLvvDispo
      data EtatMenuInfoVitLvvDispo: type=tLOG, init-value=CONST_tLOG_0:0
    SR_EtatMenuInfoVitRvvDispo
      data EtatMenuInfoVitRvvDispo: type=tLOG, init-value=CONST_tLOG_0:0
    SR_EtatMenuInfoXVVDispo
      data EtatMenuInfoXVVDispo: type=tLOG, init-value=CONST_tLOG_0:0
    SR_EtatMenuINV_ADSD
      data EtatMenuINV_ADSD: type=tLOG, init-value=CONST_tLOG_0:0
    SR_EtatMenuLangueVehicule
      data EtatMenuLangueVehicule: type=tBYTE, init-value=CONST_tBYTE_0:0
    SR_EtatMenuMotoVolAr
      data EtatMenuMotoVolAr: type=tLOG, init-value=CONST_tLOG_0:0
    SR_EtatMenuPresenceARC
      data EtatMenuPresenceARC: type=tLOG, init-value=CONST_tLOG_0:0
    SR_EtatMenuPRV_MODE
      data EtatMenuPRV_MODE: type=tBYTE, init-value=CONST_tBYTE_0:0
    SR_EtatMenuReserveZEV
      data EtatMenuReserveZEV: type=tLOG, init-value=CONST_tLOG_0:0
    SR_EtatMenuRTAB_EnergyRec
      data EtatMenuRTAB_EnergyRec: type=tBYTE, init-value=CONST_tBYTE_0b01:0b01
    SR_EtatMenuRTAB_RechargeHDeb
      data EtatMenuRTAB_RechargeHDeb: type=tWORD, init-value=CONST_tWORD_0:0
    SR_EtatMenuRTAB_TypeRec
      data EtatMenuRTAB_TypeRec: type=tLOG, init-value=CONST_tLOG_0:0
    SR_EtatMenuSelecArriere
      data EtatMenuSelecArriere: type=tLOG, init-value=CONST_tLOG_0:0
    SR_EtatMenuSelecCabine
      data EtatMenuSelecCabine: type=tLOG, init-value=CONST_tLOG_0:0
    SR_EtatMenuSelecOuvPlip
      data EtatMenuSelecOuvPlip: type=tLOG, init-value=CONST_tLOG_0:0
    SR_EtatMenuSelReserveZEV
      data EtatMenuSelReserveZEV: type=tLOG, init-value=CONST_tLOG_0:0
    SR_EtatMenuSonPoly
      data EtatMenuSonPoly: type=tBILOG, init-value=CONST_tBILOG_0:0
    SR_EtatMenuStatusAAS
      data EtatMenuStatusAAS: type=tLOG, init-value=CONST_tLOG_0:0
    SR_EtatMenuStatusSAM
      data EtatMenuStatusSAM: type=tLOG, init-value=CONST_tLOG_0:0
    SR_EtatMenuTCFG
      data EtatMenuTCFG: type=tBYTE, init-value=CONST_tBYTE_0:0
    SR_EtatMenuUniteConso
      data EtatMenuUniteConso: type=tLOG, init-value=CONST_tLOG_0:0
    SR_EtatMenuUniteDistance
      data EtatMenuUniteDistance: type=tLOG, init-value=CONST_tLOG_0:0
    SR_EtatMenuUniteTemperature
      data EtatMenuUniteTemperature: type=tLOG, init-value=CONST_tLOG_0:0
    SR_EtatMenuUniteVolume
      data EtatMenuUniteVolume: type=tLOG, init-value=CONST_tLOG_0:0
    SR_EtatMenuVitesse1XVV
      data EtatMenuVitesse1XVV: type=tBYTE, init-value=CONST_tBYTE_0:0
    SR_EtatMenuVitesse2XVV
      data EtatMenuVitesse2XVV: type=tBYTE, init-value=CONST_tBYTE_0:0
    SR_EtatMenuVitesse3XVV
      data EtatMenuVitesse3XVV: type=tBYTE, init-value=CONST_tBYTE_0:0
    SR_EtatMenuVitesse4XVV
      data EtatMenuVitesse4XVV: type=tBYTE, init-value=CONST_tBYTE_0:0
    SR_EtatMenuVitesse5XVV
      data EtatMenuVitesse5XVV: type=tBYTE, init-value=CONST_tBYTE_0:0
    SR_EtatMenuVitLvv1
      data EtatMenuVitLvv1: type=tBYTE, init-value=CONST_tBYTE_0xFF:255
    SR_EtatMenuVitLvv2
      data EtatMenuVitLvv2: type=tBYTE, init-value=CONST_tBYTE_0xFF:255
    SR_EtatMenuVitLvv3
      data EtatMenuVitLvv3: type=tBYTE, init-value=CONST_tBYTE_0xFF:255
    SR_EtatMenuVitLvv4
      data EtatMenuVitLvv4: type=tBYTE, init-value=CONST_tBYTE_0xFF:255
    SR_EtatMenuVitLvv5
      data EtatMenuVitLvv5: type=tBYTE, init-value=CONST_tBYTE_0xFF:255
    SR_EtatMenuVitLvv6
      data EtatMenuVitLvv6: type=tBYTE, init-value=CONST_tBYTE_0xFF:255
    SR_EtatMenuVitRvv1
      data EtatMenuVitRvv1: type=tBYTE, init-value=CONST_tBYTE_0xFF:255
    SR_EtatMenuVitRvv2
      data EtatMenuVitRvv2: type=tBYTE, init-value=CONST_tBYTE_0xFF:255
    SR_EtatMenuVitRvv3
      data EtatMenuVitRvv3: type=tBYTE, init-value=CONST_tBYTE_0xFF:255
    SR_EtatMenuVitRvv4
      data EtatMenuVitRvv4: type=tBYTE, init-value=CONST_tBYTE_0xFF:255
    SR_EtatMenuVitRvv5
      data EtatMenuVitRvv5: type=tBYTE, init-value=CONST_tBYTE_0xFF:255
    SR_EtatMenuVitRvv6
      data EtatMenuVitRvv6: type=tBYTE, init-value=CONST_tBYTE_0xFF:255
    SR_EtatMenuVTOR_IRV
      data EtatMenuVTOR_IRV: type=tLOG, init-value=CONST_tLOG_0:0
    SR_S360_Envoi
      data S360_Envoi: type=tBILOG, init-value=CONST_tBILOG_0:0
    SR_S360_OCTET_1
      data S360_OCTET_1: type=tBYTE, init-value=CONST_tBYTE_0:0
    SR_S360_OCTET_2
      data S360_OCTET_2: type=tBYTE, init-value=CONST_tBYTE_0:0
    SR_S360_OCTET_3
      data S360_OCTET_3: type=tBYTE, init-value=CONST_tBYTE_0:0
    SR_S360_OCTET_4
      data S360_OCTET_4: type=tBYTE, init-value=CONST_tBYTE_0:0
    SR_S360_OCTET_5
      data S360_OCTET_5: type=tBYTE, init-value=CONST_tBYTE_0:0
    SR_S360_OCTET_6
      data S360_OCTET_6: type=tBYTE, init-value=CONST_tBYTE_0:0
    SR_S360_OCTET_7
      data S360_OCTET_7: type=tBYTE, init-value=CONST_tBYTE_0:0
    SR_S360_OCTET_8
      data S360_OCTET_8: type=tBYTE, init-value=CONST_tBYTE_0:0
    SR_S3A0_Recu
      data S3A0_Recu: type=tBILOG, init-value=CONST_tBILOG_0:0
    SR_SEC_AccueilDeMenuPerso
      data SEC_AccueilDeMenuPerso: type=tLOG, init-value=CONST_tLOG_0:0
    SR_SEC_ActButee1XVV
      data SEC_ActButee1XVV: type=tLOG, init-value=CONST_tLOG_0:0
    SR_SEC_ActButee2XVV
      data SEC_ActButee2XVV: type=tLOG, init-value=CONST_tLOG_0:0
    SR_SEC_ActButee3XVV
      data SEC_ActButee3XVV: type=tLOG, init-value=CONST_tLOG_0:0
    SR_SEC_ActButee4XVV
      data SEC_ActButee4XVV: type=tLOG, init-value=CONST_tLOG_0:0
    SR_SEC_ActButee5XVV
      data SEC_ActButee5XVV: type=tLOG, init-value=CONST_tLOG_0:0
    SR_SEC_ActButeeGenXVV
      data SEC_ActButeeGenXVV: type=tLOG, init-value=CONST_tLOG_0:0
    SR_SEC_ActivationARCDeMenuPerso
      data SEC_ActivationARCDeMenuPerso: type=tLOG, init-value=CONST_tLOG_1:1
    SR_SEC_BAAActivationDeMenuPerso
      data SEC_BAAActivationDeMenuPerso: type=tLOG, init-value=CONST_tLOG_0:0
    SR_SEC_BAAAutolockingDeMenuPerso
      data SEC_BAAAutolockingDeMenuPerso: type=tLOG, init-value=CONST_tLOG_0:0
    SR_SEC_CLIM_PrecASAPDeMenuPerso
      data SEC_CLIM_PrecASAPDeMenuPerso: type=tLOG, init-value=CONST_tLOG_0:0
    SR_SEC_CLIM_PrecH1DeMenuPerso
      data SEC_CLIM_PrecH1DeMenuPerso: type=tWORD, init-value=CONST_tWORD_0:0
    SR_SEC_CLIM_PrecH2DeMenuPerso
      data SEC_CLIM_PrecH2DeMenuPerso: type=tWORD, init-value=CONST_tWORD_0:0
    SR_SEC_CLIM_PrecH3DeMenuPerso
      data SEC_CLIM_PrecH3DeMenuPerso: type=tWORD, init-value=CONST_tWORD_0:0
    SR_SEC_CLIM_PrecH4DeMenuPerso
      data SEC_CLIM_PrecH4DeMenuPerso: type=tWORD, init-value=CONST_tWORD_0:0
    SR_SEC_CLIM_PrecOn1DeMenuPerso
      data SEC_CLIM_PrecOn1DeMenuPerso: type=tLOG, init-value=CONST_tLOG_0:0
    SR_SEC_CLIM_PrecOn2DeMenuPerso
      data SEC_CLIM_PrecOn2DeMenuPerso: type=tLOG, init-value=CONST_tLOG_0:0
    SR_SEC_CLIM_PrecOn3DeMenuPerso
      data SEC_CLIM_PrecOn3DeMenuPerso: type=tLOG, init-value=CONST_tLOG_0:0
    SR_SEC_CLIM_PrecOn4DeMenuPerso
      data SEC_CLIM_PrecOn4DeMenuPerso: type=tLOG, init-value=CONST_tLOG_0:0
    SR_SEC_CLIMPrecPrg1DeMenuPerso
      data SEC_CLIMPrecPrg1DeMenuPerso: type=tWORD, init-value=CONST_tWORD_0:0
    SR_SEC_CLIMPrecPrg2DeMenuPerso
      data SEC_CLIMPrecPrg2DeMenuPerso: type=tWORD, init-value=CONST_tWORD_0:0
    SR_SEC_CLIMPrecPrg3DeMenuPerso
      data SEC_CLIMPrecPrg3DeMenuPerso: type=tWORD, init-value=CONST_tWORD_0:0
    SR_SEC_CLIMPrecPrg4DeMenuPerso
      data SEC_CLIMPrecPrg4DeMenuPerso: type=tWORD, init-value=CONST_tWORD_0:0
    SR_SEC_CLIMPrecSem1DeMenuPerso
      data SEC_CLIMPrecSem1DeMenuPerso: type=tBYTE, init-value=CONST_tBYTE_0:0
    SR_SEC_CLIMPrecSem2DeMenuPerso
      data SEC_CLIMPrecSem2DeMenuPerso: type=tBYTE, init-value=CONST_tBYTE_0:0
    SR_SEC_CLIMPrecSem3DeMenuPerso
      data SEC_CLIMPrecSem3DeMenuPerso: type=tBYTE, init-value=CONST_tBYTE_0:0
    SR_SEC_CLIMPrecSem4DeMenuPerso
      data SEC_CLIMPrecSem4DeMenuPerso: type=tBYTE, init-value=CONST_tBYTE_0:0
    SR_SEC_CMDM_DAE_4WDDeMenuPerso
      data SEC_CMDM_DAE_4WDDeMenuPerso: type=t_cDAE, init-value=CONST_t_cDAE_0:0
    SR_SEC_CMDM_DAEDeMenuPerso
      data SEC_CMDM_DAEDeMenuPerso: type=t_cDAE, init-value=CONST_t_cDAE_0:0
    SR_SEC_DAAActivationDeMenuPerso
      data SEC_DAAActivationDeMenuPerso: type=tLOG, init-value=CONST_tLOG_0:0
    SR_SEC_DecondaSelectDeMenuPerso
      data SEC_DecondaSelectDeMenuPerso: type=tLOG, init-value=CONST_tLOG_0:0
    SR_SEC_DSGDeMenuPerso
      data SEC_DSGDeMenuPerso: type=tLOG, init-value=CONST_tLOG_0:0
    SR_SEC_EclAccomp
      data SEC_EclAccomp: type=tLOG, init-value=CONST_tLOG_0:0
    SR_SEC_EclAccompTempo
      data SEC_EclAccompTempo: type=tBYTE, init-value=CONST_tBYTE_0:0
    SR_SEC_EclAdaptDeMenuPerso
      data SEC_EclAdaptDeMenuPerso: type=tLOG, init-value=CONST_tLOG_0:0
    SR_SEC_EclAFSDeMenuPerso
      data SEC_EclAFSDeMenuPerso: type=tLOG, init-value=CONST_tLOG_0:0
    SR_SEC_EclAmbiDeMenuPerso
      data SEC_EclAmbiDeMenuPerso: type=tLOG, init-value=CONST_tLOG_0:0
    SR_SEC_EclAmbiNivDeMenuPerso
      data SEC_EclAmbiNivDeMenuPerso: type=tBYTE, init-value=CONST_tBYTE_3:3
    SR_SEC_EclARSDeMenuPerso
      data SEC_EclARSDeMenuPerso: type=tLOG, init-value=CONST_tLOG_0:0
    SR_SEC_EclAutoDeMenuPerso
      data SEC_EclAutoDeMenuPerso: type=tLOG, init-value=CONST_tLOG_0:0
    SR_SEC_EclAutorouteDeMenuPerso
      data SEC_EclAutorouteDeMenuPerso: type=tLOG, init-value=CONST_tLOG_0:0
    SR_SEC_EclCalandDeMenuPerso
      data SEC_EclCalandDeMenuPerso: type=tBILOG, init-value=CONST_tBILOG_0:0
    SR_SEC_EclDeconda
      data SEC_EclDeconda: type=tLOG, init-value=CONST_tLOG_0:0
    SR_SEC_EclDecondaTempo
      data SEC_EclDecondaTempo: type=tBYTE, init-value=CONST_tBYTE_0:0
    SR_SEC_ECLI_PPC_ANIMDeMenuPerso
      data SEC_ECLI_PPC_ANIMDeMenuPerso: type=tBYTE, init-value=CONST_tBYTE_0:0
    SR_SEC_ECLI_PPC_BLOC1DeMenuPerso
      data SEC_ECLI_PPC_BLOC1DeMenuPerso: type=tLOG, init-value=CONST_tLOG_0:0
    SR_SEC_ECLI_PPC_COL1DeMenuPerso
      data SEC_ECLI_PPC_COL1DeMenuPerso: type=tBYTE, init-value=CONST_tBYTE_1:1
    SR_SEC_ECLX_ECL_CAFRDeMenuPerso
      data SEC_ECLX_ECL_CAFRDeMenuPerso: type=tLOG, init-value=CONST_tLOG_0:0
    SR_SEC_EssuiVitMarDeMenuPerso
      data SEC_EssuiVitMarDeMenuPerso: type=tLOG, init-value=CONST_tLOG_0:0
    SR_SEC_FARCDeMenuPerso
      data SEC_FARCDeMenuPerso: type=tLOG, init-value=CONST_tLOG_0:0
    SR_SEC_FctToucheCfgDeMenuPerso
      data SEC_FctToucheCfgDeMenuPerso: type=t_cFTCG, init-value=CONST_t_cFTCG_0:0
    SR_SEC_FeuxDiurneDeMenuPerso
      data SEC_FeuxDiurneDeMenuPerso: type=tLOG, init-value=CONST_tLOG_0:0
    SR_SEC_FSEAutoDeMenuPerso
      data SEC_FSEAutoDeMenuPerso: type=tLOG, init-value=CONST_tLOG_0:0
    SR_SEC_GAV_AMLADeMenuPerso
      data SEC_GAV_AMLADeMenuPerso: type=tLOG, init-value=CONST_tLOG_0:0
    SR_SEC_ILVDeMenuPerso
      data SEC_ILVDeMenuPerso: type=tLOG, init-value=CONST_tLOG_0:0
    SR_SEC_ILV_ETSRDeMenuPerso
      data SEC_ILV_ETSRDeMenuPerso: type=tLOG, init-value=CONST_tLOG_0:0
    SR_SEC_IMADeMenuPerso
      data SEC_IMADeMenuPerso: type=tLOG, init-value=CONST_tLOG_0:0
    SR_SEC_InhibitionAASDeMenuPerso
      data SEC_InhibitionAASDeMenuPerso: type=tLOG, init-value=CONST_tLOG_0:0
    SR_SEC_InhibitionSAMDeMenuPerso
      data SEC_InhibitionSAMDeMenuPerso: type=tLOG, init-value=CONST_tLOG_0:0
    SR_SEC_INV_ADSDDeMenuPerso
      data SEC_INV_ADSDDeMenuPerso: type=tLOG, init-value=CONST_tLOG_0:0
    SR_SEC_LangueVehicule
      data SEC_LangueVehicule: type=tBYTE, init-value=CONST_tBYTE_0:0
    SR_SEC_MotoVolArDeMenuPerso
      data SEC_MotoVolArDeMenuPerso: type=tLOG, init-value=CONST_tLOG_0:0
    SR_SEC_PrgPemDiDeMenuPerso
      data SEC_PrgPemDiDeMenuPerso: type=tDWORD, init-value=CONST_tDWORD_0:0
    SR_SEC_PrgPemJeDeMenuPerso
      data SEC_PrgPemJeDeMenuPerso: type=tDWORD, init-value=CONST_tDWORD_0:0
    SR_SEC_PrgPemLuDeMenuPerso
      data SEC_PrgPemLuDeMenuPerso: type=tDWORD, init-value=CONST_tDWORD_0:0
    SR_SEC_PrgPemMaDeMenuPerso
      data SEC_PrgPemMaDeMenuPerso: type=tDWORD, init-value=CONST_tDWORD_0:0
    SR_SEC_PrgPemMeDeMenuPerso
      data SEC_PrgPemMeDeMenuPerso: type=tDWORD, init-value=CONST_tDWORD_0:0
    SR_SEC_PrgPemSaDeMenuPerso
      data SEC_PrgPemSaDeMenuPerso: type=tDWORD, init-value=CONST_tDWORD_0:0
    SR_SEC_PrgPemVeDeMenuPerso
      data SEC_PrgPemVeDeMenuPerso: type=tDWORD, init-value=CONST_tDWORD_0:0
    SR_SEC_PRV_MODEDeMenuPerso
      data SEC_PRV_MODEDeMenuPerso: type=tBYTE, init-value=CONST_tBYTE_0:0
    SR_SEC_ReserveZEVDeMenuPerso
      data SEC_ReserveZEVDeMenuPerso: type=tBYTE, init-value=CONST_tBYTE_0:0
    SR_SEC_RTABDeMenuPerso
      data SEC_RTABDeMenuPerso: type=tLOG, init-value=CONST_tLOG_0:0
    SR_SEC_RTAB_EnergyRecDeMenuPerso
      data SEC_RTAB_EnergyRecDeMenuPerso: type=tBYTE, init-value=CONST_tBYTE_0b01:0b01
    SR_SEC_RTAB_RecHDebDeMenuPerso
      data SEC_RTAB_RecHDebDeMenuPerso: type=tWORD, init-value=CONST_tWORD_0:0
    SR_SEC_RTAB_TypeRecDeMenuPerso
      data SEC_RTAB_TypeRecDeMenuPerso: type=tLOG, init-value=CONST_tLOG_0:0
    SR_SEC_SelectOuvARDeMenuPerso
      data SEC_SelectOuvARDeMenuPerso: type=tLOG, init-value=CONST_tLOG_0:0
    SR_SEC_SelReserveZEVDeMenuPerso
      data SEC_SelReserveZEVDeMenuPerso: type=tLOG, init-value=CONST_tLOG_0:0
    SR_SEC_SensibiliteARCDeMenuPerso
      data SEC_SensibiliteARCDeMenuPerso: type=tQUARTET, init-value=CONST_tQUARTET_3:3
    SR_SEC_SonPolyphDeMenuPerso
      data SEC_SonPolyphDeMenuPerso: type=tBILOG, init-value=CONST_tBILOG_0:0
    SR_SEC_UniteConso
      data SEC_UniteConso: type=tLOG, init-value=CONST_tLOG_0:0
    SR_SEC_UniteDistance
      data SEC_UniteDistance: type=tLOG, init-value=CONST_tLOG_0:0
    SR_SEC_UniteTemperature
      data SEC_UniteTemperature: type=tLOG, init-value=CONST_tLOG_0:0
    SR_SEC_UniteVolume
      data SEC_UniteVolume: type=tLOG, init-value=CONST_tLOG_0:0
    SR_SEC_VAM_ECS_MODEDeMenuPerso
      data SEC_VAM_ECS_MODEDeMenuPerso: type=tLOG, init-value=CONST_tLOG_0:0
    SR_SEC_Vitesse1XVV
      data SEC_Vitesse1XVV: type=tBYTE, init-value=CONST_tBYTE_0:0
    SR_SEC_Vitesse2XVV
      data SEC_Vitesse2XVV: type=tBYTE, init-value=CONST_tBYTE_0:0
    SR_SEC_Vitesse3XVV
      data SEC_Vitesse3XVV: type=tBYTE, init-value=CONST_tBYTE_0:0
    SR_SEC_Vitesse4XVV
      data SEC_Vitesse4XVV: type=tBYTE, init-value=CONST_tBYTE_0:0
    SR_SEC_Vitesse5XVV
      data SEC_Vitesse5XVV: type=tBYTE, init-value=CONST_tBYTE_0:0
    SR_SEC_VitLvv1DeMenuPerso
      data SEC_VitLvv1DeMenuPerso: type=tBYTE, init-value=CONST_tBYTE_0:0
    SR_SEC_VitLvv1MilesDeMenuPerso
      data SEC_VitLvv1MilesDeMenuPerso: type=tBYTE, init-value=CONST_tBYTE_0:0
    SR_SEC_VitLvv2DeMenuPerso
      data SEC_VitLvv2DeMenuPerso: type=tBYTE, init-value=CONST_tBYTE_0:0
    SR_SEC_VitLvv2MilesDeMenuPerso
      data SEC_VitLvv2MilesDeMenuPerso: type=tBYTE, init-value=CONST_tBYTE_0:0
    SR_SEC_VitLvv3DeMenuPerso
      data SEC_VitLvv3DeMenuPerso: type=tBYTE, init-value=CONST_tBYTE_0:0
    SR_SEC_VitLvv3MilesDeMenuPerso
      data SEC_VitLvv3MilesDeMenuPerso: type=tBYTE, init-value=CONST_tBYTE_0:0
    SR_SEC_VitLvv4DeMenuPerso
      data SEC_VitLvv4DeMenuPerso: type=tBYTE, init-value=CONST_tBYTE_0:0
    SR_SEC_VitLvv4MilesDeMenuPerso
      data SEC_VitLvv4MilesDeMenuPerso: type=tBYTE, init-value=CONST_tBYTE_0:0
    SR_SEC_VitLvv5DeMenuPerso
      data SEC_VitLvv5DeMenuPerso: type=tBYTE, init-value=CONST_tBYTE_0:0
    SR_SEC_VitLvv5MilesDeMenuPerso
      data SEC_VitLvv5MilesDeMenuPerso: type=tBYTE, init-value=CONST_tBYTE_0:0
    SR_SEC_VitLvv6DeMenuPerso
      data SEC_VitLvv6DeMenuPerso: type=tBYTE, init-value=CONST_tBYTE_0:0
    SR_SEC_VitLvv6MilesDeMenuPerso
      data SEC_VitLvv6MilesDeMenuPerso: type=tBYTE, init-value=CONST_tBYTE_0:0
    SR_SEC_VitRvv1DeMenuPerso
      data SEC_VitRvv1DeMenuPerso: type=tBYTE, init-value=CONST_tBYTE_0:0
    SR_SEC_VitRvv1MilesDeMenuPerso
      data SEC_VitRvv1MilesDeMenuPerso: type=tBYTE, init-value=CONST_tBYTE_0:0
    SR_SEC_VitRvv2DeMenuPerso
      data SEC_VitRvv2DeMenuPerso: type=tBYTE, init-value=CONST_tBYTE_0:0
    SR_SEC_VitRvv2MilesDeMenuPerso
      data SEC_VitRvv2MilesDeMenuPerso: type=tBYTE, init-value=CONST_tBYTE_0:0
    SR_SEC_VitRvv3DeMenuPerso
      data SEC_VitRvv3DeMenuPerso: type=tBYTE, init-value=CONST_tBYTE_0:0
    SR_SEC_VitRvv3MilesDeMenuPerso
      data SEC_VitRvv3MilesDeMenuPerso: type=tBYTE, init-value=CONST_tBYTE_0:0
    SR_SEC_VitRvv4DeMenuPerso
      data SEC_VitRvv4DeMenuPerso: type=tBYTE, init-value=CONST_tBYTE_0:0
    SR_SEC_VitRvv4MilesDeMenuPerso
      data SEC_VitRvv4MilesDeMenuPerso: type=tBYTE, init-value=CONST_tBYTE_0:0
    SR_SEC_VitRvv5DeMenuPerso
      data SEC_VitRvv5DeMenuPerso: type=tBYTE, init-value=CONST_tBYTE_0:0
    SR_SEC_VitRvv5MilesDeMenuPerso
      data SEC_VitRvv5MilesDeMenuPerso: type=tBYTE, init-value=CONST_tBYTE_0:0
    SR_SEC_VitRvv6DeMenuPerso
      data SEC_VitRvv6DeMenuPerso: type=tBYTE, init-value=CONST_tBYTE_0:0
    SR_SEC_VitRvv6MilesDeMenuPerso
      data SEC_VitRvv6MilesDeMenuPerso: type=tBYTE, init-value=CONST_tBYTE_0:0
    SR_SEC_VTOR_IRVDeMenuPerso
      data SEC_VTOR_IRVDeMenuPerso: type=tLOG, init-value=CONST_tLOG_0:0
    SR_SEC_ZCSelectDeMenuPerso
      data SEC_ZCSelectDeMenuPerso: type=tLOG, init-value=CONST_tLOG_0:0
    SR_ContactFreinHS
      data ContactFreinHS: type=tLOG, init-value=CONST_tLOG_0:0
    SR_ContactFreinHSCorrompue
      data ContactFreinHSCorrompue: type=tLOG, init-value=CONST_tLOG_0:0
    SR_ContactFreinSecondaire
      data ContactFreinSecondaire: type=t_cContactFrein, init-value=CONST_t_cContactFrein_0:0
    SR_DoorOpeningStateSwitch
      data DoorOpeningState: type=tOpeningPosition, init-value=CONST_DoorOpeningState_tOpeningPosition_eMVA_None:0  # Represent the door opening state side by side.
    SR_DriverDoorFolds
      data DriverOpeningStateFolds: type=tLOG, init-value=CONST_tLOG_0:0  # Represent the opening state of the driver doors depends on the "folds" strategy (driver door have been not open at all but the vehicle was starting).
      data DriverOpeningStateFoldsStatus: type=t_DriverOpeningStateFoldsStatus, init-value=CONST_DriverOpeningStateFoldsStatus_t_DriverOpeningStateFoldsStatus_eMVA_NoDefect:0  # Represent the opening state of the driver doors depends on the "folds" strategy (driver door have been not open at all but the vehicle was starting).
    SR_DysfVitesseVehicule
      data DysfVitesseVehicule: type=t_cVitv, init-value=CONST_t_cVitv_0:0  # Vitesse utilisée pour décrire l'état de la vitesse vehicule
    SR_ED_ContactFrein
      data ED_ContactFrein: type=tLOG, init-value=CONST_tLOG_0:0
    SR_EtatCeintureCond
      data EtatCeintureCond: type=t_cTNB, init-value=CONST_EtatCeintureCond_t_cTNB_cTNB_Invalide:3
    SR_EtatCeinturePar2c
      data EtatCeinturePar2c: type=t_cTNB, init-value=CONST_EtatCeinturePar2c_t_cTNB_cTNB_Invalide:3
    SR_EtatCeinturePar2d
      data EtatCeinturePar2d: type=t_cTNB, init-value=CONST_EtatCeinturePar2d_t_cTNB_cTNB_Invalide:3
    SR_EtatCeinturePar2g
      data EtatCeinturePar2g: type=t_cTNB, init-value=CONST_EtatCeinturePar2g_t_cTNB_cTNB_Invalide:3
    SR_EtatCeinturePar3d
      data EtatCeinturePar3d: type=t_cTNB, init-value=CONST_EtatCeinturePar3d_t_cTNB_cTNB_Invalide:3
    SR_EtatCeinturePar3g
      data EtatCeinturePar3g: type=t_cTNB, init-value=CONST_EtatCeinturePar3g_t_cTNB_cTNB_Invalide:3
    SR_EtatCeinturePav
      data EtatCeinturePav: type=t_cTNB, init-value=CONST_EtatCeinturePav_t_cTNB_cTNB_Invalide:3
    SR_EtatCeinturePavC
      data EtatCeinturePavC: type=t_cTNB, init-value=CONST_EtatCeinturePavC_t_cTNB_cTNB_Invalide:3
    SR_EtatClefInhibRBAGPassager
      data EtatClefInhibRBAGPassager: type=t_cInhibRBGPass, init-value=CONST_t_cInhibRBGPass_0:0
    SR_EtatGMP
      data EtatGMP: type=t_GM_GMP, init-value=CONST_EtatGMP_t_GM_GMP_GM_GMPCoupe:1
    SR_InfoCpoCondRepli
      data InfoCpoCondRepli: type=tLOG, init-value=CONST_tLOG_0:0
    SR_InterMemoDefauts
      data InterMemoDefauts: type=tLOG, init-value=CONST_tLOG_0:0
    SR_MarcheArriere
      data MarcheArriere: type=tLOG, init-value=CONST_tLOG_0:0
    SR_PresencePassagerAvant
      data PresencePassagerAvant: type=tLOG, init-value=CONST_tLOG_0:0
    SR_SAV_CondaRealisee
      data SAV_CondaRealisee: type=t_cCR, init-value=CONST_t_cCR_1:1
    SR_SAV_EtatOuvrants
      data SAV_EtatOuvrants: type=t_cmEO, init-value=CONST_t_cmEO_0:0
    SR_SEC_ConfigSEV
      data SEC_ConfigSEV: type=t_cCSEV, init-value=CONST_t_cCSEV_4:4
    SR_VehicleLockingState
      6 x data:
        LogicalVehicleLockingState: type=tLOG, init-value=CONST_tLOG_0:0
        TrunkLockingState: type=tLOG, init-value=CONST_tLOG_0:0
        TrunkUlockingState: type=tLOG, init-value=CONST_tLOG_0:0
        VehicleLockingState: type=tVehicleLockingState, init-value=CONST_VehicleLockingState_tVehicleLockingState_eMVA_Unlocked:1
        VehicleLockingStateExtSbs: type=tOpeningPosition, init-value=CONST_VehicleLockingStateExtSbs_tOpeningPosition_eMVA_None:0
        VehicleLockingStateIntSbs: type=tOpeningPosition, init-value=CONST_VehicleLockingStateIntSbs_tOpeningPosition_eMVA_None:0
    SR_VitesseVehicule
      data VitesseVehicule: type=tWORD, init-value=CONST_tWORD_0:0
    SR_BMFPresente
      data BMFPresente: type=tLOG, init-value=CONST_tLOG_0:0
    SR_DdeClignoTemCeintAR2D
      data DdeClignoTemCeintAR2D: type=tLOG, init-value=CONST_tLOG_0:0
    SR_DdeClignoTemCeintAR2G
      data DdeClignoTemCeintAR2G: type=tLOG, init-value=CONST_tLOG_0:0
    SR_DdeClignoTemCeintAR2M
      data DdeClignoTemCeintAR2M: type=tLOG, init-value=CONST_tLOG_0:0
    SR_DdeClignoTemCeintAR3D
      data DdeClignoTemCeintAR3D: type=tLOG, init-value=CONST_tLOG_0:0
    SR_DdeClignoTemCeintAR3G
      data DdeClignoTemCeintAR3G: type=tLOG, init-value=CONST_tLOG_0:0
    SR_DdeClignoTemCeintCond
      data DdeClignoTemCeintCond: type=tLOG, init-value=CONST_tLOG_0:0
    SR_DdeClignoTemCeintPav
      data DdeClignoTemCeintPav: type=tLOG, init-value=CONST_tLOG_0:0
    SR_DdeClignoTemCeintPavC
      data DdeClignoTemCeintPavC: type=tLOG, init-value=CONST_tLOG_0:0
    SR_DdeTemoinCeintureAR2D
      data DdeTemoinCeintureAR2D: type=tLOG, init-value=CONST_tLOG_0:0
    SR_DdeTemoinCeintureAR2G
      data DdeTemoinCeintureAR2G: type=tLOG, init-value=CONST_tLOG_0:0
    SR_DdeTemoinCeintureAR2M
      data DdeTemoinCeintureAR2M: type=tLOG, init-value=CONST_tLOG_0:0
    SR_DdeTemoinCeintureAR3D
      data DdeTemoinCeintureAR3D: type=tLOG, init-value=CONST_tLOG_0:0
    SR_DdeTemoinCeintureAR3G
      data DdeTemoinCeintureAR3G: type=tLOG, init-value=CONST_tLOG_0:0
    SR_DdeTemoinCeintureCond
      data DdeTemoinCeintureCond: type=tLOG, init-value=CONST_tLOG_0:0
    SR_DdeTemoinCeinturePav
      data DdeTemoinCeinturePav: type=tLOG, init-value=CONST_tLOG_0:0
    SR_DdeTemoinCeinturePavC
      data DdeTemoinCeinturePavC: type=tLOG, init-value=CONST_tLOG_0:0
    SR_DiagDefautPresenceConducteur
      data DiagDefautPresenceConducteur: type=t_cDefautPresConducteur, init-value=CONST_DiagDefautPresenceConducteur_t_cDefautPresConducteur_cDefautPresConducteur_Ok:0
    SR_EtatBouclageDiff
      data EtatBouclageDiff: type=t_cBouclage, init-value=CONST_t_cBouclage_0:0
    SR_PresenceConducteurDiag
      data PresenceConducteurDiag: type=tLOG, init-value=CONST_tLOG_0:0
    SR_PresenceConducteurMux
      data PresenceConducteurMux: type=t_cPresenceConducteur, init-value=CONST_PresenceConducteurMux_t_cPresenceConducteur_cPresenceConducteur_Absent:1
    SR_PresenceSimpleConducteur
      data PresenceSimpleConducteur: type=t_cPresenceSimpleConducteur, init-value=CONST_PresenceSimpleConducteur_t_cPresenceSimpleConducteur_cPresenceSimpleConducteur_Absent:0
    SR_SAV_EtatCNBMemorisePar2c
      data SAV_EtatCNBMemorisePar2c: type=tLOG, init-value=CONST_tLOG_0:0
    SR_SAV_EtatCNBMemorisePar2d
      data SAV_EtatCNBMemorisePar2d: type=tLOG, init-value=CONST_tLOG_0:0
    SR_SAV_EtatCNBMemorisePar2g
      data SAV_EtatCNBMemorisePar2g: type=tLOG, init-value=CONST_tLOG_0:0
    SR_SAV_EtatCNBMemorisePar3d
      data SAV_EtatCNBMemorisePar3d: type=tLOG, init-value=CONST_tLOG_0:0
    SR_SAV_EtatCNBMemorisePar3g
      data SAV_EtatCNBMemorisePar3g: type=tLOG, init-value=CONST_tLOG_0:0
    SR_SAV_EtatCNBMemorisePavC
      data SAV_EtatCNBMemorisePavC: type=tLOG, init-value=CONST_tLOG_0:0
    SR_SAV_EtatCNBMemorisePavd
      data SAV_EtatCNBMemorisePavd: type=tLOG, init-value=CONST_tLOG_0:0
    SR_SAV_EtatCNBMemorisePavg
      data SAV_EtatCNBMemorisePavg: type=tLOG, init-value=CONST_tLOG_0:0
    SR_SAV_EtatPresenceMemorisePav
      data SAV_EtatPresenceMemorisePav: type=tLOG, init-value=CONST_tLOG_0:0
    SR_TypeSonANBC
      data TypeSonANBC: type=t_cTypeSonANBC, init-value=CONST_t_cTypeSonANBC_0:0
    SR_ApportCarbDetecte
      data ApportCarbDetecte: type=tLOG, init-value=CONST_tLOG_0:0
    SR_DefautBouchonCarbConfirme
      data DefautBouchonCarbConfirme: type=tLOG, init-value=CONST_tLOG_0:0
    SR_DefautJaugeCarbConfirme
      data DefautJaugeCarbConfirme: type=t_cSDF_Defaut, init-value=CONST_DefautJaugeCarbConfirme_t_cSDF_Defaut_cSDF_DefautAbsent:105
    SR_DefautMvmtVhl
      data DefautMvmtVhl: type=tLOG, init-value=CONST_tLOG_0:0
    SR_DeltaCarb
      data DeltaCarb: type=tWORD, init-value=CONST_tWORD_0:0
    SR_ImpedanceJaugeCarb
      data ImpedanceJaugeCarb: type=tWORD, init-value=CONST_tWORD_0:0
    SR_ModeDegrDefVitesse
      data ModeDegrDefVitesse: type=tLOG, init-value=CONST_tLOG_0:0
    SR_NivCarbBrutReference
      data NivCarbBrutReference: type=tWORD, init-value=CONST_tWORD_0:0
    SR_PbDetectionApport
      data PbDetectionApport: type=tLOG, init-value=CONST_tLOG_0:0
    SR_PremiereMesureJC_OK
      data PremiereMesureJC_OK: type=t_cSDF_Mesure, init-value=CONST_PremiereMesureJC_OK_t_cSDF_Mesure_cSDF_MesureNonRealisee:105
    SR_SAV_DiagJaugeCarbu
      data SAV_DiagJaugeCarbu: type=t_Def_0, init-value=CONST_SAV_DiagJaugeCarbu_t_Def_0_cAttenteDefJC:0
    SR_SAV_EtatBouchonCarb
      data SAV_EtatBouchonCarb: type=tLOG, init-value=CONST_tLOG_0:0
    SR_SAV_NivCarbMesure
      data SAV_NivCarbMesure: type=tWORD, init-value=CONST_tWORD_0:0
    SR_ToggleAcqJaugeRealisee
      data ToggleAcqJaugeRealisee: type=tLOG, init-value=CONST_tLOG_0:0
    SR_ValiditeAbsenceBouchonCarb
      data ValiditeAbsenceBouchonCarb: type=tLOG, init-value=CONST_tLOG_0:0
    SR_ABSMuet_P7D
      data ABSMuet_P7D: type=tLOG, init-value=CONST_tLOG_0:0
    SR_DefautTopRoueARD
      data DefautTopRoueARD: type=tLOG, init-value=CONST_tLOG_0:0
    SR_DefautTopRoueARG
      data DefautTopRoueARG: type=tLOG, init-value=CONST_tLOG_0:0
    SR_DispoVitesseVehiculeBit
      data DispoVitesseVehiculeBit: type=tLOG, init-value=CONST_tLOG_0:0
    SR_EtatCmdPlusCAN
      data EtatCmdPlusCAN: type=t_cCMDPLUSCAN, init-value=CONST_EtatCmdPlusCAN_t_cCMDPLUSCAN_cCMDPLUSCAN_INDETERMINE:3
    SR_MvmtVhl
      data MvmtVhl: type=tLOG, init-value=CONST_tLOG_0:0
    SR_SAV_NivCarbAffiche
      data SAV_NivCarbAffiche: type=tWORD, init-value=CONST_tWORD_0xFFFF:65535
    SR_StatusCmdPlusCAN
      data StatusCmdPlusCAN: type=t_cCmdPlusCAN, init-value=CONST_StatusCmdPlusCAN_t_cCmdPlusCAN_PLUSCAN_UNDEFINED:3
    SR_VitesseVehiculeCorrompue
      data VitesseVehiculeCorrompue: type=tLOG, init-value=CONST_tLOG_0:0
    SR_ConsommationCarbReelle
      data ConsommationCarbReelle: type=tBYTE, init-value=CONST_tBYTE_0:0
    SR_ConsoReelleInvalide
      data ConsoReelleInvalide: type=tLOG, init-value=CONST_tLOG_0:0
    SR_ED_DdePushModeGPL
      data ED_DdePushModeGPL: type=tLOG, init-value=CONST_tLOG_0:0
    SR_EtatModeGaz
      data EtatModeGaz: type=tBYTE, init-value=CONST_t_7:7
    SR_GPLModeINFO
      data GPLModeINFO: type=t_e_0, init-value=CONST_t_e_0_0:0
    SR_GPLtankCapacity
      data GPLtankCapacity: type=tBYTE, init-value=CONST_tBYTE_0:0
    SR_ModeFonctMotGAZ
      data ModeFonctMotGAZ: type=t_cModeFonctMotGAZ, init-value=CONST_t_cModeFonctMotGAZ_0x07:7
    SR_NivGPLAffiche7D
      data NivGPLAffiche7D: type=tBYTE, init-value=CONST_tBYTE_0:0
    SR_CapaciteReservoirJCA
      data CapaciteReservoirJCA: type=tBYTE, init-value=CONST_tBYTE_0:0
    SR_DdeVoyMiniCarburant
      data DdeVoyMiniCarburant: type=tLOG, init-value=CONST_tLOG_0:0
    SR_DdeVoyMiniCarburantClig
      data DdeVoyMiniCarburantClig: type=t_cDemande, init-value=CONST_t_cDemande_0:0
    SR_MiniCarburant
      data MiniCarburant: type=tBYTE, init-value=CONST_tFLOAT_0:0
    SR_MiniGPL
      data MiniGPL: type=tLOG, init-value=CONST_tLOG_0:0
    SR_MiniGPLCritique
      data MiniGPLCritique: type=tLOG, init-value=CONST_tLOG_0:0
    SR_NivCarbAfficheVersCmb
      data NivCarbAfficheVersCmb: type=tBYTE, init-value=CONST_tBYTE_0:0
    SR_NivCarbMesureConverti
      data NivCarbMesureConverti: type=tBYTE, init-value=CONST_tBYTE_0:0
    SR_DefautPompeAdd
      data DefautPompeAdd: type=tLOG, init-value=CONST_tLOG_0:0
    SR_ForcageTemoinsEnCours
      data ForcageTemoinsEnCours: type=tLOG, init-value=CONST_tLOG_0:0
    SR_NivMinAdditifGazole
      data NivMinAdditifGazole: type=tLOG, init-value=CONST_tLOG_0:0
    SR_PompeAddMuette
      data PompeAddMuette: type=tLOG, init-value=CONST_tLOG_0:0
    SR_PresenceTemoinDefMot
      data PresenceTemoinDefMot: type=tLOG, init-value=CONST_tLOG_0:0
    SR_PresenceTemoinFAPColm
      data PresenceTemoinFAPColm: type=tLOG, init-value=CONST_tLOG_0:0
    SR_RisquesColmatageFAP
      data RisquesColmatageFAP: type=tLOG, init-value=CONST_tLOG_0:0
    SR_ContexteDefCalcAdditif
      data ContexteDefCalcAdditif: type=tLOG, init-value=CONST_tLOG_0:0
    SR_ContexteDefCapteurBouchon
      data ContexteDefCapteurBouchon: type=tLOG, init-value=CONST_tLOG_0:0
    SR_ContexteDefInjecteur
      data ContexteDefInjecteur: type=tLOG, init-value=CONST_tLOG_0:0
    SR_ContexteDefJaugeAdditif
      data ContexteDefJaugeAdditif: type=tLOG, init-value=CONST_tLOG_0:0
    SR_ContexteDefJaugeCarb
      data ContexteDefJaugeCarb: type=tLOG, init-value=CONST_tLOG_0:0
    SR_ContexteDefPompe
      data ContexteDefPompe: type=tLOG, init-value=CONST_tLOG_0:0
    SR_ContexteDefSondeTemp
      data ContexteDefSondeTemp: type=tLOG, init-value=CONST_tLOG_0:0
    SR_ContexteEtatAdditivation
      data ContexteEtatAdditivation: type=tLOG, init-value=CONST_tLOG_1:1
    SR_SAV_CompteurEnvoiDeltaCarb
      data SAV_CompteurEnvoiDeltaCarb: type=tBYTE, init-value=CONST_tBYTE_0:0
    SR_SAV_VolCarbAjoute
      data SAV_VolCarbAjoute: type=tBYTE, init-value=CONST_tBYTE_0xFE:254
    SR_VoyRisqueColmatageFAP
      data VoyRisqueColmatageFAP: type=tLOG, init-value=CONST_tLOG_0:0
    If_executerPas
      data Data_pas_domaine: type=tBYTE, init-value=CONST_tBYTE_0x00:0
      data Data_pas_pas: type=tBYTE, init-value=CONST_tBYTE_0x00:0
      data Data_pas_test: type=tBYTE, init-value=CONST_tBYTE_0x00:0
    IF_commande
      data Data_commande_domaine: type=tBYTE, init-value=CONST_tBYTE_0x00:0
      data Data_commande_ordre: type=tBYTE, init-value=CONST_tBYTE_0x00:0
      data Data_commande_test: type=tBYTE, init-value=CONST_tBYTE_0x00:0
    IF_RetourTest
      5 x data, all with type=tBYTE, init-value=CONST_tBYTE_0x00:0:
        Data_retourTest_domaine
        Data_retourTest_erreurPas
        Data_retourTest_erreurSWC
        Data_retourTest_statut
        Data_retourTest_test
    IF_TransfertErreur
      data Data_erreur_code: type=tBYTE, init-value=CONST_tBYTE_0x00:0
      data Data_erreur_domaine: type=tBYTE, init-value=CONST_tBYTE_0x00:0
      data Data_erreur_test: type=tBYTE, init-value=CONST_tBYTE_0x00:0
    IF_DemandeStatut
      data Data_statut_domaine: type=tBYTE, init-value=CONST_tBYTE_0x00:0
      data Data_statut_test: type=tBYTE, init-value=CONST_tBYTE_0x00:0
    IF_DETReportFlag
      data DETClearFirstFlag: type=tLOG, init-value=CONST_tLOG_0x00:0
      data DETReportFlag: type=tLOG, init-value=CONST_tLOG_0x00:0
    IF_LancerTest
      data Data_LancerTest_domaine: type=tBYTE, init-value=CONST_tBYTE_0x00:0
      data Data_LancerTest_test: type=tBYTE, init-value=CONST_tBYTE_0x00:0
    IF_RAZ
      data Data_raz_domaine: type=tBYTE, init-value=CONST_tBYTE_0x00:0
    IF_resultat
      5 x data, all with type=tBYTE, init-value=CONST_tBYTE_0x00:0:
        Data_resultat_domaine
        Data_resultat_erreurPas
        Data_resultat_erreurSWC
        Data_resultat_statut
        Data_resultat_test
    IF_EchoPas
      data Data_echo_domaine: type=tBYTE, init-value=CONST_tBYTE_0x00:0
      data Data_echo_pas: type=tBYTE, init-value=CONST_tBYTE_0x00:0
      data Data_echo_test: type=tBYTE, init-value=CONST_tBYTE_0x00:0
    SR_ActivationHeartBeat
      data ActivationHeartBeat: type=tLOG, init-value=CONST_tLOG_1:1
    SR_ComOff
      data ComOff: type=tLOG, init-value=CONST_tLOG_0:0
    SR_ConfigSEV
      data ConfigSEV: type=t_cCSEV, init-value=CONST_ConfigSEV_t_cCSEV_cCSEV_Montage:0
    SR_DiagCmdPlusCAN1
      data DiagCmdPlusCAN1: type=tSDDiag, init-value=CONST_DiagCmdPlusCAN1_tSDDiag_cSDDiag_DiagOk:0
    SR_DiagCmdPlusCAN2
      data DiagCmdPlusCAN2: type=tSDDiag, init-value=CONST_DiagCmdPlusCAN2_tSDDiag_cSDDiag_IndispoDiag:2
    SR_DiagRelaisAPC
      data DiagRelaisAPC: type=tBYTE, init-value=CONST_tBYTE_0x02:2
    SR_ED_PlusAPC
      data ED_PlusAPC: type=tLOG, init-value=CONST_tLOG_0:0
    SR_ED_PlusRCD
      data ED_PlusRCD: type=tLOG, init-value=CONST_tLOG_0:0
    SR_HoldCluster
      data HoldCluster: type=t_cHOLD, init-value=CONST_HoldCluster_t_cHOLD_cHOLD_OFF:0
    SR_HoldPartialWakeUp
      data HoldPWT1PartialWakeUp: type=tLOG, init-value=CONST_tLOG_0:0
      data HoldPWT2PartialWakeUp: type=tLOG, init-value=CONST_tLOG_0:0
      data HoldPWT8PartialWakeUp: type=tLOG, init-value=CONST_tLOG_0:0
    SR_SchTabFunctional
      8 x data, all with type=tBYTE, init-value=CONST_tBYTE_0:0:
        SchTabFunctional_Lin_{1..8}
    SR_SustainPartialWakeUp
      data SustainPWT1PartialWakeUp: type=tLOG, init-value=CONST_tLOG_0:0
      data SustainPWT2PartialWakeUp: type=tLOG, init-value=CONST_tLOG_0:0
      data SustainPWT8PartialWakeUp: type=tLOG, init-value=CONST_tLOG_0:0
    SR_AppModeRequest
      data RequestedMode: type=t_ApplicationModeRequestType, init-value=CONST_t_ApplicationModeRequestType_0:0
    SR_BodyNetworkWkPattern
      data CanWkPattern: type=tLOG, init-value=CONST_tLOG_0:0
    SR_BodyVersion
      data BodyVersion: type=t_cBodyVersion, init-value=CONST_t_cBodyVersion_0:0
    SR_ComOffIndicationOnLin
      data ComOffIndication: type=t_cLIN_COMOFF, init-value=CONST_ComOffIndication_t_cLIN_COMOFF_cLIN_COMOFFINACTIF:0
    SR_InhibNetworkWakeUp
      data NetworkWkInhibition: type=tLOG, init-value=CONST_tLOG_0:0
    SR_InhibPartialWakeUp
      data PartialWkInhibition: type=tLOG, init-value=CONST_tLOG_0:0
    SR_LastWakeupEvents
      data LastWakeupEvents: type=tDWORD, init-value=CONST_tDWORD_0:0
    SR_LpCanBody
      data LpCanBody: type=t_cLpCanBody, init-value=CONST_LpCanBody_t_cLpCanBody_cSGL_BODY_Sleep:0
    SR_LpLin
      data LpLin: type=t_cLpLIN, init-value=CONST_LpLin_t_cLpLIN_PrepareToSleep:0
    SR_NetState_CanBody
      data NetState_CanBody: type=t_cCANBODY, init-value=CONST_NetState_CanBody_t_cCANBODY_cBODY_ComOff:4
    SR_NetState_CanPwt
      data NetState_CanPwt: type=t_cCANPWT, init-value=CONST_NetState_CanPwt_t_cCANPWT_cPWT_OFF:0
    SR_NetState_Lin
      data NetState_Lin: type=t_cLINLPhM, init-value=CONST_NetState_Lin_t_cLINLPhM_LIN_SLEEP:0
    SR_OpStatusCanPwt
      data OpStatusCanPwt: type=t_cOSPWT, init-value=CONST_OpStatusCanPwt_t_cOSPWT_cOSPWT_Default:7
    SR_PwtVersion
      data PwtVersion: type=t_cPwtVersion, init-value=CONST_t_cPwtVersion_0:0
    SR_StatusCmdAPC
      data StatusCmdAPC: type=t_cCmdAPC, init-value=CONST_StatusCmdAPC_t_cCmdAPC_APC_UNDEFINED:0
    SR_StatusCmdPlusLIN
      data StatusCmdPlusLIN: type=t_cCmdPlusLIN, init-value=CONST_StatusCmdPlusLIN_t_cCmdPlusLIN_PLUSLIN_UNDEFINED:3
    SR_StatusCmdPlusRCD
      data StatusCmdPlusRCD: type=t_cCmdPlusRCD, init-value=CONST_StatusCmdPlusRCD_t_cCmdPlusRCD_cPLUSRCD_OFF:0
    SR_WakeupCause
      data WakeupCause: type=t_WakeUpCause, init-value=CONST_WakeupCause_t_WakeUpCause_cUNKNOWN_SOURCE:0
package /RootP_SR_Param
  301 x sender receiver interface:
    SR_C28_VAL_CONS_VIT_LVV_MIN
      data C28_VAL_CONS_VIT_LVV_MIN: type=t_C28_VAL_CONS_VIT_LVV_MIN, init-value=CONST_t_C28_VAL_CONS_VIT_LVV_MIN_30:30  # Valeur de la vitesse minimale que le client peut donner à ses vitesses préprogrammées LVV
    SR_C28_VAL_CONS_VIT_LVV_MIN_MILES
      data C28_VAL_CONS_VIT_LVV_MIN_MILES: type=t_C28_VAL_CONS_VIT_LVV_MIN_MILES, init-value=CONST_t_C28_VAL_CONS_VIT_LVV_MIN_MILES_50:50  # Valeur de la vitesse minimale que le client peut donner à ses vitesses préprogrammées LVV
    SR_C28_VAL_CONS_VIT_RVV_MIN
      data C28_VAL_CONS_VIT_RVV_MIN: type=t_C28_VAL_CONS_VIT_RVV_MIN, init-value=CONST_t_C28_VAL_CONS_VIT_RVV_MIN_40:40  # Valeur de la vitesse minimale que le client peut donner à ses vitesses préprogrammées RVV
    SR_C28_VAL_CONS_VIT_RVV_MIN_MILES
      data C28_VAL_CONS_VIT_RVV_MIN_MILES: type=t_C28_VAL_CONS_VIT_RVV_MIN_MILES, init-value=CONST_t_C28_VAL_CONS_VIT_RVV_MIN_MILES_50:50  # Valeur de la vitesse minimale que le client peut donner à ses vitesses préprogrammées RVV
    SR_CFG_INIT_AAS
      data CFG_INIT_AAS: type=tLOG, init-value=CONST_tLOG_1:1  # Valeur d'init de l'AAS ENUM 0 "Désactiver" ENUM 1 "Activer"
    SR_CFG_INIT_ACCUEIL_COND
      data CFG_INIT_ACCUEIL_COND: type=tLOG, init-value=CONST_tLOG_1:1  # Valeur d'init de l'accueil conducteur ENUM 0 "Désactiver" ENUM 1 "Activer"
    SR_CFG_INIT_BAAACTIVATION
      data CFG_INIT_BAAACTIVATION: type=tLOG, init-value=CONST_tLOG_1:1  # Valeur du paramétrage en sortie d'usine menu BAA ENUM 0 "Fonction inactive" ENUM 1 "Fonction active"
    SR_CFG_INIT_BAAAUTOLOCKING
      data CFG_INIT_BAAAUTOLOCKING: type=tLOG, init-value=CONST_tLOG_1:1  # Valeur du paramétrage en sortie d'usine menu BAA Autolocking ENUM 0 "Fonction inactive" ENUM 1 "Fonction active"
    SR_CFG_INIT_BUTEE_1
      data CFG_INIT_BUTEE_1: type=tLOG, init-value=CONST_tLOG_1:1  # Valeur d'init de la butee XVV 1 ENUM 0 "Désactiver" ENUM 1 "Activer"
    SR_CFG_INIT_BUTEE_2
      data CFG_INIT_BUTEE_2: type=tLOG, init-value=CONST_tLOG_1:1  # Valeur d'init de la butee XVV 2 ENUM 0 "Désactiver" ENUM 1 "Activer"
    SR_CFG_INIT_BUTEE_3
      data CFG_INIT_BUTEE_3: type=tLOG, init-value=CONST_tLOG_1:1  # Valeur d'init de la butee XVV 3 ENUM 0 "Désactiver" ENUM 1 "Activer"
    SR_CFG_INIT_BUTEE_4
      data CFG_INIT_BUTEE_4: type=tLOG, init-value=CONST_tLOG_1:1  # Valeur d'init de la butee XVV 4 ENUM 0 "Désactiver" ENUM 1 "Activer"
    SR_CFG_INIT_BUTEE_5
      data CFG_INIT_BUTEE_5: type=tLOG, init-value=CONST_tLOG_1:1  # Valeur d'init de la butee XVV 5 ENUM 0 "Désactiver" ENUM 1 "Activer"
    SR_CFG_INIT_BUTEE_GENERALE
      data CFG_INIT_BUTEE_GENERALE: type=tLOG, init-value=CONST_tLOG_0:0  # Valeur d'init de la butee generale XVV ENUM 0 "Désactiver" ENUM 1 "Activer"
    SR_CFG_INIT_CALAND
      data CFG_INIT_CALAND: type=tLOG, init-value=CONST_tLOG_1:1  # Valeur du paramétrage en sortie d'usine ENUM 0 "Fonction inactive" ENUM 1 "Fonction active"
    SR_CFG_INIT_CLIM_PRECOND_ASAP
      data CFG_INIT_CLIM_PRECOND_ASAP: type=tLOG, init-value=CONST_tLOG_0:0  # Valeur d'Init de la fonction CLIM ENUM 0 "Fonction inactive" ENUM 1 "Fonction active"
    SR_CFG_INIT_CLIM_PRECOND_DI_1
      data CFG_INIT_CLIM_PRECOND_DI_1: type=tLOG, init-value=CONST_tLOG_0:0  # Configuration en sortie d'usine du paramètre \CLIM_PRECOND_DI_1 au menu perso
    SR_CFG_INIT_CLIM_PRECOND_DI_2
      data CFG_INIT_CLIM_PRECOND_DI_2: type=tLOG, init-value=CONST_tLOG_0:0  # Configuration en sortie d'usine du paramètre \CLIM_PRECOND_DI_2 au menu perso
    SR_CFG_INIT_CLIM_PRECOND_DI_3
      data CFG_INIT_CLIM_PRECOND_DI_3: type=tLOG, init-value=CONST_tLOG_0:0  # Configuration en sortie d'usine du paramètre \CLIM_PRECOND_DI_3 au menu perso
    SR_CFG_INIT_CLIM_PRECOND_DI_4
      data CFG_INIT_CLIM_PRECOND_DI_4: type=tLOG, init-value=CONST_tLOG_0:0  # Configuration en sortie d'usine du paramètre \CLIM_PRECOND_DI_4 au menu perso
    SR_CFG_INIT_CLIM_PRECOND_H_1
      data CFG_INIT_CLIM_PRECOND_H_1: type=tWORD, init-value=CONST_tWORD_0:0  # Configuration en sortie d'usine du paramètre \CLIM_PRECOND_H_1 au menu perso
    SR_CFG_INIT_CLIM_PRECOND_H_2
      data CFG_INIT_CLIM_PRECOND_H_2: type=tWORD, init-value=CONST_tWORD_0:0  # Configuration en sortie d'usine du paramètre \CLIM_PRECOND_H_2 au menu perso
    SR_CFG_INIT_CLIM_PRECOND_H_3
      data CFG_INIT_CLIM_PRECOND_H_3: type=tWORD, init-value=CONST_tWORD_0:0  # Configuration en sortie d'usine du paramètre \CLIM_PRECOND_H_3 au menu perso
    SR_CFG_INIT_CLIM_PRECOND_H_4
      data CFG_INIT_CLIM_PRECOND_H_4: type=tWORD, init-value=CONST_tWORD_0:0  # Configuration en sortie d'usine du paramètre \CLIM_PRECOND_H_4 au menu perso
    SR_CFG_INIT_CLIM_PRECOND_JE_1
      data CFG_INIT_CLIM_PRECOND_JE_1: type=tLOG, init-value=CONST_tLOG_0:0  # Configuration en sortie d'usine du paramètre \CLIM_PRECOND_JE_1 au menu perso
    SR_CFG_INIT_CLIM_PRECOND_JE_2
      data CFG_INIT_CLIM_PRECOND_JE_2: type=tLOG, init-value=CONST_tLOG_0:0  # Configuration en sortie d'usine du paramètre \CLIM_PRECOND_JE_2 au menu perso
    SR_CFG_INIT_CLIM_PRECOND_JE_3
      data CFG_INIT_CLIM_PRECOND_JE_3: type=tLOG, init-value=CONST_tLOG_0:0  # Configuration en sortie d'usine du paramètre \CLIM_PRECOND_JE_3 au menu perso
    SR_CFG_INIT_CLIM_PRECOND_JE_4
      data CFG_INIT_CLIM_PRECOND_JE_4: type=tLOG, init-value=CONST_tLOG_0:0  # Configuration en sortie d'usine du paramètre \CLIM_PRECOND_JE_4 au menu perso
    SR_CFG_INIT_CLIM_PRECOND_LU_1
      data CFG_INIT_CLIM_PRECOND_LU_1: type=tLOG, init-value=CONST_tLOG_0:0  # Configuration en sortie d'usine du paramètre \CLIM_PRECOND_LU_1 au menu perso
    SR_CFG_INIT_CLIM_PRECOND_LU_2
      data CFG_INIT_CLIM_PRECOND_LU_2: type=tLOG, init-value=CONST_tLOG_0:0  # Configuration en sortie d'usine du paramètre \CLIM_PRECOND_LU_2 au menu perso
    SR_CFG_INIT_CLIM_PRECOND_LU_3
      data CFG_INIT_CLIM_PRECOND_LU_3: type=tLOG, init-value=CONST_tLOG_0:0  # Configuration en sortie d'usine du paramètre \CLIM_PRECOND_LU_3 au menu perso
    SR_CFG_INIT_CLIM_PRECOND_LU_4
      data CFG_INIT_CLIM_PRECOND_LU_4: type=tLOG, init-value=CONST_tLOG_0:0  # Configuration en sortie d'usine du paramètre \CLIM_PRECOND_LU_4 au menu perso
    SR_CFG_INIT_CLIM_PRECOND_MA_1
      data CFG_INIT_CLIM_PRECOND_MA_1: type=tLOG, init-value=CONST_tLOG_0:0  # Configuration en sortie d'usine du paramètre \CLIM_PRECOND_MA_1 au menu perso
    SR_CFG_INIT_CLIM_PRECOND_MA_2
      data CFG_INIT_CLIM_PRECOND_MA_2: type=tLOG, init-value=CONST_tLOG_0:0  # Configuration en sortie d'usine du paramètre \CLIM_PRECOND_MA_2 au menu perso
    SR_CFG_INIT_CLIM_PRECOND_MA_3
      data CFG_INIT_CLIM_PRECOND_MA_3: type=tLOG, init-value=CONST_tLOG_0:0  # Configuration en sortie d'usine du paramètre \CLIM_PRECOND_MA_3 au menu perso
    SR_CFG_INIT_CLIM_PRECOND_MA_4
      data CFG_INIT_CLIM_PRECOND_MA_4: type=tLOG, init-value=CONST_tLOG_0:0  # Configuration en sortie d'usine du paramètre \CLIM_PRECOND_MA_4 au menu perso
    SR_CFG_INIT_CLIM_PRECOND_ME_1
      data CFG_INIT_CLIM_PRECOND_ME_1: type=tLOG, init-value=CONST_tLOG_0:0  # Configuration en sortie d'usine du paramètre \CLIM_PRECOND_ME_1 au menu perso
    SR_CFG_INIT_CLIM_PRECOND_ME_2
      data CFG_INIT_CLIM_PRECOND_ME_2: type=tLOG, init-value=CONST_tLOG_0:0  # Configuration en sortie d'usine du paramètre \CLIM_PRECOND_ME_2 au menu perso
    SR_CFG_INIT_CLIM_PRECOND_ME_3
      data CFG_INIT_CLIM_PRECOND_ME_3: type=tLOG, init-value=CONST_tLOG_0:0  # Configuration en sortie d'usine du paramètre \CLIM_PRECOND_ME_3 au menu perso
    SR_CFG_INIT_CLIM_PRECOND_ME_4
      data CFG_INIT_CLIM_PRECOND_ME_4: type=tLOG, init-value=CONST_tLOG_0:0  # Configuration en sortie d'usine du paramètre \CLIM_PRECOND_ME_4 au menu perso
    SR_CFG_INIT_CLIM_PRECOND_ON_1
      data CFG_INIT_CLIM_PRECOND_ON_1: type=tLOG, init-value=CONST_tLOG_0:0  # Configuration en sortie d'usine du paramètre \CLIM_PRECOND_ON_1 au menu perso
    SR_CFG_INIT_CLIM_PRECOND_ON_2
      data CFG_INIT_CLIM_PRECOND_ON_2: type=tLOG, init-value=CONST_tLOG_0:0  # Configuration en sortie d'usine du paramètre \CLIM_PRECOND_ON_2 au menu perso
    SR_CFG_INIT_CLIM_PRECOND_ON_3
      data CFG_INIT_CLIM_PRECOND_ON_3: type=tLOG, init-value=CONST_tLOG_0:0  # Configuration en sortie d'usine du paramètre \CLIM_PRECOND_ON_3 au menu perso
    SR_CFG_INIT_CLIM_PRECOND_ON_4
      data CFG_INIT_CLIM_PRECOND_ON_4: type=tLOG, init-value=CONST_tLOG_0:0  # Configuration en sortie d'usine du paramètre \CLIM_PRECOND_ON_4 au menu perso
    SR_CFG_INIT_CLIM_PRECOND_SA_1
      data CFG_INIT_CLIM_PRECOND_SA_1: type=tLOG, init-value=CONST_tLOG_0:0  # Configuration en sortie d'usine du paramètre \CLIM_PRECOND_SA_1 au menu perso
    SR_CFG_INIT_CLIM_PRECOND_SA_2
      data CFG_INIT_CLIM_PRECOND_SA_2: type=tLOG, init-value=CONST_tLOG_0:0  # Configuration en sortie d'usine du paramètre \CLIM_PRECOND_SA_2 au menu perso
    SR_CFG_INIT_CLIM_PRECOND_SA_3
      data CFG_INIT_CLIM_PRECOND_SA_3: type=tLOG, init-value=CONST_tLOG_0:0  # Configuration en sortie d'usine du paramètre \CLIM_PRECOND_SA_3 au menu perso
    SR_CFG_INIT_CLIM_PRECOND_SA_4
      data CFG_INIT_CLIM_PRECOND_SA_4: type=tLOG, init-value=CONST_tLOG_0:0  # Configuration en sortie d'usine du paramètre \CLIM_PRECOND_SA_4 au menu perso
    SR_CFG_INIT_CLIM_PRECOND_VE_1
      data CFG_INIT_CLIM_PRECOND_VE_1: type=tLOG, init-value=CONST_tLOG_0:0  # Configuration en sortie d'usine du paramètre \CLIM_PRECOND_VE_1 au menu perso
    SR_CFG_INIT_CLIM_PRECOND_VE_2
      data CFG_INIT_CLIM_PRECOND_VE_2: type=tLOG, init-value=CONST_tLOG_0:0  # Configuration en sortie d'usine du paramètre \CLIM_PRECOND_VE_2 au menu perso
    SR_CFG_INIT_CLIM_PRECOND_VE_3
      data CFG_INIT_CLIM_PRECOND_VE_3: type=tLOG, init-value=CONST_tLOG_0:0  # Configuration en sortie d'usine du paramètre \CLIM_PRECOND_VE_3 au menu perso
    SR_CFG_INIT_CLIM_PRECOND_VE_4
      data CFG_INIT_CLIM_PRECOND_VE_4: type=tLOG, init-value=CONST_tLOG_0:0  # Configuration en sortie d'usine du paramètre \CLIM_PRECOND_VE_4 au menu perso
    SR_CFG_INIT_CMDM_DAE
      data CFG_INIT_CMDM_DAE: type=tLOG, init-value=CONST_tLOG_1:1  # Valeur du paramétrage en sortie d'usine menu CMDM_DAE ENUM 0 "Fonction inactive" ENUM 1 "Fonction active"
    SR_CFG_INIT_CMDM_DAE_4WD
      data CFG_INIT_CMDM_DAE_4WD: type=tLOG, init-value=CONST_tLOG_1:1  # Valeur du paramétrage en sortie d'usine menu CMDM_DAE_4WD ENUM 0 "Fonction inactive" ENUM 1 "Fonction active"
    SR_CFG_INIT_DAAACTIVATION
      data CFG_INIT_DAAACTIVATION: type=tLOG, init-value=CONST_tLOG_1:1  # Valeur du paramétrage en sortie d'usine menu DAA ENUM 0 "Fonction inactive" ENUM 1 "Fonction active"
    SR_CFG_INIT_DSG
      data CFG_INIT_DSG: type=tLOG, init-value=CONST_tLOG_0:0  # Menu de reinitialisation de la DSG indirecte ENUM 0 "Fonction inactive" ENUM 1 "Fonction active"
    SR_CFG_INIT_ECL_ACCOMP
      data CFG_INIT_ECL_ACCOMP: type=tLOG, init-value=CONST_tLOG_0:0  # Valeur d'init de l'ecl accomp ENUM 0 "Désactiver" ENUM 1 "Activer"
    SR_CFG_INIT_ECL_ADAPT
      data CFG_INIT_ECL_ADAPT: type=tLOG, init-value=CONST_tLOG_1:1  # Valeur d'init de l'ecl adaptatif ENUM 0 "Désactiver" ENUM 1 "Activer"
    SR_CFG_INIT_ECL_AMBI
      data CFG_INIT_ECL_AMBI: type=tLOG, init-value=CONST_tLOG_1:1  # Valeur d'init de l'ecl ambiance ENUM 0 "Désactiver" ENUM 1 "Activer"
    SR_CFG_INIT_ECL_AMBI_NIV
      data CFG_INIT_ECL_AMBI_NIV: type=t_CFG_INIT_ECL_AMBI_NIV, init-value=6  # Niveau de l'éclairage d'ambiance en sortie d'usine ENUM 0 "Niveau_0" ENUM 1 "Niveau_1" ENUM 2 "Niveau_2" ENUM 3 "Niveau_3" ENUM 4 "Niveau_4" ENUM 5 "Niveau_5" ENUM 6 "Niveau_6"
    SR_CFG_INIT_ECL_AUTO
      data CFG_INIT_ECL_AUTO: type=tLOG, init-value=CONST_tLOG_0:0  # Valeur d'init de l'ecl auto ENUM 0 "Désactiver" ENUM 1 "Activer"
    SR_CFG_INIT_ECL_AUTOROUTE
      data CFG_INIT_ECL_AUTOROUTE: type=tLOG, init-value=CONST_tLOG_1:1  # Valeur d'init de l'ecl autoroute ENUM 0 "Désactiver" ENUM 1 "Activer"
    SR_CFG_INIT_ECL_DECONDA
      data CFG_INIT_ECL_DECONDA: type=tLOG, init-value=CONST_tLOG_0:0  # Valeur d'init de l'ecl deconda ENUM 0 "Désactiver" ENUM 1 "Activer"
    SR_CFG_INIT_ECL_FEUX_DIURNES
      data CFG_INIT_ECL_FEUX_DIURNES: type=tLOG, init-value=CONST_tLOG_0:0  # Valeur d'init de l'ecl feux diurnes ENUM 0 "Désactiver" ENUM 1 "Activer"
    SR_CFG_INIT_ECLI_PPC_ANIM
      data CFG_INIT_ECLI_PPC_ANIM: type=tBYTE, init-value=CONST_tBYTE_1:1  # Valeur du paramétrage en sortie d'usine menu xxx
    SR_CFG_INIT_ECLI_PPC_BLOC1
      data CFG_INIT_ECLI_PPC_BLOC1: type=tLOG, init-value=CONST_tLOG_1:1  # Valeur du paramétrage en sortie d'usine menu xxx ENUM 0 "Fonction inactive" ENUM 1 "Fonction active"
    SR_CFG_INIT_ECLI_PPC_COL1
      data CFG_INIT_ECLI_PPC_COL1: type=tBYTE, init-value=CONST_tBYTE_1:1  # Valeur du paramétrage en sortie d'usine menu xxx
    SR_CFG_INIT_ECLX_AFS
      data CFG_INIT_ECLX_AFS: type=tLOG, init-value=CONST_tLOG_0:0  # Valeur du paramétrage en sortie d'usine menu AFS ENUM 0 "Fonction inactive" ENUM 1 "Fonction active"
    SR_CFG_INIT_ECLX_ARS
      data CFG_INIT_ECLX_ARS: type=tLOG, init-value=CONST_tLOG_0:0  # Valeur du paramétrage en sortie d'usine menu ARS ENUM 0 "Fonction inactive" ENUM 1 "Fonction active"
    SR_CFG_INIT_ECLX_ECL_CAFR
      data CFG_INIT_ECLX_ECL_CAFR: type=tLOG, init-value=CONST_tLOG_1:1  # Valeur du paramétrage en sortie d'usine menu CAFR ENUM 0 "Fonction inactive" ENUM 1 "Fonction active"
    SR_CFG_INIT_ESSUIE_VIT_MAR
      data CFG_INIT_ESSUIE_VIT_MAR: type=tLOG, init-value=CONST_tLOG_0:0  # Valeur d'init de l'essuie vitre MAR ENUM 0 "Désactiver" ENUM 1 "Activer"
    SR_CFG_INIT_FARC
      data CFG_INIT_FARC: type=tLOG, init-value=CONST_tLOG_0:0  # Valeur usine de l'état du menu FARC ENUM 0 "Fonction inactive" ENUM 1 "Fonction active"
    SR_CFG_INIT_FSE_AUTO
      data CFG_INIT_FSE_AUTO: type=tLOG, init-value=CONST_tLOG_1:1  # Valeur d'init du FSE auto ENUM 0 "Désactiver" ENUM 1 "Activer"
    SR_CFG_INIT_GAV_AMLA
      data CFG_INIT_GAV_AMLA: type=tLOG, init-value=CONST_tLOG_0:0  # Valeur d'Init de la fonction GAV
    SR_CFG_INIT_HARMONIE_SON
      data CFG_INIT_HARMONIE_SON: type=t_CFG_INIT_HARMONIE_SON, init-value=0  # Valeur d'init des sons polyphoniques ENUM 0 "Harmonie 1" ENUM 1 "Harmonie 2" ENUM 2 "Harmonie 3" ENUM 3 "Harmonie 4"
    SR_CFG_INIT_ILV
      data CFG_INIT_ILV: type=tLOG, init-value=CONST_tLOG_1:1  # Valeur du paramétrage en sortie d'usine menu ILV ENUM 0 "Fonction inactive" ENUM 1 "Fonction active"
    SR_CFG_INIT_ILV_ETSR
      data CFG_INIT_ILV_ETSR: type=tLOG, init-value=CONST_tLOG_1:1  # Valeur du paramétrage en sortie d'usine menu xxx ENUM 0 "Fonction inactive" ENUM 1 "Fonction active"
    SR_CFG_INIT_IMA
      data CFG_INIT_IMA: type=tLOG, init-value=CONST_tLOG_1:1  # Valeur d'init du menu Indexation Marche Arrière ENUM 0 "Fonction inactive" ENUM 1 "Fonction active"
    SR_CFG_INIT_INV_ADSD
      data CFG_INIT_INV_ADSD: type=tLOG, init-value=CONST_tLOG_1:1  # Valeur du paramétrage en sortie d'usine menu INVIO_ADSD ENUM 0 "Fonction inactive" ENUM 1 "Fonction active"
    SR_CFG_INIT_LANGUE_VHL
      data CFG_INIT_LANGUE_VHL: type=t_CFG_INIT_LANGUE_VHL, init-value=0  # Valeur d'init de la langue vehicule
    SR_CFG_INIT_MENU_HC_END
      data CFG_INIT_MENU_HC_END: type=t_CFG_INIT_MENU_HC_END, init-value=420  # Programmation de 0 à 1439 minutes
    SR_CFG_INIT_MENU_HC_START
      data CFG_INIT_MENU_HC_START: type=t_CFG_INIT_MENU_HC_START, init-value=1380  # Programmation de 0 à 1439 minutes
    SR_CFG_INIT_MENU_PRG_PEM_DI
      data CFG_INIT_MENU_PRG_PEM_DI: type=t_CFG_INIT_MENU_PRG_PEM_DI, init-value=480  # Programmation de 0 à 1439 minutes
    SR_CFG_INIT_MENU_PRG_PEM_JE
      data CFG_INIT_MENU_PRG_PEM_JE: type=t_CFG_INIT_MENU_PRG_PEM_JE, init-value=480  # Programmation de 0 à 1439 minutes
    SR_CFG_INIT_MENU_PRG_PEM_LU
      data CFG_INIT_MENU_PRG_PEM_LU: type=t_CFG_INIT_MENU_PRG_PEM_LU, init-value=480  # Programmation de 0 à 1439 minutes
    SR_CFG_INIT_MENU_PRG_PEM_MA
      data CFG_INIT_MENU_PRG_PEM_MA: type=t_CFG_INIT_MENU_PRG_PEM_MA, init-value=480  # Programmation de 0 à 1430 minutes
    SR_CFG_INIT_MENU_PRG_PEM_ME
      data CFG_INIT_MENU_PRG_PEM_ME: type=t_CFG_INIT_MENU_PRG_PEM_ME, init-value=480  # Programmation de 0 à 1439 minutes
    SR_CFG_INIT_MENU_PRG_PEM_SA
      data CFG_INIT_MENU_PRG_PEM_SA: type=t_CFG_INIT_MENU_PRG_PEM_SA, init-value=480  # Programmationd de 0 à 1439 minutes
    SR_CFG_INIT_MENU_PRG_PEM_VE
      data CFG_INIT_MENU_PRG_PEM_VE: type=t_CFG_INIT_MENU_PRG_PEM_VE, init-value=480  # Programmation de 0 à 1439 minutes
    SR_CFG_INIT_MENU_SEL_HC
      data CFG_INIT_MENU_SEL_HC: type=tLOG, init-value=CONST_tLOG_1:1  # 0 : Fonction inactive 1 : Fonction active ENUM 0 "Fonction inactive" ENUM 1 "Fonction active"
    SR_CFG_INIT_MENU_SEL_PRG_PEM_DI
      data CFG_INIT_MENU_SEL_PRG_PEM_DI: type=tLOG, init-value=CONST_tLOG_1:1  # 0 : Fonction inactive 1 : Fonction active ENUM 0 "Fonction inactive" ENUM 1 "Fonction active"
    SR_CFG_INIT_MENU_SEL_PRG_PEM_JE
      data CFG_INIT_MENU_SEL_PRG_PEM_JE: type=tLOG, init-value=CONST_tLOG_1:1  # 0 : Fonction inactive 1 : Fonction active ENUM 0 "Fonction inactive" ENUM 1 "Fonction active"
    SR_CFG_INIT_MENU_SEL_PRG_PEM_LU
      data CFG_INIT_MENU_SEL_PRG_PEM_LU: type=tLOG, init-value=CONST_tLOG_1:1  # 0 : Fonction inactive 1 : Fonction active ENUM 0 "Fonction inactive" ENUM 1 "Fonction active"
    SR_CFG_INIT_MENU_SEL_PRG_PEM_MA
      data CFG_INIT_MENU_SEL_PRG_PEM_MA: type=tLOG, init-value=CONST_tLOG_1:1  # 0 : Fonction inactive 1 : Fonction active ENUM 0 "Fonction inactive" ENUM 1 "Fonction active"
    SR_CFG_INIT_MENU_SEL_PRG_PEM_ME
      data CFG_INIT_MENU_SEL_PRG_PEM_ME: type=tLOG, init-value=CONST_tLOG_1:1  # 0 : Fonction inactive 1 : Fonction active ENUM 0 "Fonction inactive" ENUM 1 "Fonction active"
    SR_CFG_INIT_MENU_SEL_PRG_PEM_SA
      data CFG_INIT_MENU_SEL_PRG_PEM_SA: type=tLOG, init-value=CONST_tLOG_1:1  # 0 : Fonction inactive 1 : Fonction active ENUM 0 "Fonction inactive" ENUM 1 "Fonction active"
    SR_CFG_INIT_MENU_SEL_PRG_PEM_VE
      data CFG_INIT_MENU_SEL_PRG_PEM_VE: type=tLOG, init-value=CONST_tLOG_1:1  # 0 : Fonction inactive 1 : Fonction active ENUM 0 "Fonction inactive" ENUM 1 "Fonction active"
    SR_CFG_INIT_MOTOR_VOLET
      data CFG_INIT_MOTOR_VOLET: type=tLOG, init-value=CONST_tLOG_0:0  # Valeur d'init motorisation du volet ENUM 0 "Désactiver" ENUM 1 "Activer"
    SR_CFG_INIT_PRESENCE_ARC
      data CFG_INIT_PRESENCE_ARC: type=tLOG, init-value=CONST_tLOG_1:1  # Configuration en sortie d'usine du paramètre \Présence de la fonction ARC\ au menu perso ENUM 0 "Fonction inactive" ENUM 1 "Fonction active"
    SR_CFG_INIT_PRV_MODE
      data CFG_INIT_PRV_MODE: type=t_CFG_INIT_PRV_MODE, init-value=0  # Valeur du paramétrage en sortie d'usine menu PRIVACY_MODE ENUM 0 "Full_private" ENUM 1 "Geoloc_private" ENUM 2 "No_private"
    SR_CFG_INIT_RESERVE_ZEV
      data CFG_INIT_RESERVE_ZEV: type=t_CFG_INIT_RESERVE_ZEV, init-value=2  # 0 : 5km 1 : 10km 2 : 15km 3 : non utilisé ENUM 0 "5km" ENUM 1 "10km" ENUM 2 "15km" ENUM 3 "Non utilise"
    SR_CFG_INIT_RTAB
      data CFG_INIT_RTAB: type=tLOG, init-value=CONST_tLOG_1:1  # Valeur du paramétrage en sortie d'usine ENUM 0 "Fonction inactive" ENUM 1 "Fonction active"
    SR_CFG_INIT_RTAB_ENERGY_REC
      data CFG_INIT_RTAB_ENERGY_REC: type=tBYTE, init-value=CONST_tBYTE_0:0  # Configuration en sortie d'usine du paramètre \RTAB_ENERGY_RECOVER au menu perso
    SR_CFG_INIT_RTAB_RECHARGE
      data CFG_INIT_RTAB_RECHARGE: type=tLOG, init-value=CONST_tLOG_0:0  # Valeur d'init Recharge Batterie
    SR_CFG_INIT_RTAB_RECHARGE_H_DEB
      data CFG_INIT_RTAB_RECHARGE_H_DEB: type=tDWORD, init-value=CONST_tDWORD_0:0  # Configuration en sortie d'usine du paramètre \RECHARGE_H_DEBUT au menu perso
    SR_CFG_INIT_RTAB_TYPE_REC
      data CFG_INIT_RTAB_TYPE_REC: type=tLOG, init-value=CONST_tLOG_0:0  # Valeur du paramétrage en sortie d'usine menu RTAB
    SR_CFG_INIT_SAM
      data CFG_INIT_SAM: type=tLOG, init-value=CONST_tLOG_1:1  # Valeur d'init de la SAM ENUM 0 "Désactiver" ENUM 1 "Activer"
    SR_CFG_INIT_SELECTIVITE_CAB_ZC
      data CFG_INIT_SELECTIVITE_CAB_ZC: type=tLOG, init-value=CONST_tLOG_0:0  # Valeur d'init de la sélectivité cabine ENUM 0 "Désactiver" ENUM 1 "Activer"
    SR_CFG_INIT_SELECTIVITE_COND
      data CFG_INIT_SELECTIVITE_COND: type=tLOG, init-value=CONST_tLOG_0:0  # Valeur d'init de la sélectivité conducteur ENUM 0 "Désactiver" ENUM 1 "Activer"
    SR_CFG_INIT_SELECTIVITE_OUV_AR
      data CFG_INIT_SELECTIVITE_OUV_AR: type=tLOG, init-value=CONST_tLOG_0:0  # Valeur d'init de la sélectivité ouvrant arriere ENUM 0 "Désactiver" ENUM 1 "Activer"
    SR_CFG_INIT_SEL_RESERVE_ZEV
      data CFG_INIT_SEL_RESERVE_ZEV: type=tLOG, init-value=CONST_tLOG_1:1  # 0 : Fonction inactive 1 : Fonction active ENUM 0 "Fonction inactive" ENUM 1 "Fonction active"
    SR_CFG_INIT_SENS_ARC_NIV
      data CFG_INIT_SENS_ARC_NIV: type=t_CFG_INIT_SENS_ARC_NIV, init-value=2  # Configuration en sortie d'usine du paramètre \Sensibilité ARC\ au menu perso ENUM 1 "1" ENUM 2 "2" ENUM 3 "3"
    SR_CFG_INIT_TCFG
      data CFG_INIT_TCFG: type=t_CFG_INIT_TCFG, init-value=4  # Valeur d'init de la TCFG ENUM 0 "Eclairage plafonnier" ENUM 1 "Black Panel" ENUM 2 "Acces JDA" ENUM 3 "Personnalisation CMB" ENUM 4 "Colorisation CMB" ENUM 5 "Check manuel" ENUM 6 "Non Utilise" ENUM 7 "Non Utilise" ENUM 8 "Non Utilise" ENUM 9 "Non Utilise" ENUM 10 "Non Utilise" ENUM 11 "Non Utilise" ENUM 12 "Non Utilise" ENUM 13 "Non Utilise" ENUM 14 "Non Utilise" ENUM 15 "Non Utilise"
    SR_CFG_INIT_TEMPO_ACCOMP
      data CFG_INIT_TEMPO_ACCOMP: type=t_CFG_INIT_TEMPO_ACCOMP, init-value=1  # Valeur d'init de la tempo d'ecl accomp ENUM 0 "15 s" ENUM 1 "30 s" ENUM 2 "60 s" ENUM 3 "Non Utilisé"
    SR_CFG_INIT_TEMPO_DECONDA
      data CFG_INIT_TEMPO_DECONDA: type=t_CFG_INIT_TEMPO_DECONDA, init-value=1  # Valeur d'init de la tempo d'ecl deconda ENUM 0 "15 s" ENUM 1 "30 s" ENUM 2 "60 s" ENUM 3 "Non Utilisé"
    SR_CFG_INIT_UNITE_CONSO
      data CFG_INIT_UNITE_CONSO: type=tLOG, init-value=CONST_tLOG_0:0  # Valeur d'init de l'unite de conso ENUM 0 "Volume pour 100 unites de distance" ENUM 1 "Distance par unite de volume"
    SR_CFG_INIT_UNITE_DISTANCE
      data CFG_INIT_UNITE_DISTANCE: type=tLOG, init-value=CONST_tLOG_0:0  # Valeur d'init de l'unite de distance ENUM 0 "km" ENUM 1 "miles"
    SR_CFG_INIT_UNITE_TEMP
      data CFG_INIT_UNITE_TEMP: type=tLOG, init-value=CONST_tLOG_0:0  # Valeur d'init de l'unite de temperature ENUM 0 "àC" ENUM 1 "àF"
    SR_CFG_INIT_UNITE_VOLUME
      data CFG_INIT_UNITE_VOLUME: type=tLOG, init-value=CONST_tLOG_0:0  # Valeur d'init de l'unite de volume ENUM 0 "Litre" ENUM 1 "Gallon"
    SR_CFG_INIT_VAM_ECS_MODE
      data CFG_INIT_VAM_ECS_MODE: type=tLOG, init-value=CONST_tLOG_1:1  # Valeur du paramétrage en sortie d'usine menu ECS Mode ENUM 0 "Fonction inactive" ENUM 1 "Fonction active"
    SR_CFG_INIT_VITESSE_1
      data CFG_INIT_VITESSE_1: type=tBYTE, init-value=CONST_tBYTE_50:50  # Valeur d'init de la vitesse butee XVV 1
    SR_CFG_INIT_VITESSE_2
      data CFG_INIT_VITESSE_2: type=tBYTE, init-value=CONST_tBYTE_70:70  # Valeur d'init de la vitesse butee XVV 2
    SR_CFG_INIT_VITESSE_3
      data CFG_INIT_VITESSE_3: type=tBYTE, init-value=CONST_tBYTE_90:90  # Valeur d'init de la vitesse butee XVV 3
    SR_CFG_INIT_VITESSE_4
      data CFG_INIT_VITESSE_4: type=tBYTE, init-value=CONST_tBYTE_110:110  # Valeur d'init de la vitesse butee XVV 4
    SR_CFG_INIT_VITESSE_5
      data CFG_INIT_VITESSE_5: type=tBYTE, init-value=CONST_tBYTE_130:130  # Valeur d'init de la vitesse butee XVV 5
    SR_CFG_INIT_VIT_LVV_1
      data CFG_INIT_VIT_LVV_1: type=tBYTE, init-value=CONST_tBYTE_50:50  # Configuration en sortie d'usine du paramètre \Vitesse LVV 1\ au menu perso
    SR_CFG_INIT_VIT_LVV_1_Miles
      data CFG_INIT_VIT_LVV_1_Miles: type=tBYTE, init-value=CONST_tBYTE_32:32  # Configuration en sortie d'usine du paramètre \Vitesse LVV 1\ au menu perso
    SR_CFG_INIT_VIT_LVV_2
      data CFG_INIT_VIT_LVV_2: type=tBYTE, init-value=CONST_tBYTE_70:70  # Configuration en sortie d'usine du paramètre \Vitesse LVV 2\ au menu perso
    SR_CFG_INIT_VIT_LVV_2_Miles
      data CFG_INIT_VIT_LVV_2_Miles: type=tBYTE, init-value=CONST_tBYTE_48:48  # Configuration en sortie d'usine du paramètre \Vitesse LVV 2\ au menu perso
    SR_CFG_INIT_VIT_LVV_3
      data CFG_INIT_VIT_LVV_3: type=tBYTE, init-value=CONST_tBYTE_80:80  # Configuration en sortie d'usine du paramètre \Vitesse LVV 3\ au menu perso
    SR_CFG_INIT_VIT_LVV_3_Miles
      data CFG_INIT_VIT_LVV_3_Miles: type=tBYTE, init-value=CONST_tBYTE_64:64  # Configuration en sortie d'usine du paramètre \Vitesse LVV 3\ au menu perso
    SR_CFG_INIT_VIT_LVV_4
      data CFG_INIT_VIT_LVV_4: type=tBYTE, init-value=CONST_tBYTE_90:90  # Configuration en sortie d'usine du paramètre \Vitesse LVV 4\ au menu perso
    SR_CFG_INIT_VIT_LVV_4_Miles
      data CFG_INIT_VIT_LVV_4_Miles: type=tBYTE, init-value=CONST_tBYTE_80:80  # Configuration en sortie d'usine du paramètre \Vitesse LVV 4\ au menu perso
    SR_CFG_INIT_VIT_LVV_5
      data CFG_INIT_VIT_LVV_5: type=tBYTE, init-value=CONST_tBYTE_110:110  # Configuration en sortie d'usine du paramètre \Vitesse LVV 5\ au menu perso
    SR_CFG_INIT_VIT_LVV_5_Miles
      data CFG_INIT_VIT_LVV_5_Miles: type=tBYTE, init-value=CONST_tBYTE_96:96  # Configuration en sortie d'usine du paramètre \Vitesse LVV 5\ au menu perso
    SR_CFG_INIT_VIT_LVV_6
      data CFG_INIT_VIT_LVV_6: type=tBYTE, init-value=CONST_tBYTE_130:130  # Configuration en sortie d'usine du paramètre \Vitesse LVV 6\ au menu perso
    SR_CFG_INIT_VIT_LVV_6_Miles
      data CFG_INIT_VIT_LVV_6_Miles: type=tBYTE, init-value=CONST_tBYTE_112:112  # Configuration en sortie d'usine du paramètre \Vitesse LVV 6\ au menu perso
    SR_CFG_INIT_VIT_RVV_1
      data CFG_INIT_VIT_RVV_1: type=tBYTE, init-value=CONST_tBYTE_50:50  # Configuration en sortie d'usine du paramètre \Vitesse RVV 1\ au menu perso
    SR_CFG_INIT_VIT_RVV_1_Miles
      data CFG_INIT_VIT_RVV_1_Miles: type=tBYTE, init-value=CONST_tBYTE_48:48  # Configuration en sortie d'usine du paramètre \Vitesse RVV 1\ au menu perso
    SR_CFG_INIT_VIT_RVV_2
      data CFG_INIT_VIT_RVV_2: type=tBYTE, init-value=CONST_tBYTE_70:70  # Configuration en sortie d'usine du paramètre \Vitesse RVV 2\ au menu perso
    SR_CFG_INIT_VIT_RVV_2_Miles
      data CFG_INIT_VIT_RVV_2_Miles: type=tBYTE, init-value=CONST_tBYTE_64:64  # Configuration en sortie d'usine du paramètre \Vitesse RVV 2\ au menu perso
    SR_CFG_INIT_VIT_RVV_3
      data CFG_INIT_VIT_RVV_3: type=tBYTE, init-value=CONST_tBYTE_80:80  # Configuration en sortie d'usine du paramètre \Vitesse RVV 3\ au menu perso
    SR_CFG_INIT_VIT_RVV_3_Miles
      data CFG_INIT_VIT_RVV_3_Miles: type=tBYTE, init-value=CONST_tBYTE_80:80  # Configuration en sortie d'usine du paramètre \Vitesse RVV 3\ au menu perso
    SR_CFG_INIT_VIT_RVV_4
      data CFG_INIT_VIT_RVV_4: type=tBYTE, init-value=CONST_tBYTE_90:90  # Configuration en sortie d'usine du paramètre \Vitesse RVV 4\ au menu perso
    SR_CFG_INIT_VIT_RVV_4_Miles
      data CFG_INIT_VIT_RVV_4_Miles: type=tBYTE, init-value=CONST_tBYTE_96:96  # Configuration en sortie d'usine du paramètre \Vitesse RVV 4\ au menu perso
    SR_CFG_INIT_VIT_RVV_5
      data CFG_INIT_VIT_RVV_5: type=tBYTE, init-value=CONST_tBYTE_110:110  # Configuration en sortie d'usine du paramètre \Vitesse RVV 5\ au menu perso
    SR_CFG_INIT_VIT_RVV_5_Miles
      data CFG_INIT_VIT_RVV_5_Miles: type=tBYTE, init-value=CONST_tBYTE_112:112  # Configuration en sortie d'usine du paramètre \Vitesse RVV 5\ au menu perso
    SR_CFG_INIT_VIT_RVV_6
      data CFG_INIT_VIT_RVV_6: type=tBYTE, init-value=CONST_tBYTE_130:130  # Configuration en sortie d'usine du paramètre \Vitesse RVV 6\ au menu perso
    SR_CFG_INIT_VIT_RVV_6_Miles
      data CFG_INIT_VIT_RVV_6_Miles: type=tBYTE, init-value=CONST_tBYTE_129:129  # Configuration en sortie d'usine du paramètre \Vitesse RVV 6\ au menu perso
    SR_CFG_INIT_VTOR_IRV
      data CFG_INIT_VTOR_IRV: type=tLOG, init-value=CONST_tLOG_0:0  # Valeur du paramétrage en sortie d'usine menu VTOR_IRV ENUM 0 "Fonction inactive" ENUM 1 "Fonction active"
    SR_CFG_MECATRONIC_HEADLAMP
      data CFG_MECATRONIC_HEADLAMP: type=tLOG, init-value=CONST_tLOG_0:0  # Option des projecteurs innovants
    SR_CFG_OPTION_MENU_FSE
      data CFG_OPTION_MENU_FSE: type=tLOG, init-value=CONST_tLOG_1:1  # Indique si l'item 'Mode de serrage du FSE' doit être affiché au menu de personnalisation ENUM 0 "Menu absent" ENUM 1 "Menu présent"
    SR_CFG_PRESENCE_AFS
      data CFG_PRESENCE_AFS: type=tLOG, init-value=CONST_tLOG_0:0  # Présence dAFS ENUM 0 "Absence de l'organe" ENUM 1 "Presence de l'organe"
    SR_CFG_PRESENCE_ARC
      data CFG_PRESENCE_ARC: type=t_cARC_0, init-value=CONST_t_cARC_0_1:1  # Indique si le véhicule est équipé de la fonction ARC (Alerter des Risques de Collision) ENUM 0 "ARC absent" cARC_absent ENUM 1 "ARC présent" cARC_present ENUM 2 "ARC 2" cARC_2_present ENUM 3 "ARC 3" cARC_3_present
    SR_CFG_PRESENCE_FARC
      data CFG_PRESENCE_FARC: type=t_cFARC_0, init-value=CONST_t_cFARC_0_0:0  # Indique si le véhicule est équipé de la option FARC (Frein Automatique sur Risque de Collision) ENUM 0 "FARC absent" cFARC_absent ENUM 1 "FARC présent" cFARC_present ENUM 2 "FARC urbain présent" cFARC_U_present ENUM 3 "FARC 2" cFARC_2_present ENUM 4 "FARC 3" cFARC_3_present
    SR_CFG_PRESENCE_MENU_PERSO
      data CFG_PRESENCE_MENU_PERSO: type=tBYTE, init-value=CONST_tBYTE_0:0  # Présence et type de menu de personnalisation ENUM 0 "Menu absent" ENUM 1 "Menu présent"
    SR_CFG_PRESENCE_TO
      data CFG_PRESENCE_TO: type=t_CFG_PRESENCE_TO, init-value=CONST_t_CFG_PRESENCE_TO_0:0  # Indique le nombre de TO présent(s) dans le véhicule 0: Absence de TO 1: Présence d'un TO 2: Présence de deux TO 3: Présence de trois TO ENUM 0 "Absence de TO" ENUM 1 "Présence d'un TO" ENUM 2 "Présence de deux TO" ENUM 3 "Présence de trois TO"
    SR_CFG_PRESENCE_TOUCHE_CONFIG
      data CFG_PRESENCE_TOUCHE_CONFIG: type=tLOG, init-value=CONST_tLOG_0:0  # Indique la présence de la touche de configuration pour le menu perso ENUM 0 "Touche de configuration absente" ENUM 1 "Touche de configuration présente"
    SR_CFG_TYPE_AAS
      data CFG_TYPE_AAS: type=t_cAAS, init-value=CONST_t_cAAS_0:0  # Définit la présence de l'Aide Au Stationnement (AAS) avant et arrière, ainsi que de la Mesure de Place Disponible (MPD), de l'Aide Visuel au Recul (AVR), du Stationnement automatique (CityPark) et de la Vision latérale Japon (VLJ). Définit également les calculateurs/capteurs associés. Champ de bits : 0 -> fonction absente 1 -> fonction présente CHPB_NUL "aucune fonction AAS présente" cAAS_Absent CHPB 0 "Présence de l'AAS arrière" cAAS_DOPAR CHPB 1 "Présence de l'AAS avant" cAAS_DOPAV CHPB 2 "Présence de la MPD par le calculteur AAS" cAAS_MPDparAAS CHPB 3 "Présence de la MPD par le calculteur SAM" cAAS_MPDparSAM CHPB 4 "Présence de l'AVR" cAAS_AVR CHPB 5 "Présence de la fonction CityPark" cAAS_CityPark CHPB 6 "Présence de la fonction CityPark, option AMSP" cAAS_CityPark_AMSP CHPB 7 "Présence de la fonction VLJ" cAAS_VLJ
    SR_CFG_TYPE_ACTIVATION_AFS
      data CFG_TYPE_ACTIVATION_AFS: type=tLOG, init-value=CONST_tLOG_0:0  # Permet de distinguer si on utilise le flux AFS (pour BYOM) ou AUTOROUTE (NAC/RCC)
    SR_CFG_TYPE_FSE
      data CFG_TYPE_FSE: type=t_cTypeFSE, init-value=CONST_t_cTypeFSE_0:0  # Indique si la sous fonction Freinage par FSE est disponible, et si oui la provenance des informations utilisée pour cette sous fonction. FSE: Frein Secondaire Electrique (ou Frein de Stationnement Electrique) ENUM 0 "Pas de FSE" cTypeFSE_Absent ENUM 1 "FSE par ESP sans étriers motorisés" cTypeFSE_ParESP ENUM 2 "FSE par FSE sans étriers motorisés" cTypeFSE_ParFSE ENUM 3 "FSE par ESP avec étriers motorisés" cTypeFSE_ParESP_EtriersMotorises
    SR_CFG_TYPE_FUNCTIONAL_ABSD
      data CFG_TYPE_FUNCTIONAL_ABSD: type=t_cTYPE_FUNCTIONAL_ABSD, init-value=CONST_t_cTYPE_FUNCTIONAL_ABSD_0:0  # Défini le type d'activation/désactivation de la fonction BSD (solution PSA ou EuroNCap) ENUM 0 "cTYPE_FUNCTIONAL_ABSD_EURONCAP" ENUM 1 "cTYPE_FUNCTIONAL_ABSD_PSA"
    SR_CFG_TYPE_REGLAGE_SELECTIVITE
      data CFG_TYPE_REGLAGE_SELECTIVITE: type=t_cGAV_Selectivite, init-value=CONST_t_cGAV_Selectivite_0:0  # Type de reglage de la selectivitéActivabilité de la fonction de sélectivité des portes (aucun réglage ou viaréglage le par menu de personnaliation ou push) ENUM 0 "Sélectivité non activable" cGAV_SelectiviteNonActivable ENUM 1 "Sélectivité activable par menu de personnalisaton" cGAV_SelectiviteActivableParMenu ENUM 2 "Sélectivité activable par push de deverouillage cabine Zone de charge" cGAV_SelectiviteActivableParPush
    SR_CFG_TYPE_SELECTIVITE
      data CFG_TYPE_SELECTIVITE: type=t_cTypeSelect, init-value=CONST_t_cTypeSelect_0:0  # Type de la sélectivite sur les serrures portes: 0: pas de sélectivité 1: sélectivité conducteur 2: sélectivité avant arrière ENUM 0 "aucune sélectivité" cTypeSelect_Aucune ENUM 1 "sélectivité porte conducteur" cTypeSelect_Conducteur ENUM 2 "sélectivité avant / arrière" cTypeSelect_AvantArriere
    SR_CFG_TYPE_SELECTIVITE_OUV_AR
      data CFG_TYPE_SELECTIVITE_OUV_AR: type=t_cTypeSelectOuvAR, init-value=CONST_t_cTypeSelectOuvAR_0:0  # Type de la sélectivite au plip sur l'ouvrant arrière 0: Absence de sélectivité de l'ouvrant arrière au plip 1: Présence de sélectivité de l'ouvrant arrière par éjection au plip de celui-ci sans déverrouillage global du véhicule 2: Présence de sélectivité de l'ouvrant arrière par déverrouillage au plip de celui-ci sans déverrouillage global du véhicule ENUM 0 "Absence de sélectivité de l'ouvrant arrière au plip" cTypeSelectOuvAR_Absente ENUM 1 "Présence de sélectivité de l'ouvrant arrière par éjection au plip de celui-ci sans déverrouillage global du véhicule" cTypeSelectOuvAR_EjectionSelect ENUM 2 "Présence de sélectivité de l'ouvrant arrière par déverrouillage au plip de celui-ci sans déverrouillage global du véhicule" cTypeSelectOuvAR_DeverrSelect
    SR_T28_APPUI_LONG_TOUCHE_CONF
      data T28_APPUI_LONG_TOUCHE_CONF: type=tBYTE, init-value=CONST_tBYTE_2:2  # Temporisation de detection d'un appui long sur la touche configurable Unité : s
    SR_T28_MAINTIEN_DONNEES_TOUCHE
      data T28_MAINTIEN_DONNEES_TOUCHE: type=t_T28_MAINTIEN_DONNEES_TOUCHE, init-value=CONST_t_T28_MAINTIEN_DONNEES_TOUCHE_500:500  # Durée de maintien des données levées suite détection appui touche configurable Unité : ms
    SR_CA7C_GESTION_MESSAGES_ANBC
      data CA7C_GESTION_MESSAGES_ANBC: type=tLOG, init-value=CONST_tLOG_1:1  # Description : Autorisation ou non de l'affichage des messages ANBC si BMF non presente. 0x0 = pas d'affichage 0x1 = affichage
    SR_CA7C_SEUIL_DETECTION_CEINT
      data CA7C_SEUIL_DETECTION_CEINT: type=tBYTE, init-value=CONST_tBYTE_20:20  # Seuil de détection d'un problème sur le contacteur de ceinture du conducteur
    SR_CA7C_SEUIL_ROULAGE
      data CA7C_SEUIL_ROULAGE: type=tBYTE, init-value=CONST_tBYTE_3:3  # Vitesse en dessous de laquelle on peut considèrer que le véhicule est quasiment à l'arrêt. (Res: Km/h)
    SR_CA7C_VITESSE_SEUIL_TNB_1
      data CA7C_VITESSE_SEUIL_TNB_1: type=tBYTE, init-value=CONST_tBYTE_20:20  # Vitesse au dessus de laquelle une alerte de niveau 1 (ALERTE_XXX_NIVEAU_1_DEBOUCLAGE) devient une alerte niveau 2 (Res: km/h)
    SR_CA7C_VITESSE_SEUIL_TNB_2
      data CA7C_VITESSE_SEUIL_TNB_2: type=tBYTE, init-value=CONST_tBYTE_20:20  # Vitesse au dessus de laquelle une alerte de niveau 1 (ALERTE_XXX_NIVEAU_1_NON_BOUCLAGE) devient une alerte niveau 2 (Res: km/h)
    SR_CA7C_VITESSE_SEUIL_TNB_MAR
      data CA7C_VITESSE_SEUIL_TNB_MAR: type=tBYTE, init-value=CONST_tBYTE_10:10  # Seuil de vitesse pour modifier le niveau d'une alerte en sortie de marche arrière
    SR_CFG_ACQUI_PRESENCE_PASS
      data CFG_ACQUI_PRESENCE_PASS: type=tLOG, init-value=CONST_tLOG_0:0  # Acquisitions distinctes ou non de la présence et du bouclage du passager avant ENUM 0 "Pas d'acquisition distincte de la présence et du bouclage du passager" ENUM 1 "Acquisition distincte de la présence et du bouclage du passager avant"
    SR_CFG_Barrette_TNB_sur_LIN
      data CFG_Barrette_TNB_sur_LIN: type=tLOG, init-value=CONST_tLOG_0:0  # Indique s'il existe une barrette TNB (Témoin de Non Bouclage) déportée sur le réseau LIN ENUM 0 "Barrette LIN absente" ENUM 1 "Barrette LIN présente"
    SR_CFG_DETECTION_PRES_NB_PAR2C
      data CFG_DETECTION_PRES_NB_PAR2C: type=tLOG, init-value=CONST_tLOG_0:0  # Indicates if the presence of each passenger on row 2 is detected or not - Presence de nappe de detection présent non bouclé pour passager rang 2 central ENUM 0 "absence de détection passager présent non bouclé" ENUM 1 "présence de détection passager présent non bouclé"
    SR_CFG_DETECTION_PRES_NB_PAR2D
      data CFG_DETECTION_PRES_NB_PAR2D: type=tLOG, init-value=CONST_tLOG_0:0  # Indicates if the presence of each passenger on row 2 is detected or not - Presence de nappe de detection présent non bouclé pour passager rang 2 droit ENUM 0 "absence de détection passager présent non bouclé" ENUM 1 "présence de détection passager présent non bouclé"
    SR_CFG_DETECTION_PRES_NB_PAR2G
      data CFG_DETECTION_PRES_NB_PAR2G: type=tLOG, init-value=CONST_tLOG_0:0  # Indicates if the presence of each passenger on row 2 is detected or not - Presence de nappe de detection présent non bouclé pour passager rang 2 gauche ENUM 0 "absence de détection passager présent non bouclé" ENUM 1 "présence de détection passager présent non bouclé"
    SR_CFG_DETECTION_PRES_NB_PAR3
      data CFG_DETECTION_PRES_NB_PAR3: type=tLOG, init-value=CONST_tLOG_0:0  # Indicates if the presence of each passenger on row 3 is detected or not - Presence de nappe de detection présent non bouclé pour passager rang 3 ENUM 0 "absence de détection passager présent non bouclé" ENUM 1 "présence de détection passager présent non bouclé"
    SR_CFG_INHIB_DIAG_TNB_COND
      data CFG_INHIB_DIAG_TNB_COND: type=tLOG, init-value=CONST_tLOG_0:0  # Inhibe la fonction de détection de non bouclage ceinture pour le conducteur ENUM 0 "pas d'inhibition" ENUM 1 "inhibition"
    SR_CFG_INHIB_DIAG_TNB_PAR2C
      data CFG_INHIB_DIAG_TNB_PAR2C: type=tLOG, init-value=CONST_tLOG_0:0  # Inhibe la fonction de détection de non bouclage ceinture pour le passager arrière central ENUM 0 "pas d'inhibition" ENUM 1 "inhibition"
    SR_CFG_INHIB_DIAG_TNB_PAR2D
      data CFG_INHIB_DIAG_TNB_PAR2D: type=tLOG, init-value=CONST_tLOG_0:0  # Inhibe la fonction de détection de non bouclage ceinture pour le passager arrière droit ENUM 0 "pas d'inhibition" ENUM 1 "inhibition"
    SR_CFG_INHIB_DIAG_TNB_PAR2G
      data CFG_INHIB_DIAG_TNB_PAR2G: type=tLOG, init-value=CONST_tLOG_0:0  # Inhibe la fonction de détection de non bouclage ceinture pour le passager arrière gauche ENUM 0 "pas d'inhibition" ENUM 1 "inhibition"
    SR_CFG_INHIB_DIAG_TNB_PAR3
      data CFG_INHIB_DIAG_TNB_PAR3: type=tLOG, init-value=CONST_tLOG_0:0  # Inhibe la fonction de détection de non bouclage ceinture pour les occupants arrières 3ème rang ENUM 0 "pas d'inhibition" ENUM 1 "inhibition"
    SR_CFG_INHIB_DIAG_TNB_PAV
      data CFG_INHIB_DIAG_TNB_PAV: type=tLOG, init-value=CONST_tLOG_0:0  # Inhibe la fonction de détection de non bouclage ceinture pour le passager avant ENUM 0 "pas d'inhibition" ENUM 1 "inhibition"
    SR_CFG_NAPPE_DETECTION_PASS
      data CFG_NAPPE_DETECTION_PASS: type=tLOG, init-value=CONST_tLOG_0:0  # Présence d'une nappe de détection passager avant ENUM 0 "absence de nappes de détection" ENUM 1 "présence nappes de détection"
    SR_CFG_NBR_CNB
      data CFG_NBR_CNB: type=t_CFG_NBR_CNB, init-value=CONST_t_CFG_NBR_CNB_0:0  # Nombre de Contacteur de Non Bouclage présent dans le véhicule
    SR_CFG_OPTION_PAVC_PRES_DETECTION
      data CFG_OPTION_PAVC_PRES_DETECTION: type=tLOG, init-value=CONST_tLOG_0:0  # Indicates if the presence of passenger on row 1 central is detected or not ENUM 0 "Absent" ENUM 1 "Present"
    SR_CFG_OPTION_TAXI
      data CFG_OPTION_TAXI: type=tLOG, init-value=CONST_tLOG_0:0  # Configuration taxi du véhicule ENUM 0 "hors taxi" ENUM 1 "configuration taxi"
    SR_CFG_PRESENCE_CLE_INHIB_RBG_PASS
      data CFG_PRESENCE_CLE_INHIB_RBG_PASS: type=tLOG, init-value=CONST_tLOG_0:0  # Présence d'une clef d'inhibition de l'airbag passager ENUM 0 "Pas de clef d'inhibition airbag passager" ENUM 1 "clef d'inhibition airbag passager présente"
    SR_CFG_PRESENCE_ECR
      data CFG_PRESENCE_ECR: type=t_cECR_A, init-value=CONST_t_cECR_A_0:0  # Présence de boîtier ECR (Enrouleur Ceinture Réversible) Champ de bits, par place. CHPB_NUL "Aucun ECR" cECR_Aucun CHPB 0 "Présence de l'ECR avant gauche" cECR_AVG CHPB 1 "Présence de l'ECR avant droit" cECR_AVD
    SR_CFG_PRESENCE_ISOFIX_AV
      data CFG_PRESENCE_ISOFIX_AV: type=tLOG, init-value=CONST_tLOG_0:0  # Présence d'une fixation ISOFIX sur le siège passager avant ENUM 0 "Pas d'ISOFIX avant" ENUM 1 "ISOFIX avant présent"
    SR_CFG_PRESENCE_MSG_ANBC_COND
      data CFG_PRESENCE_MSG_ANBC_COND: type=tLOG, init-value=CONST_tLOG_0:0  # Gestion d'un message en configuration un TNB pour le seul conducteur ENUM 0 "Pas de message avec le conducteur seul" ENUM 1 "Gestion d'un message pour le conducteur seul"
    SR_CFG_STEERING_WHEEL_POSITION
      data CFG_STEERING_WHEEL_POSITION: type=t_SteeringWheelPosition, init-value=CONST_CFG_STEERING_WHEEL_POSITION_t_SteeringWheelPosition_eSteeringWheelPosition_Invalid:0  # Indicate where is the steering wheel on the cokpit.
    SR_CFG_TYPE_ANBC
      data CFG_TYPE_ANBC: type=tLOG, init-value=CONST_tLOG_0:0  # Protocole EURONcap ANBC ENUM 0 "Protocole classique" ENUM 1 "Protocole 2009"
    SR_CFG_TYPE_CHAINE_TRACTION
      data CFG_TYPE_CHAINE_TRACTION: type=t_cTCT, init-value=CONST_t_cTCT_0:0  # Type de la chaine de traction ENUM 0 "Chaine de traction classique moteur thermique cTCT_MTH" ENUM 1 "Chaine de traction hybride HY cTCT_HY" ENUM 2 "Chaine de traction électrique cTCT_ELEC"
    SR_TA7C_BOUCLAGE_CEINT_COND
      data TA7C_BOUCLAGE_CEINT_COND: type=t_TA7C_BOUCLAGE_CEINT_COND, init-value=CONST_t_TA7C_BOUCLAGE_CEINT_COND_60:60  # Temps pendant lequel on attend une fermeture de la porte conducteur apres une décondamnation du véhicule.
    SR_TA7C_CONFIRM_DEBOUCLAGE_CEINT
      data TA7C_CONFIRM_DEBOUCLAGE_CEINT: type=tBYTE, init-value=CONST_tBYTE_1:1  # Tempo au delà de laquelle une ceinture est confirmée débouclée
    SR_TA7C_CONFIRM_OUVERTURE_PORTE
      data TA7C_CONFIRM_OUVERTURE_PORTE: type=tBYTE, init-value=CONST_tBYTE_1:1  # Tempo au delà de laquelle une porte est confirmée ouverte, en ms
    SR_TA7C_DUREE_FORCAGE_TEMOINS_ARR
      data TA7C_DUREE_FORCAGE_TEMOINS_ARR: type=tBYTE, init-value=CONST_tBYTE_30:30  # Durée de l'allumage forfaitaire (Res: sec) Cette donnée ne peut pas être nulle ! (sinon il n'y a pas d'allumage forfaitaire) Pour inhiber l'allumage forfaitaire il faut obligatoirement passer par CFG_INHIB_ALERTE_DEM_TNB_AR. Dès lors oÃ¹ CFG_INHIB_ALERTE_DEM_TNB_AR vaut 0 (présence d'un allumage forfaitaire) il est nécessaire de préciser une durée (valeur min : 1s)
    SR_TA7C_FORCAGE_MAX_TNB
      data TA7C_FORCAGE_MAX_TNB: type=tBYTE, init-value=CONST_tBYTE_30:30  # Lorsqu'aucun contacteur n'est present, cette DConf represente le temps pendant lequel le temoin conducteur doit être maintenu allume au passage en moteur tournant. Lorsqu'au moins un contacteur est present cette DConf n'est pas utile (Res: sec)
    SR_T_DUREE_SON_ANBC_NIV1
      data T_DUREE_SON_ANBC_NIV1: type=tBYTE, init-value=CONST_tBYTE_15:15  # Durée en secondes de l'alerte sonore ANBC de type \classic\ du niveau sonore 1.
    SR_T_DUREE_SON_ANBC_NIV1_PRIM
      data T_DUREE_SON_ANBC_NIV1_PRIM: type=tBYTE, init-value=CONST_tBYTE_0:0  # Durée en secondes de l'alerte sonore ANBC de type \loud and clear\ du niveau sonore 1.
    SR_T_DUREE_SON_ANBC_NIV2
      data T_DUREE_SON_ANBC_NIV2: type=tBYTE, init-value=CONST_tBYTE_15:15  # Durée en secondes de l'alerte sonore ANBC de type \classic\ du niveau sonore 2.
    SR_T_DUREE_SON_ANBC_NIV2_PRIM
      data T_DUREE_SON_ANBC_NIV2_PRIM: type=tBYTE, init-value=CONST_tBYTE_0:0  # Durée en secondes de l'alerte sonore ANBC de type \loud and clear\ du niveau sonore 2.
    SR_T_DUREE_SON_ANBC_NIV3
      data T_DUREE_SON_ANBC_NIV3: type=tBYTE, init-value=CONST_tBYTE_90:90  # Durée en secondes de l'alerte sonore ANBC de type \classic\ du niveau sonore 3 (si il n'y a pas de nouveau débouclage de ceinture détecté).
    SR_T_DUREE_SON_ANBC_NIV3_PRIM
      data T_DUREE_SON_ANBC_NIV3_PRIM: type=tBYTE, init-value=CONST_tBYTE_90:90  # Durée en secondes de l'alerte sonore ANBC de type \loud and clear\ du niveau sonore 3 (si il n'y a pas de nouveau débouclage de ceinture détecté).
    SR_TP7C_FILTRAGE_ABSENCE
      data TP7C_FILTRAGE_ABSENCE: type=t_TP7C_FILTRAGE_ABSENCE, init-value=CONST_t_TP7C_FILTRAGE_ABSENCE_0:0  # Durée de filtrage de l'entrée de présence du passager avant. La valeur max de ce paramètre selon le DAL est 16s. L'ASWC_P7C est séquencé à 100ms et la valeur max de TP7C_FILTRAGE_ABSENCE est donc 160 et on peut se contenter d'un BYTE
    SR_C7D1_ECART1_NIV
      data C7D1_ECART1_NIV: type=tWORD, init-value=CONST_tWORD_5:5  # Seuil de détection des apports suite à la comparaison par rapport au niveau brut ou temporaire Unités : [1 LSB = 1 litre] Doit être accessible en LID étude (R/W)
    SR_C7D1_ECART2_NIV
      data C7D1_ECART2_NIV: type=tWORD, init-value=CONST_tWORD_20:20  # Seuil de détection des apports suite à la comparaison par rapport au niveau affiché Unités : [1 LSB = 1 litre] Doit être accessible en LID étude (R/W)
    SR_C7D1_ECART3_NIV
      data C7D1_ECART3_NIV: type=tWORD, init-value=CONST_tWORD_10:10  # Seuil de détection des apports suite à la comparaison par rapport au niveau brut ou temporaire Unités : [1 LSB = 1 litre] Doit être accessible en LID étude (R/W)
    SR_C7D1_NB_ACQ_CONFIRM_ETAT_JAUGE
      data C7D1_NB_ACQ_CONFIRM_ETAT_JAUGE: type=tBYTE, init-value=CONST_tBYTE_8:8  # Nbre d'acquisition à réaliser pour confirmer un défaut de jauge Cette valeur doit être couplée à la période d'échantillonnage de la jauge pour donner une confirmation en [sec] : exemple 8 acquisitions de avec un échantillonnage tous les 250msec correspondra à une confirmations de 2sec
    SR_C7D1_NCarb00
      data C7D1_NCarb00: type=tBYTE, init-value=CONST_tBYTE_0:0  # Table de jaugeage carburant
    SR_C7D1_NCarb01
      data C7D1_NCarb01: type=tBYTE, init-value=CONST_tBYTE_0:0  # Table de jaugeage carburant
    SR_C7D1_NCarb02
      data C7D1_NCarb02: type=tBYTE, init-value=CONST_tBYTE_0:0  # Table de jaugeage carburant
    SR_C7D1_NCarb03
      data C7D1_NCarb03: type=tBYTE, init-value=CONST_tBYTE_0:0  # Table de jaugeage carburant
    SR_C7D1_NCarb04
      data C7D1_NCarb04: type=tBYTE, init-value=CONST_tBYTE_0:0  # Table de jaugeage carburant
    SR_C7D1_NCarb05
      data C7D1_NCarb05: type=tBYTE, init-value=CONST_tBYTE_0:0  # Table de jaugeage carburant
    SR_C7D1_NCarb06
      data C7D1_NCarb06: type=tBYTE, init-value=CONST_tBYTE_0:0  # Table de jaugeage carburant
    SR_C7D1_NCarb07
      data C7D1_NCarb07: type=tBYTE, init-value=CONST_tBYTE_0:0  # Table de jaugeage carburant
    SR_C7D1_NCarb08
      data C7D1_NCarb08: type=tBYTE, init-value=CONST_tBYTE_0:0  # Table de jaugeage carburant
    SR_C7D1_NCarb09
      data C7D1_NCarb09: type=tBYTE, init-value=CONST_tBYTE_0:0  # Table de jaugeage carburant
    SR_C7D1_NCarb10
      data C7D1_NCarb10: type=tBYTE, init-value=CONST_tBYTE_0:0  # Table de jaugeage carburant
    SR_C7D1_NCarb11
      data C7D1_NCarb11: type=tBYTE, init-value=CONST_tBYTE_0:0  # Table de jaugeage carburant
    SR_C7D1_NCarb12
      data C7D1_NCarb12: type=tBYTE, init-value=CONST_tBYTE_0:0  # Table de jaugeage carburant
    SR_C7D1_NCarb13
      data C7D1_NCarb13: type=tBYTE, init-value=CONST_tBYTE_0:0  # Table de jaugeage carburant
    SR_C7D1_NCarb14
      data C7D1_NCarb14: type=tBYTE, init-value=CONST_tBYTE_0:0  # Table de jaugeage carburant
    SR_C7D1_NCarb15
      data C7D1_NCarb15: type=tBYTE, init-value=CONST_tBYTE_0:0  # Table de jaugeage carburant
    SR_C7D1_RCarb01
      data C7D1_RCarb01: type=tWORD, init-value=CONST_tWORD_0:0  # Table de jaugeage carburant
    SR_C7D1_RCarb02
      data C7D1_RCarb02: type=tWORD, init-value=CONST_tWORD_0:0  # Table de jaugeage carburant
    SR_C7D1_RCarb03
      data C7D1_RCarb03: type=tWORD, init-value=CONST_tWORD_0:0  # Table de jaugeage carburant
    SR_C7D1_RCarb04
      data C7D1_RCarb04: type=tWORD, init-value=CONST_tWORD_0:0  # Table de jaugeage carburant
    SR_C7D1_RCarb05
      data C7D1_RCarb05: type=tWORD, init-value=CONST_tWORD_0:0  # Table de jaugeage carburant
    SR_C7D1_RCarb06
      data C7D1_RCarb06: type=tWORD, init-value=CONST_tWORD_0:0  # Table de jaugeage carburant
    SR_C7D1_RCarb07
      data C7D1_RCarb07: type=tWORD, init-value=CONST_tWORD_0:0  # Table de jaugeage carburant
    SR_C7D1_RCarb08
      data C7D1_RCarb08: type=tWORD, init-value=CONST_tWORD_0:0  # Table de jaugeage carburant
    SR_C7D1_RCarb09
      data C7D1_RCarb09: type=tWORD, init-value=CONST_tWORD_0:0  # Table de jaugeage carburant
    SR_C7D1_RCarb10
      data C7D1_RCarb10: type=tWORD, init-value=CONST_tWORD_0:0  # Table de jaugeage carburant
    SR_C7D1_RCarb11
      data C7D1_RCarb11: type=tWORD, init-value=CONST_tWORD_0:0  # Table de jaugeage carburant
    SR_C7D1_RCarb12
      data C7D1_RCarb12: type=tWORD, init-value=CONST_tWORD_0:0  # Table de jaugeage carburant
    SR_C7D1_RCarb13
      data C7D1_RCarb13: type=tWORD, init-value=CONST_tWORD_0:0  # Table de jaugeage carburant
    SR_C7D1_RCarb14
      data C7D1_RCarb14: type=tWORD, init-value=CONST_tWORD_0:0  # Table de jaugeage carburant
    SR_C7D1_RESIST_BOUCH_FERME
      data C7D1_RESIST_BOUCH_FERME: type=tWORD, init-value=CONST_tWORD_900:900  # Seuil de résistance correspondant à l'impédance du bouchon fermé Unités : [1 LSB = 1 Ohm]
    SR_C7D1_RESIST_BOUCH_INV
      data C7D1_RESIST_BOUCH_INV: type=tWORD, init-value=CONST_tWORD_500:500  # Seuil de résistance correspondant à l'impédance du bouchon invalide Unités : [1 LSB = 1 Ohm]
    SR_C7D1_RESIST_BOUCH_OUV
      data C7D1_RESIST_BOUCH_OUV: type=tWORD, init-value=CONST_tWORD_100:100  # Seuil de résistance correspondant à l'impédance du bouchon ouvert Unités : [1 LSB = 1 Ohm]
    SR_C7D1_RESIST_MASSE
      data C7D1_RESIST_MASSE: type=tWORD, init-value=CONST_tWORD_0:0  # Seuil de résistance correspondant à l'impédance du bouchon à la masse Unités : [1 LSB = 1 Ohm]
    SR_C7D1_SEUIL_MAXI_RCARB
      data C7D1_SEUIL_MAXI_RCARB: type=tWORD, init-value=CONST_tWORD_350:350  # Seuil de résistance pour diagnostiquer la jauge en défaut CO Unités : [1 LSB = 2 Ohms]
    SR_C7D1_SEUIL_MINI_RCARB
      data C7D1_SEUIL_MINI_RCARB: type=tBYTE, init-value=CONST_tBYTE_50:50  # Seuil de résistance pour diagnostiquer la jauge en défaut CCM Unités : [1 LSB = 2 Ohms]
    SR_C7D1_SEUIL_VITESSE_NULLE
      data C7D1_SEUIL_VITESSE_NULLE: type=tWORD, init-value=CONST_tWORD_3:3  # Seuil de vitesse en dessous duquel la vitesse est considérée nulle Unités : [1 LSB = 1 Km/h] Doit être accessible en LID étude (R/W)
    SR_CFG_AUTOR_MAP_JCA
      data CFG_AUTOR_MAP_JCA: type=tLOG, init-value=CONST_tLOG_0:0  # Autorisation de l emission des trames MAP_JCA ENUM 0 "emission non autorise" ENUM 1 "emission autorise"
    SR_CFG_CAPACITE_RESERVOIR
      data CFG_CAPACITE_RESERVOIR: type=tBYTE, init-value=CONST_tBYTE_50:50  # Donne la capacité maximum du réservoir
    SR_CFG_CAPA_RESERVOIR_PLEIN
      data CFG_CAPA_RESERVOIR_PLEIN: type=tWORD, init-value=CONST_tWORD_80:80  # Valeur de la résistance dans la table d'interpolation correspondant à un réservoir plein
    SR_CFG_CAPA_RESERVOIR_VIDE
      data CFG_CAPA_RESERVOIR_VIDE: type=tWORD, init-value=CONST_tWORD_320:320  # Valeur de la résistance dans la table d'interpolation correspondant à un réservoir vide
    SR_CFG_DETECT_APPORT_PAR_MVT
      data CFG_DETECT_APPORT_PAR_MVT: type=tLOG, init-value=CONST_tLOG_0:0  # Choix de l'agorithme de détection des apports carburant avec prise en compte ou non de l'information mouvement du véhiucle. ENUM 0 "Mouvement véhicule non pris en compte" ENUM 1 "Mouvement véhicule pris en compte"
    SR_CFG_NB_MAX_TABLE_JC
      data CFG_NB_MAX_TABLE_JC: type=tBYTE, init-value=CONST_tBYTE_15:15  # Nombre maximum des cartographies de jaugeage carburant
    SR_CFG_NUM_TABLE_CARB
      data CFG_NUM_TABLE_CARB: type=tBYTE, init-value=CONST_tBYTE_255:255  # Numéro de la table de corespondance impédance <-> niveau pour le jaugeage de carburant C22_NumTablme pour l'ancien jaugeage dans le code du lot 22 CFG_NUM_TABLE_CARB pour le nouveau jaugeage exclusivement
    SR_CFG_TYPE_CAPTEUR_BOUCHON_CARB
      data CFG_TYPE_CAPTEUR_BOUCHON_CARB: type=t_cCaptBouchon, init-value=CONST_t_cCaptBouchon_0:0  # Localisation de la connexion du capteur Bouchon Carburant ENUM 0 "Pas de capteur bouchon carburant" cCaptBouchon_Aucun ENUM 1 "Capteur Bouchon connecté au boîtier ADDGO" cCaptBouchon_DansADDGO ENUM 2 "Capteur Bouchon connecté au BSI" cCaptBouchon_DansBSI
    SR_T7D1_BASE_TEMPS_ACQUISITION
      data T7D1_BASE_TEMPS_ACQUISITION: type=tWORD, init-value=CONST_tWORD_250:250  # Période d'acquisition de la jauge carburant Unités : [msec]
    SR_T7D1_DETECTION_DEFAUT_MVMT_VHL
      data T7D1_DETECTION_DEFAUT_MVMT_VHL: type=tBYTE, init-value=CONST_tBYTE_2:2  # Temporisation pour confirmer la présence du défaut mouvement véhicule
    SR_T7D1_DUREE_CONFIRM_ETAT_ELEC_BOUCHON
      data T7D1_DUREE_CONFIRM_ETAT_ELEC_BOUCHON: type=tBYTE, init-value=CONST_tBYTE_2:2  # Durée de confirmation de l'état électrique (défaut ou non) du capteur bouchon Unités : [1 LSB = 1 sec]
    SR_T7D1_DUREE_CONFIRM_ETAT_OUBLI_BOUCHON
      data T7D1_DUREE_CONFIRM_ETAT_OUBLI_BOUCHON: type=tBYTE, init-value=CONST_tBYTE_2:2  # Durée de confirmation du défaut oubli bouchon Unités : [1LSB = 1sec]
    SR_T7D1_DUREE_FLAG_DETECTION_APPORT
      data T7D1_DUREE_FLAG_DETECTION_APPORT: type=tBYTE, init-value=CONST_tBYTE_1:1  # Durée de levée du flag de détection des apports (principalement pour les échanges avec les lots 222 et 725) Unités : [1 LSB = 1sec]
    SR_T7D1_TEMPO_FILTRAGE_ALIME
      data T7D1_TEMPO_FILTRAGE_ALIME: type=tWORD, init-value=CONST_tWORD_500:500  # Temporisation de filtrage de l'alimentation +CAN Unités : [msec]
    SR_T7D1_TEMPO_MAJ_NIV_TEMP
      data T7D1_TEMPO_MAJ_NIV_TEMP: type=tBYTE, init-value=CONST_tBYTE_2:2  # Période d'acquisition du niveau brut pour créer le niveau temporaire Unités : [1 LSB = 1sec] Doit être accessible en LID étude (R/W)
    SR_T7D1_TEMPO_STAB_CARB
      data T7D1_TEMPO_STAB_CARB: type=tBYTE, init-value=CONST_tBYTE_15:15  # Durée de stabilisation du niveau de carburant dans le réservoir Unités : [1 LSB = 1sec] Doit être accessible en LID étude (R/W)
    SR_C7D2_DeltaRelIhmMiniCarb1
      data C7D2_DeltaRelIhmMiniCarb1: type=t_C7D2_DeltaRelIhmMiniCarb1, init-value=CONST_t_C7D2_DeltaRelIhmMiniCarb1_50:50  # Unité : 1 LSB = 0.1L description : premier décrément de clignotement du voyant mini carburant
    SR_C7D2_DeltaRelIhmMiniCarb2
      data C7D2_DeltaRelIhmMiniCarb2: type=t_C7D2_DeltaRelIhmMiniCarb2, init-value=CONST_t_C7D2_DeltaRelIhmMiniCarb2_25:25  # Unité : 1LSB = 0,1l Description : deuxième décrément de clignotement du voyant mini carburant
    SR_C7D2_DeltaRelIhmMiniGPL1
      data C7D2_DeltaRelIhmMiniGPL1: type=tBYTE, init-value=CONST_tBYTE_50:50  # Unité : 1 LSB = 0,01L description : premier décrément de clignotement du voyant mini carburant
    SR_C7D2_DeltaRelIhmMiniGPL2
      data C7D2_DeltaRelIhmMiniGPL2: type=tBYTE, init-value=CONST_tBYTE_25:25  # Unité : 1 LSB = 0,01L description : deuxieme décrément de clignotement du voyant mini carburant
    SR_C7D2_HYST_ALRT_GPL
      data C7D2_HYST_ALRT_GPL: type=t_C7D2_HYST_ALRT_GPL, init-value=CONST_t_C7D2_HYST_ALRT_GPL_2:2  # Hystérésis pour Alert Mini GPL; en %
    SR_C7D2_INCREMENT_QUANTITE
      data C7D2_INCREMENT_QUANTITE: type=tBYTE, init-value=CONST_tBYTE_37:37  # Quantité ajouté ou soustrait du niveau lissé périodiquement Unités : [1 LSB = 0.01 litre]
    SR_C7D2_LOW_FUEL_ALERT_REPEAT
      data C7D2_LOW_FUEL_ALERT_REPEAT: type=tLOG, init-value=CONST_tLOG_0:0  # Indicates if the low fuel alerts are repeated or not, as the fuel level decreases while driving
    SR_C7D2_NivZero
      data C7D2_NivZero: type=tBYTE, init-value=CONST_tBYTE_0:0  # Unité : 1L description : correspond au niveau zéro de carburant restant
    SR_C7D2_OPTION_LOW_LPG_ALERT
      data C7D2_OPTION_LOW_LPG_ALERT: type=t_cPosIdent, init-value=CONST_C7D2_OPTION_LOW_LPG_ALERT_t_cPosIdent_cPosIdent_Absent:0  # Presence of the Low LPG alert message in the cockpit. If not present, Low fuel alert message will be used instead.
    SR_C7D2_PONDERATION_1_DEBIT
      data C7D2_PONDERATION_1_DEBIT: type=tBYTE, init-value=CONST_tBYTE_18:18  # Coefficient de pondération pour la mise à jour du calcul du niveau affiché Unités : [1 LSB = 0.01 litre]
    SR_C7D2_PONDERATION_2_DEBIT
      data C7D2_PONDERATION_2_DEBIT: type=tBYTE, init-value=CONST_tBYTE_7:7  # Coefficient de pondération pour la mise à jour du calcul du niveau affiché Unités : [1 LSB = 0.01 litre]
    SR_C7D2_PONDERATION_DEFAUT_DEBIT
      data C7D2_PONDERATION_DEFAUT_DEBIT: type=tBYTE, init-value=CONST_tBYTE_13:13  # Coefficient de pondération pour la mise à jour du calcul du niveau affiché Unités : [1 LSB = 0.01 litre]
    SR_C7D2_QTE_CARB_SEUIL
      data C7D2_QTE_CARB_SEUIL: type=tWORD, init-value=CONST_tWORD_1250:1250  # Seuil de cumul du carburant consommé avant la mise à jour du niveau affiché Unités : [1 LSB = 80mm3]
    SR_C7D2_VOLUME_SOUSTRAIT_CARB
      data C7D2_VOLUME_SOUSTRAIT_CARB: type=tBYTE, init-value=CONST_tBYTE_0:0  # Niveau de précaution retranché au niveau de carburant brut lors de la réinitialisation des niveaux affiché (interne) et lissé Unités : [1 LSB = 0.5 litre]
    SR_C7D_NIV_CARB_CRITIQUE
      data C7D_NIV_CARB_CRITIQUE: type=t_C7D_NIV_CARB_CRITIQUE, init-value=CONST_t_C7D_NIV_CARB_CRITIQUE_4:4  # Le seuil critique du carburant restant à partir duquel on fait clignoter le voyant mini carburant.
    SR_C7D_NIV_GPL_CRITIQUE
      data C7D_NIV_GPL_CRITIQUE: type=tBYTE, init-value=CONST_tBYTE_7:7  # Niveau de GAZ seuil critique en dessous duquel une alerte est générée. Conversion : 1 LSB = 1%
    SR_CFG_NIV_ALERTE_MINI_CARB
      data CFG_NIV_ALERTE_MINI_CARB: type=tBYTE, init-value=CONST_tBYTE_20:20  # Niveau de carburant seuil en dessous duquel une alerte est générée. Conversion : 1 LSB = 0.5 litre
    SR_CFG_NIV_ALERTE_MINI_GPL
      data CFG_NIV_ALERTE_MINI_GPL: type=tBYTE, init-value=CONST_tBYTE_16:16  # Niveau de GAZ seuil en dessous duquel une alerte est générée. Conversion : 1 LSB = 1%
    SR_CFG_PRESENCE_GAZ
      data CFG_PRESENCE_GAZ: type=tLOG, init-value=CONST_tLOG_0:0  # Indique la présence d'un équipement GAZ ENUM 0 "équipement GAZ absent" ENUM 1 "équipement GAZ présent"
    SR_CFG_TYPE_GPL_IHM
      data CFG_TYPE_GPL_IHM: type=t_cIHM, init-value=CONST_t_cIHM_0:0  # Indiquer le type d'IHM pour GPL ENUM 0 "without" cIHM_without ENUM 1 "current" cIHM_currentAutonomy ENUM 2 "TOTAL" cIHM_totalAutonomy
    SR_T7D2_DeltaRelIhmMiniCarbZero
      data T7D2_DeltaRelIhmMiniCarbZero: type=t_T7D2_DeltaRelIhmMiniCarbZero, init-value=CONST_t_T7D2_DeltaRelIhmMiniCarbZero_60:60  # Période de clignotement du voyant mini carburant quand le niveau carburant restant atteint zero
    SR_T7D2_DUREE_MIN_PUSH_GPL
      data T7D2_DUREE_MIN_PUSH_GPL: type=tBYTE, init-value=CONST_tBYTE_10:10  # Valeur de la temporisation pour le filtre RUNA à 50ms
    SR_T7D2_FAILURE_PUSH_GPL
      data T7D2_FAILURE_PUSH_GPL: type=t_T7D2_FAILURE_PUSH_GPL, init-value=CONST_t_T7D2_FAILURE_PUSH_GPL_20:20  # Valeur de la temporisation pour failure, RUNA à 50ms
    SR_T7D2_FILTRE_LED_GPL
      data T7D2_FILTRE_LED_GPL: type=tBYTE, init-value=CONST_tBYTE_20:20  # Temps de push sortir LED Valeur de la temporisation pour le filtre du LED RUNA à 50ms
    SR_T7D2_FILTRE_PUSH_GPL
      data T7D2_FILTRE_PUSH_GPL: type=tBYTE, init-value=CONST_tBYTE_20:20  # Valeur de la temporisation pour le filtre RUNA à 50ms
    SR_T7D2_TEMPO_FILTRAGE_IHM_MINICARB
      data T7D2_TEMPO_FILTRAGE_IHM_MINICARB: type=t_T7D2_TEMPO_FILTRAGE_IHM_MINICARB, init-value=CONST_t_T7D2_TEMPO_FILTRAGE_IHM_MINICARB_10:10  # Valeur de la temporisation de filtrage de la séquence de démarrage de l'IHM Unités : [ 1LSB = 1sec]
    SR_T7D2_TEMPO_LISSAGE
      data T7D2_TEMPO_LISSAGE: type=tBYTE, init-value=CONST_tBYTE_22:22  # Valeur de la temporisation pour le filtre du lissage du niveau brut Unités : [1 LSB = 1sec]
    SR_C7D3_VITESSE_SEUIL_ROULAGE
      data C7D3_VITESSE_SEUIL_ROULAGE: type=tBYTE, init-value=CONST_tBYTE_3:3  # Vitesse minimal à prendre en compte pour considérer un vitesse non nulle Unité : Km/h NON TELECODABLE
    SR_CFG_TYPE_FAP
      data CFG_TYPE_FAP: type=t_cFAP, init-value=CONST_t_cFAP_0:0  # Type de l'ARCHItecture organique pour assurer la gestion du Filtre à Particules ENUM 0 "Pas de Filtre à Particule" cFAP_Absent ENUM 1 "ARCHItecture type CMM : le CMM pilote la pompe d'additivation filaire" cFAP_PompeFilaire ENUM 2 "ARCHItecture type Pompe Mux : le BSI pilote la pompe d'additivation connectée en LIN1.3" cFAP_PompeMux13 ENUM 3 "ARCHItecture type Pompe Mux : le BSI pilote la pompe d'additivation connectée en LIN2.1" cFAP_PompeMux21 ENUM 4 "ARCHItecture type FAP non additivé" cFAP_NonAdditive
    SR_CFG_TYPE_SC
      data CFG_TYPE_SC: type=t_cTypeSC_Euro, init-value=CONST_CFG_TYPE_SC_t_cTypeSC_Euro_cTypeSC_Euro6:2  # Type de génération de structure couple ENUM 0 "EURO4" cTypeSC_Euro4 ENUM 1 "EURO5" cTypeSC_Euro5 ENUM 2 "EURO6" cTypeSC_Euro6 ENUM 3 "EURO6.1" cTypeSC_Euro6_1 ENUM 4 "EURO6.2" cTypeSC_Euro6_2 ENUM 5 "EURO6.3" cTypeSC_Euro6_3
    SR_T7D3_TEMPO_SEUIL_VITESSE
      data T7D3_TEMPO_SEUIL_VITESSE: type=tBYTE, init-value=CONST_tBYTE_5:5  # Temps au dela duquel on considere le vehicule n'est plus a l'arret, lorsque la vitesse du véhicule est supérieure au seuil de vitesse, pour s'affranchir des aléas de détection d'apport Unité : secondes NON TELECODABLE
    SR_IndexTableInPartition
      data IndexVIT_LVV: type=uint8
      data IndexPrecond: type=uint8
      data IndexTempo_Histo: type=uint8
    SR_CFG_DEFAUT_RELAIS_APC
      data CFG_DEFAUT_RELAIS_APC: type=tLOG, init-value=CONST_tLOG_0:0  # 0 : Défaut non géré 1 : Défaut géré
    SR_CFG_PRESENCE_BPGA
      data CFG_PRESENCE_BPGA: type=tLOG, init-value=CONST_tLOG_0:0  # Caractérise la présence d'un BPGA (Boitier de protection et de gestion des alimentations). ENUM 0 "BPGA absent" ENUM 1 "BPGA présent"
    SR_CFG_TYPE_HY
      data CFG_TYPE_HY: type=t_H, init-value=CONST_t_H_0:0  # Indique le type d'hybride équipant le véhicule ENUM 0 "HY PHASE 1" ENUM 1 "HY PHASE 2" ENUM 2 "HY E35" ENUM 3 "HY4PREMIUM" ENUM 4 "PHEV"
    SR_CFG_CSM_FORCE_OLD_RANDOM
      data CFG_CSM_FORCE_OLD_RANDOM: type=tLOG, init-value=CONST_tLOG_1:1  # Débrayage du nouvel algorithme de random pour forcer l’utilisation de l’ancien random (hebergé dans le CSM). A mettre à 0 pour les projets ADML 2.X, mais remettre à 1 si le random pose des problémes / défauts BSI.
package /Pack_sw_Types
  114 x impl type, all with category=VALUE:
    t_C28_VAL_CONS_VIT_LVV_MIN: base-type=uint8
    t_C28_VAL_CONS_VIT_LVV_MIN_MILES: base-type=uint8
    t_C28_VAL_CONS_VIT_RVV_MIN: base-type=uint8
    t_C28_VAL_CONS_VIT_RVV_MIN_MILES: base-type=uint8
    t_cAAS: base-type=uint8, compu {0x00=cAAS_Absent, 0x01=cAAS_DOPAR, 0x02=cAAS_DOPAV, 0x04=cAAS_MPDparAAS, 0x08=cAAS_MPDparSAM, 0x10=cAAS_AVR, 0x20=cAAS_CityPark, 0x40=cAAS_CityPark_AMSP, 0x80=cAAS_VLJ}
    t_cAccomp: base-type=uint8, compu {0=cAccomp_Desactive, 1=cAccomp_15s, 2=cAccomp_30s, 3=cAccomp_60s}
    t_cARC_0: base-type=uint8, compu {0=cARC_absent, 1=cARC_present, 2=cARC_2_present, 3=cARC_3_present}
    t_cCANLS: base-type=uint8, compu {0x00=cCANLS_VEILLE, 0x01=cCANLS_NORMAL, 0x02=cCANLS_MISE_EN_VEILLE, 0x03=cCANLS_REVEIL, 0x04=cCANLS_COMOFF}
    t_cDAE: base-type=uint8, compu {0=cDAE_SPORT, 1=cDAE_NORMAL}
    t_cDeconda: base-type=uint8, compu {0=cDeconda_Desactive, 1=cDeconda_15s, 2=cDeconda30s, 3=cDeconda_60s}
    t_cFARC_0: base-type=uint8, compu {0=cFARC_absent, 1=cFARC_present, 2=cFARC_U_present, 3=cFARC_2_present, 4=cFARC_3_present}
    t_CFG_INIT_ECL_AMBI_NIV: base-type=uint8
    t_CFG_INIT_HARMONIE_SON: base-type=uint8
    t_CFG_INIT_LANGUE_VHL: base-type=uint8
    t_CFG_INIT_MENU_HC_END: base-type=uint16
    t_CFG_INIT_MENU_HC_START: base-type=uint16
    t_CFG_INIT_MENU_PRG_PEM_DI: base-type=uint16
    t_CFG_INIT_MENU_PRG_PEM_JE: base-type=uint16
    t_CFG_INIT_MENU_PRG_PEM_LU: base-type=uint16
    t_CFG_INIT_MENU_PRG_PEM_MA: base-type=uint16
    t_CFG_INIT_MENU_PRG_PEM_ME: base-type=uint16
    t_CFG_INIT_MENU_PRG_PEM_SA: base-type=uint16
    t_CFG_INIT_MENU_PRG_PEM_VE: base-type=uint16
    t_CFG_INIT_PRV_MODE: base-type=uint8
    t_CFG_INIT_RESERVE_ZEV: base-type=uint8
    t_CFG_INIT_SENS_ARC_NIV: base-type=uint8
    t_CFG_INIT_TCFG: base-type=uint8
    t_CFG_INIT_TEMPO_ACCOMP: base-type=uint8
    t_CFG_INIT_TEMPO_DECONDA: base-type=uint8
    t_CFG_PRESENCE_TO: base-type=uint8
    t_cFTCG: base-type=uint8, compu {0=cFTCG_Plafonnier, 1=cFTCG_BlackPanel, 2=cFTCG_AccesJDA, 3=cFTCG_PersoCMB, 4=cFTCG_ColorisationCMB, 5=cFTCG_CheckAlertes}
    t_cGAV_Selectivite: base-type=uint8, compu {0=cGAV_SelectiviteNonActivable, 1=cGAV_SelectiviteActivableParMenu, 2=cGAV_SelectiviteActivableParPush}
    t_cTypeFSE: base-type=uint8, compu {0=cTypeFSE_Absent, 1=cTypeFSE_ParESP, 2=cTypeFSE_ParFSE, 3=cTypeFSE_ParESP_EtriersMotorises}
    t_cTYPE_FUNCTIONAL_ABSD: base-type=uint8, compu {1=cTYPE_FUNCTIONAL_ABSD_PSA, 0=cTYPE_FUNCTIONAL_ABSD_EURONCAP}
    t_cTypeSelect: base-type=uint8, compu {0=cTypeSelect_Aucune, 1=cTypeSelect_Conducteur, 2=cTypeSelect_AvantArriere}
    t_cTypeSelectOuvAR: base-type=uint8, compu {0=cTypeSelectOuvAR_Absente, 1=cTypeSelectOuvAR_EjectionSelect, 2=cTypeSelectOuvAR_DeverrSelect}
    t_SEV: base-type=uint8, compu {0x69=SEV_Arret, 0x96=SEV_Contact, 0x3C=SEV_Demarreur}
    t_SurvGestToucheConfig: base-type=uint8, compu {0=cAttenteAppui, 1=cKelTypeDappui, 2=cUnAppuiCourt, 3=cUnAppuiLong, 4=cUnAppuiDefaut}
    t_T28_MAINTIEN_DONNEES_TOUCHE: base-type=uint16
    Dem_DebounceResetStatusType: base-type=uint8
    Dem_EventIdType: base-type=uint16
    Dem_EventStatusType: base-type=uint8
    t_ALE: base-type=uint16, compu {0=cALE_DefautDIRARouge, 1=cALE_DefautDIRAOrange, 2=cALE_DefautREF, 3=cALE_NiveauLHM, 4=cALE_PressionHuile, 5=cALE_RoueARDCrevee, 6=cALE_RoueARGCrevee, 7=cALE_RoueAVDCrevee, 8=cALE_RoueAVGCrevee, 9=cALE_RoueARDDegonflee, 10=cALE_RoueARGDegonflee, 11=cALE_RoueAVDDegonflee, 12=cALE_RoueAVGDegonflee, 13=cALE_DefautDSG, 14=cALE_RoueARDNonSurv, 15=cALE_RoueARGNonSurv, 16=cALE_RoueAVDNonSurv, 17=cALE_RoueAVGNonSurv, 18=cALE_Teau, 19=cALE_RegulationASRCDS, 20=cALE_DefautCDS, 21=cALE_InhibitionCDS, 22=cALE_NotInhibitionCDS, 23=cALE_OuvrantsCoffreVitSup, 24=cALE_OuvrantsLunetteVitSup, 25=cALE_OuvrantsARDVitSup, 26=cALE_OuvrantsARGVitSup, 27=cALE_OuvrantsAVDVitSup, 28=cALE_OuvrantsAVGVitSup, 29=cALE_OuvrantsCoffreVitInf, 30=cALE_OuvrantsLunetteVitInf, 31=cALE_OuvrantsARDVitInf, 32=cALE_OuvrantsARGVitInf, 33=cALE_OuvrantsAVDVitInf, 34=cALE_OuvrantsAVGVitInf, 35=cALE_DefautFctFSE, 36=cALE_FRPKAutoSerre, 37=cALE_FRPKAutoDesserre, 38=cALE_OubliFreinParking, 39=cALE_ModeEclairageAuto, 40=cALE_NotModeEclairageAuto, 41=cALE_ModeEssvAuto, 42=cALE_NotModeEssvAuto, 43=cALE_EtatSportAMVAR, 44=cALE_NotEtatSportAMVAR, 45=cALE_CondaEnRoulant, 46=cALE_NotCondaEnRoulant, 47=cALE_SecuriteEnfant, 48=cALE_NotSecuriteEnfant, 49=cALE_MPDPlaceDifficile, 50=cALE_MPDPlaceNonConseille, 51=cALE_MPDPlaceFacile, 52=cALE_PilePlipHFUsee, 53=cALE_AlerteCeintureAVPass, 54=cALE_AlerteCeintureAVCond, 55=cALE_DdeAlerteCeintAR2G, 56=cALE_DdeAlerteCeintAR2M, 57=cALE_DdeAlerteCeintAR2D, 58=cALE_DdePresEtatCeintAR2C, 59=cALE_DdePresEtatCeintAR2D, 60=cALE_DdePresEtatCeintAR2G, 61=cALE_AlerteEauDansGazole, 62=cALE_NiveauEauMoteur, 63=cALE_MiniCarburant, 64=cALE_DdeSignalPlaquettes, 65=cALE_TrspNonIdent, 66=cALE_DefautABS, 67=cALE_DefautGmpG3, 68=cALE_FortsRatesComb_MIL, 69=cALE_RisquesColmatageFAP, 70=cALE_DefautRBAGGeneral, 71=cALE_DESPCPDefaut, 72=cALE_DefautBV, 73=cALE_DefautSystTE, 74=cALE_ManoeuvreTENonTerm, 75=cALE_DefautToitVitesse, 76=cALE_InhibTEParTendelet, 77=cALE_InhibTEParCoffreOuvert, 78=cALE_ManoeuvreTEFinie, 79=cALE_DefautCAAR, 80=cALE_CdeCoupureInjection, 81=cALE_DefSuspensionGrave, 82=cALE_DefautSuspension, 83=cALE_NivHuile, 84=cALE_DefautClignoAVD, 85=cALE_DefautClignoAVG, 86=cALE_DefautClignoARD, 87=cALE_DefautClignoARG, 88=cALE_DefautFeuxReculG, 89=cALE_DefautFeuxReculD, 90=cALE_DefautCorrecteurSite, 91=cALE_DefautEclVir, 92=cALE_DefautFeuxABAVD, 93=cALE_DefautFeuxABAVG, 94=cALE_DefautFeuxABARG, 95=cALE_DefautFeuxABARD, 96=cALE_DefautFeuxCroisD, 97=cALE_DefautFeuxCroisG, 98=cALE_DefautFeuxPosAVD, 99=cALE_DefautFeuxPosAVG, 100=cALE_DefautFeuxPosARD, 101=cALE_DefautFeuxPosARG, 102=cALE_DefautFeuxRouteD, 103=cALE_DefautFeuxRouteG, 104=cALE_DefautFeuxStopD, 105=cALE_DefautFeuxStopG, 106=cALE_DefautFeuxStopC, 107=cALE_DefautAAS, 108=cALE_SignalisationLgVide, 109=cALE_DefautNivMiniAddGo, 110=cALE_RisqueVerglas, 111=cALE_RVVActSurVitLVVRVV, 112=cALE_VitesseRVVTropBasse, 113=cALE_SecuriteBVABipLock, 114=cALE_SecuriteBVMP, 115=cALE_OubliLanterne, 116=cALE_OubliClefVCM, 117=cALE_FRPKAutoSerreMax, 118=cALE_InhibTEParTemp, 119=cALE_DefautHillAssist, 120=cALE_DefautPushFSE, 121=cALE_OubliFreinFSE_MT, 122=cALE_VisibiliteReduiteARTIV, 123=cALE_ASRModeInhibe, 124=cALE_ASRModeNormal, 125=cALE_ASRModeBoue, 126=cALE_ASRModeNeige, 127=cALE_ASRModeSable, 128=cALE_DefautCPC_G4, 129=cALE_DefautCPC_G3, 130=cALE_ApprentissageARTIV, 131=cALE_OubliFreinFSE_MNT, 132=cALE_DefautARTIV, 133=cALE_PRECONDHorManqu, 134=cALE_PRECONDNivCarb, 135=cALE_PRECONDImpBatt, 136=cALE_DAGMPAiderDever, 137=cALE_DAGMPIdentArret, 138=cALE_DAGMPKeyLock, 139=cALE_DAGMPDefautAVE, 140=cALE_DAGMPInsertIdent, 141=cALE_DAGMPInvitBVABVMP, 142=cALE_DAGMPInvitBVM, 143=cALE_DAGMPIdentAbsent, 144=cALE_OubliClefVCEVML, 145=cALE_AbsenceCleML, 146=cALE_PiedSurFrein, 147=cALE_ACCSuspendu, 148=cALE_ACCDefaut, 149=cALE_EtatARMTHEcoActive, 150=cALE_EtatARMTHEcoDesactive, 151=cALE_DmdDebrayageSTT, 152=cALE_MPDChoixCligno, 153=cALE_DAGMPAlerteAVE, 154=cALE_CAARMiniAuto, 155=cALE_CAARMiniManu, 156=cALE_CAARMaxiManu, 157=cALE_DefautGenerateur, 158=cALE_DefautGmpG4, 159=cALE_DefautDeflecteurMobile, 160=cALE_TemperatureTE, 161=cALE_NbrManoeuvreTE, 162=cALE_DefautARC, 163=cALE_AMVARPlusEtat, 164=cALE_DefautHYG4, 165=cALE_DefautHYG3, 166=cALE_DefautHYVmax, 167=cALE_BipLockHY, 168=cALE_HYOn, 169=cALE_ZEVNonDispoHY, 170=cALE_DefautRemorque, 171=cALE_DefautFeuxPosAdd, 172=cALE_DefautClignoARD_RQ, 173=cALE_DefautClignoARG_RQ, 174=cALE_MPDMesureEnCours, 175=cALE_SecuriteBVAStartLock, 176=cALE_SecuriteBVAComStartLock, 177=cALE_RisqueCollisionFaible, 178=cALE_RisqueCollisionEleve, 179=cALE_RefusActivationARTIV, 180=cALE_XvvRefusActivationRVVi, 181=cALE_XvvAlrtDesactAutoRVVi, 182=cALE_XvvDesactAjustVitRVVi, 183=cALE_DSGiReinitialisation, 184=cALE_DSGiDefaut, 185=cALE_DriveAwayFSE, 186=cALE_AppBoutonFSE, 187=cALE_CAARBasManu, 188=cALE_CAARHautManu, 189=cALE_CAARBasAuto, 190=cALE_DSGiDegonfleeARD, 191=cALE_DSGiDegonfleeARG, 192=cALE_DSGiDegonfleeAVD, 193=cALE_DSGiDegonfleeAVG, 194=cALE_FADeselection, 195=cALE_FADefaut, 196=cALE_SCRNivMin1, 197=cALE_SCRNivMin2, 198=cALE_SCRNivNul, 199=cALE_SCRDefSeuil1, 200=cALE_SCRDefSeuil2, 201=cALE_SCRDefSeuil3, 202=cALE_EtatARMTHEcoDesactiveTemp, 203=cALE_BipLockBVMP, 204=cALE_DSGiRefusReinitialisation, 205=cALE_GMPModeDynDesac, 206=cALE_GMPModeDynDefaut, 207=cALE_ARMTHDmdRedemManu, 208=cALE_BVPiedSurFrein, 209=cALE_DefautDMTR, 210=cALE_CPDefaut, 211=cALE_SCRDefNiv2AlrtSon, 212=cALE_SCRDefSeuil2AlrtSon, 213=cALE_FreinASROff, 214=cALE_FreinASROn, 215=cALE_FrngAutoEnCours, 216=cALE_CapteurAveugle, 217=cALE_ZEVRegulFAP, 218=cALE_GAVDefCPOCond, 219=cALE_RelachezPiedFrein, 220=cALE_BVLongInit, 221=cALE_ACCRepMainNonCritique, 222=cALE_ACCRepMainCritique, 223=cALE_InfoGMPZEVMaintenance, 224=cALE_DAALongRideAlert, 225=cALE_DAABreakCtrlAlert, 226=cALE_DAABadCtrlPerfAlert, 227=cALE_LKASteerWLDropped, 228=cALE_LKADefect, 229=cALE_GAVSelDevCabZCAct, 230=cALE_GAVSelDevCabZCDesact, 231=cALE_HADCImpossibleACC, 232=cALE_HADCAlrtDesactive, 233=cALE_HADCClutchActive, 234=cALE_HADCClutchInformBVA, 235=cALE_HADCClutchInformBVM, 236=cALE_HADCFaulty, 237=cALE_HADCDeselected, 238=cALE_HADCSelected, 239=cALE_HADCImpossibleVehSpeed, 240=cALE_HADCStandby, 241=cALE_HADCRegulation, 242=cALE_ACCRefsuActivation, 243=cALE_GAVSEEDesactiveTmp, 244=cALE_HADCImpossibleHY, 245=cALE_DAGMPAltPriseBranchee, 246=cALE_DAGMPInfoPriseBranchee, 247=cALE_BVPushUnlockPSF, 248=cALE_BVPushUnlock, 249=cALE_INFOGMPZEVIndispCarb, 250=cALE_INFOGMPZEVIndispExt, 251=cALE_INFOGMPZEVIndispSOC, 252=cALE_FreinAsstDef, 253=cALE_SCRMaxRefillNiv1, 254=cALE_SCRMaxRefillNiv2, 255=cALE_TSCTempClutch, 256=cALE_GAVOuvertureCoffre, 257=cALE_FreinAllureModere, 258=cALE_FreinPerfoGMPLim, 259=cALE_JGCAMiniGPL, 260=cALE_JGCAGPLDenied, 261=cALE_AFILInhibAppuiLong, 262=cALE_LPADefect, 263=cALE_ACCLPARepCrit, 264=cALE_LPAReqHandOnSteerWL, 265=cALE_LPASelectionRefusal, 266=cALE_TOVRefusLC, 267=cALE_ILVSensInterdit, 268=cALE_ILVCIRCInterdite, 269=cALE_FreinDefICB, 270=cALE_EcleAFSGD, 271=cALE_ACCCameraAveugle, 272=cALE_DAADrowsinLightAlert, 273=cALE_DAADrowsinSevereAlert, 274=cALE_DAADistractLightAlert, 275=cALE_DAASeveretLightAlert, 276=cALE_IVVRDSDetected, 277=cALE_FACameraAveugle, 278=cALE_LPAReqRegainCtrHight, 279=cALE_OLVIFault, 280=cALE_LPAReqRegainCtrLow, 281=cALE_LPAWaitRightConditions, 282=cALE_ACCLPASuspended, 283=cALE_ACCLPARepNonCrit, 284=cALE_ACTIIntrusion, 285=cALE_ACTIFault, 286=cALE_AVNReqBeamAct, 287=cALE_AVNActivated, 288=cALE_AVNDefect, 289=cALE_SAMDefect, 290=cALE_SignDefARS, 291=cALE_PdvTelOubli, 292=cALE_DaaIvcdFailure, 293=cALE_LKAPushAppuiLong, 294=cALE_DAGMP_ArretDeg, 295=cALE_CLIMPrecondUnavail, 296=cALE_SAMActiv, 297=cALE_SAMDeactiv, 298=cALE_PICCLoudspeaker, 299=cALE_CGEPVSocMin, 300=cALE_WaitBeforeFilllTank, 301=cALE_FillTankAuth, 302=cALE_CARBVieilli, 303=cALE_DDMCoupMot, 304=cALE_EnergyRec, 305=cALE_LanechangeRefus, 306=cALE_LanechangeCancel, 307=cALE_HadDefect, 308=cALE_HadMonitorLow, 309=cALE_HadMonitorMedium, 310=cALE_HadReqSteerLow, 311=cALE_HadReqSteerMedium, 312=cALE_HadDisclaimer, 313=cALE_HadReqSteerHigh, 314=cALE_ScrDefQualSeuil1, 315=cAle_ScrDefQual2Alrt, 316=cAle_ScrDefQualSeuil2, 317=cALE_ScrDefQualSeuil3, 318=cALE_ScrDefConsoSeuil1, 319=cALE_ScrDefConso2AlrtSon, 320=cALE_ScrDefConsoSeuil2, 321=cALE_ScrDefConsoSeuil3, 322=cALE_BvPushUnlockDag, 323=cALE_BvPushUnlockDad, 324=cALE_LanechangeAborted, 325=cALE_LedBasNiveauBatt, 326=cALE_HadMrm, 327=cFinEnumCS_AlerteIHM}
    t_cAlerteIHM: base-type=uint8, compu {0=cAlerteIHM_Set, 1=cAlerteIHM_Clear, 2=cAlerteIHM_RelanceMsg, 3=cAlerteIHM_RelanceSon, 4=cAlerteIHM_RelanceMsgSon}
    t_cBouclage: base-type=uint8, compu {0=cBouclageNok, 1=cBouclageOk}
    t_cContactFrein: base-type=uint8, compu {0=cContactFrein_Relache, 1=cContactFrein_Appuye}
    t_cCR: base-type=uint8, compu {0x00=cCR_Instable, 0x01=cCR_Decondamne, 0x02=cCR_Condamne, 0x04=cCR_DecondConducteur, 0x08=cCR_SuperCondamne, 0x10=cCR_AvantDecondamne, 0x20=cCR_ArriereDecondamne}
    t_cCSEV: base-type=uint8, compu {0=cCSEV_Montage, 1=cCSEV_Usine, 2=cCSEV_Controle, 3=cCSEV_Stockage, 4=cCSEV_Client, 5=cCSEV_ShowRoom, 6=cCSEV_APV}
    t_cDefautPresConducteur: base-type=uint8, compu {0x00=cDefautPresConducteur_Ok, 0x01=cDefautPresConducteur_Msq_Ceinture, 0x02=cDefautPresConducteur_Msq_Conda}
    t_cECR_A: base-type=uint8, compu {0x00=cECR_Aucun, 0x01=cECR_AVG, 0x02=cECR_AVD}
    t_CFG_NBR_CNB: base-type=uint8
    t_cInhibRBGPass: base-type=uint8, compu {0x00=cInhibRBGPass_Indefini, 0x01=cInhibRBGPass_Inhibe, 0x02=cInhibRBGPass_NonInhibe, 0x03=cInhibRBGPass_Defaut}
    t_cmEO: base-type=uint8, compu {0x00=cmEO_Aucune, 0x01=cmEO_PorteCond, 0x02=cmEO_PortePass, 0x04=cmEO_PorteARD, 0x08=cmEO_PorteARG, 0x10=cmEO_Lunette, 0x20=cmEO_Coffre, 0x40=cmEO_ToitOuvrant, 0x80=cmEO_Capot}
    t_cPresenceConducteur: base-type=uint8, compu {0x00=cPresenceConducteur_Interdit, 0x01=cPresenceConducteur_Absent, 0x02=cPresenceConducteur_Present, 0x03=cPresenceConducteur_Invalide}
    t_cPresenceSimpleConducteur: base-type=uint8, compu {0=cPresenceSimpleConducteur_Absent, 1=cPresenceSimpleConducteur_Present}
    t_cTCT: base-type=uint8, compu {0x00=cTCT_MTH, 0x01=cTCT_HY, 0x02=cTCT_ELEC}
    t_cTNB: base-type=uint8, compu {0x00=cTNB_Indetermine, 1=cTNB_CeintureOuverte, 2=cTNB_CeintureBouclee, 3=cTNB_Invalide}
    t_cTypeSonANBC: base-type=uint8, compu {0x00=cTypeSonANBC_Classic, 0x01=cTypeSonANBC_LoudAndClear}
    t_cVitv: base-type=uint16, compu {0x5=cVitvIndispo, 0xA=cVitvDispo, 0xFFFF=cVitvInvalide, 0=cVitv_Incoherent, 1=cVitv_Coherent, 0xB=cVitv_cOK}
    t_DdeSon: base-type=uint8, compu {0=cDdeSon_SetSonSeul, 1=cDdeSon_SetSonPtr, 2=cDdeSon_Relance, 3=cDdeSon_Clear}
    t_DriverOpeningStateFoldsStatus: base-type=uint8, compu {0=eMVA_NoDefect, 1=eMVA_PotentialDefect, 2=eMVA_ConfirmedDefectFoldStrategy, 3=eMVA_ElectronicalDefect}
    t_GM_GMP: base-type=uint8, compu {0x00=GM_GMPInit, 0x01=GM_GMPCoupe, 0x02=GM_GMPEnDemarrage, 0x04=GM_GMPTournant, 0x08=GM_GMPArrete, 0x10=GM_GMPEnRedemarrage, 0x20=GM_GMPTournantHybride, 0x40=GM_GMPTournantElecPur, 0x80=GM_GMPEnPreparation}
    tOpeningPosition: base-type=uint16
    t_Sound: base-type=uint16, compu {327=cSon_Clignotant, 328=cSon_Clignotant_Clic, 329=cSon_Clignotant_Clac, 330=cSon_ClignotantEnDefaut, 331=cSon_MemoSiege, 332=cSon_RappelSiege, 333=cSon_DdeBalisage, 334=cSon_MarcheArriere, 335=cSon_Survitesse, 336=cSonAAS_ARContinu, 337=cSonAAS_AVContinu, 338=cSonAAS_ARBip, 339=cSonAAS_AVBip, 340=cSonANBC_F1, 341=cSonANBC_F2, 342=cSonANBC_F3, 343=cSonANBC_F1_PRIM, 344=cSonANBC_F2_PRIM, 345=cSonANBC_F3_PRIM, 346=cSon_CPAvancer, 347=cSon_CPPassageMar, 348=cSon_CPFinManoeuvreSCP6, 349=cSon_CPFinManoeuvreSCP9, 350=cSon_CPSCP9Desactive, 351=cSon_CPSCP6Desactive, 352=cSon_DRL_Active, 353=cSon_DRL_Desactive, 354=cSon_GmpRupteurMoteur, 355=cSon_CPPassageMav, 356=cSon_CP_FinManoeuvre_AMSP, 357=cSon_CP_AMSP_Desactive, 358=cSon_XvvAlerteDepassVit, 359=cSon_AlerteAFIL, 360=cSon_ACPKStopVehicle, 361=cSon_ACPKActivation, 362=cSon_ACPKManeuverEnd, 363=cSon_ACPKManeuverImpossible, 364=cSon_DetectionPietonNV, 365=cSon_DetectionAnimauxNV, 366=cSonCPDefaut, 367=cSON_On_Off_HandsFreeAcces, 368=cSON_DESPActiRbgPav, 369=cSON_DESPInhiRbgPav, 370=cSon_ElecOn, 371=cSon_MarBloquee, 372=cSound_WlMovement, 373=cFinEnumCS_DdeSon}
    t_SteeringWheelPosition: base-type=uint8, compu {0=eSteeringWheelPosition_Invalid, 1=eSteeringWheelPosition_Right, 2=eSteeringWheelPosition_Left}
    t_TA7C_BOUCLAGE_CEINT_COND: base-type=uint8
    t_TP7C_FILTRAGE_ABSENCE: base-type=uint8
    tVehicleLockingState: base-type=uint8, compu {0=eMVA_Unstable, 1=eMVA_Unlocked, 2=eMVA_Locked, 4=eMVA_UnlockDriver, 8=eMVA_SuperLocked, 16=eMVA_FrontUnlocked, 32=eMVA_RearUnlocked}
    t_cCaptBouchon: base-type=uint8, compu {0=cCaptBouchon_Aucun, 1=cCaptBouchon_DansADDGO, 2=cCaptBouchon_DansBSI}
    t_cCmdPlusCAN: base-type=uint8, compu {0=PLUSCAN_OFF, 1=PLUSCAN_ON, 3=PLUSCAN_UNDEFINED}
    t_cCMDPLUSCAN: base-type=uint8, compu {0x00=cCMDPLUSCAN_OFF, 0x01=cCMDPLUSCAN_ON, 0x03=cCMDPLUSCAN_INDETERMINE}
    t_cDEF_BOUCHCARB_ELEC: base-type=uint8, compu {0x00=cDEF_BOUCHCARB_ELEC_NON_DIAG, 0x01=cDEF_BOUCHCARB_ELEC_CO, 0x02=cDEF_BOUCHCARB_ELEC_INV, 0x03=cDEF_BOUCHCARB_ELEC_ABSENT}
    t_cDEF_JAUGECARB: base-type=uint8, compu {0x00=cDEF_JAUGECARB_NON_DIAG, 0x01=cDEF_JAUGECARB_CO, 0x02=cDEF_JAUGECARB_CCM, 0x03=cDEF_JAUGECARB_ABSENT}
    t_cE: base-type=uint8, compu {0=cE_SONDE_TEMPERATURE, 1=cE_JAUGE_CARB, 2=cE_NIV_LIQUIDE_FREIN}
    t_cE_RESDW: base-type=uint8, compu {0=cE_RESDW_BOUCHON_CARB, 1=cE_RESDW_SONDE_EVAPORATEUR, 2=cE_RESDW_CAPT_AAF}
    t_cSDF_Defaut: base-type=uint8, compu {0x69=cSDF_DefautAbsent, 0x96=cSDF_DefautPresent}
    t_cSDF_Mesure: base-type=uint8, compu {0x69=cSDF_MesureNonRealisee, 0x96=cSDF_MesureRealisee}
    t_Def_0: base-type=uint8, compu {0x00=cAttenteDefJC, 0x02=cDefautJCCM, 0x03=cDefautJCCO}
    t_: base-type=uint8, compu {0x0=GAZ, 0x1=EssenceForcedGaz, 0x2=GazEssenceCommutation, 0x3=EssenceFocedWaitGazCondition, 0x4=GazForcedEssenceTankVide, 0x5=EssenceGazCommutation, 0x6=EssenceForcedGazTankVide, 0x7=Essence}
    t_Alerte: base-type=uint8, compu {1=Alerte_POI_GARAGE, 2=Alerte_POI_PAUSE, 3=Alerte_POI_GAZ_STATION, 4=Alerte_POI_CHARGING_STATION, 5=Alerte_POI_ADBLUE, 5=cFinEnumCS_AlertePOI}
    t_C7D2_DeltaRelIhmMiniCarb1: base-type=uint8
    t_C7D2_DeltaRelIhmMiniCarb2: base-type=uint8
    t_C7D2_HYST_ALRT_GPL: base-type=uint8
    t_C7D_NIV_CARB_CRITIQUE: base-type=uint8
    t_cAlertePOI: base-type=uint8, compu {0=cAlertePOI_Set, 1=cAlertePOI_Clear}
    t_cDemande: base-type=uint8, compu {0x0=cDemande_Fixe, 0x1=cDemande_Clignot}
    t_cIHM: base-type=uint8, compu {0=cIHM_without, 1=cIHM_currentAutonomy, 2=cIHM_totalAutonomy}
    t_cModeFonctMotGAZ: base-type=uint8, compu {0x00=cModeFonctMotGAZ_GAZ, 0x01=cModeFonctMotGAZ_GAZ_HS, 0x02=cModeFonctMotGAZ_CommutGAZ_Essence, 0x03=cModeFonctMotGAZ_AttenteGAZ, 0x04=cModeFonctMotGAZ_EssenceVide, 0x05=cModeFonctMotGAZ_CommutEssence_GAZ, 0x06=cModeFonctMotGAZ_GAZVide, 0x07=cModeFonctMotGAZ_Essence}
    t_cPosIdent: base-type=uint8, compu {0=cPosIdent_Absent, 1=cPosIdent_Present}
    t_e_0: base-type=uint8, compu {0x0=cMode_Essence, 0x1=cMode_GPL, 0x2=cBasculement_en_cours, 0x3=cInvalideEssenceGPL}
    t_T7D2_DeltaRelIhmMiniCarbZero: base-type=uint8
    t_T7D2_FAILURE_PUSH_GPL: base-type=uint8
    t_T7D2_TEMPO_FILTRAGE_IHM_MINICARB: base-type=uint8
    t_cFAP: base-type=uint8, compu {0=cFAP_Absent, 1=cFAP_PompeFilaire, 2=cFAP_PompeMux13, 3=cFAP_PompeMux21, 4=cFAP_NonAdditive}
    t_cIdVoyServ: base-type=uint8, compu {10=cIdVoyServ_Premier, 10=cIdVoyServ_TrspNonIdent, 11=cIdVoyServ_SignalisationLgVide, 12=cIdVoyServ_DefautSignaler, 13=cIdVoyServ_DefautEclX, 14=cIdVoyServ_DefautEclVir, 15=cIdVoyServ_CorrecteurSite, 16=cIdVoyServ_DefautCPC_G3, 17=cIdVoyServ_DefautAAS, 18=cIdVoyServ_SignalisationPlaquettes, 19=cIdVoyServ_DefautFonctionEasyMove, 20=cIdVoyServ_DefautBV, 21=cIdVoyServ_DefautGmpG3, 22=cIdVoyServ_DefautHYVmax, 23=cIdVoyServ_AlerteNiveauEauMoteur, 24=cIdVoyServ_AlerteEauDansGazole, 25=cIdVoyServ_DefautCAAR, 26=cIdVoyServ_DAGMPAlerteAVE, 27=cIdVoyServ_SvceAlerteFAP, 28=cIdVoyServ_AlerteNiveauHuile, 29=cIdVoyServ_ServiceDSG, 30=cIdVoyServ_DefautBDCP, 31=cIdVoyServ_DefautRBAGGeneral, 32=cIdVoyServ_SCR, 33=cIdVoyServ_DefautDMTR, 34=cIdVoyServ_MaintDepassee, 35=cIdVoyServ_DefCPOCond, 36=cIdVoyServ_DefautAFIL, 37=cIdVoyServ_ESCDef, 38=cIdVoyServ_FreinDef, 39=cIdVoyServ_LKADefect, 40=cIdVoyServ_ACCDef, 41=cIdVoyServ_ASSTDef, 42=cIdVoyServ_OLVIFault, 43=cIdVoyServ_ECLXDefAFS, 44=cIdVoyServ_ECLXSensCir, 45=cIdVoyServ_DefautACPK, 46=cIdVoyServ_BSDDefault, 47=cIdVoyServ_LoudSpeakerDefault, 48=cIdVoyServ_LPADefect, 48=cIdVoyServ_Dernier}
    t_cPilotageVoyant: base-type=uint8, compu {0=cPilotageVoyant_Extinction, 1=cPilotageVoyant_Allumage}
    t_cTypeSC_Euro: base-type=uint8, compu {0=cTypeSC_Euro4, 1=cTypeSC_Euro5, 2=cTypeSC_Euro6, 3=cTypeSC_Euro6_1, 4=cTypeSC_Euro6_2, 5=cTypeSC_Euro6_3}
    t_ApplicationModeRequestType: base-type=uint8
    t_cBodyVersion: base-type=uint8
    t_cCANBODY: base-type=uint8, compu {0x00=cBODY_Sleep, 0x01=cBODY_Normal, 0x02=cBODY_GoToSleep, 0x03=cBODY_Wakeup, 0x04=cBODY_ComOff}
    t_cCANPWT: base-type=uint8, compu {0x00=cPWT_OFF, 0x01=cPWT_TRANSIENT, 0x02=cPWT_PARTIAL, 0x03=cPWT_PRINCIPAL, 0x04=cPWT_PRINCIPAL_DEGRADED}
    t_cCmdAPC: base-type=uint8, compu {0x0=APC_UNDEFINED, 0x2=APC_OFF, 0x3=APC_ON}
    t_cCmdPlusLIN: base-type=uint8, compu {0=PLUSLIN_OFF, 1=PLUSLIN_ON, 3=PLUSLIN_UNDEFINED}
    t_cCmdPlusRCD: base-type=uint8, compu {0=cPLUSRCD_OFF, 1=cPLUSRCD_ON, 3=cPLUSRCD_UNDEFINED}
    t_cHOLD: base-type=uint8, compu {0x00=cHOLD_OFF, 0x01=cHOLD_NETWORK, 0x02=cHOLD_LOCAL, 0x03=cHOLD_NET_AND_LOCAL}
    t_cLIN_COMOFF: base-type=uint8, compu {0=cLIN_COMOFFINACTIF, 1=cLIN_COMOFFACTIF}
    t_cLINLPhM: base-type=uint8, compu {0x00=LIN_SLEEP, 0x01=LIN_WAKEUP, 0x02=LIN_NORMAL, 0x03=LIN_COMOFF, 0x04=LIN_GOTOSLEEP}
    t_cLpCanBody: base-type=uint8, compu {0x00=cSGL_BODY_Sleep, 0x01=cSGL_BODY_Normal, 0x02=cSGL_BODY_GoToSleep, 0x03=cSGL_BODY_Wakeup, 0x04=cSGL_BODY_ComOff}
    t_cLpLIN: base-type=uint8, compu {0x00=PrepareToSleep, 0x01=WakeUp, 0xFF=Invalid}
    t_cOSPWT: base-type=uint8, compu {0x0=cOSPWT_Sleep, 0x1=cOSPWT_Partial, 0x2=cOSPWT_PartialInternal, 0x2=cOSPWT_Transient, 0x4=cOSPWT_Principal, 0x5=cOSPWT_PrincipalDegraded, 0x6=cOSPWT_GoToSleep, 0x7=cOSPWT_Default}
    t_cPwtVersion: base-type=uint8
    t_H: base-type=uint8, compu {0=cPHASE_1, 1=cPHASE_2, 2=cHY_E35, 3=cHY4_PREMIUM, 4=cPHEV}
    tSDDiag: base-type=uint8, compu {0x03=cSDDiag_Mask_IndispoDiag, 0x07=cSDDiag_Mask_CCBatt, 0x0B=cSDDiag_Mask_CCMasse, 0x13=cSDDiag_Mask_COuvert, 0x17=cSDDiag_Mask_CCBattOuCOuvert, 0x1F=cSDDiag_Mask_DiagES, 0x00=cSDDiag_DiagOk, 0x01=cSDDiag_DiagNonSupporte, 0x02=cSDDiag_IndispoDiag, 0x04=cSDDiag_CCBatt, 0x08=cSDDiag_CCMasse, 0x10=cSDDiag_COuvert, 0x14=cSDDiag_CCBattOuCircuitOuvert, 0x18=cSDDiag_CCMasseOuCircuitOuvert}
    t_WakeUpCause: base-type=uint8
package /RootP_NetworkDesc
  system VSM_System: system-version=4.0.3
    system mapping SystemMapping
      data-mappings:
        data-element=Instance_ASWC_A28.RootCompositionVSM.PRP_SR_DdeColorisationCMBDeVMF.DdeColorisationCMBDeVMF, system-signal=HS4_CDE_CMB_SIGNALISATION_DMD_COULEUR_CMB_HS4_128
        data-element=Instance_ASWC_A28.RootCompositionVSM.PRP_SR_DdePersoCMBDeVMF.DdePersoCMBDeVMF, system-signal=HS4_CDE_CMB_SIGNALISATION_DMD_PERSO_CMB_HS4_128
        data-element=Instance_ASWC_A28.RootCompositionVSM.PRP_SR_DispoDmdMenuPrecond.DispoDmdMenuPrecond, system-signal=HS7_VSM_INF_PRG_CLIM_DISPO_ETAT_PRECOND_HS7_2E0
        data-element=Instance_ASWC_A28.RootCompositionVSM.PRP_SR_DispoDmdMenuRecharge.DispoDmdMenuRecharge, system-signal=HS4_VSM_INF_PRG_RTAB_DISPO_ETAT_RECHARGE_HS4_160
        data-element=Instance_ASWC_A28.RootCompositionVSM.PRP_SR_EtatMenuAccueilCond.EtatMenuAccueilCond, system-signal=HS7_VSM_INF_PROFILS_ACCUEIL_COND_HS7_260
        data-element=Instance_ASWC_A28.RootCompositionVSM.PRP_SR_EtatMenuActButee{1..5}XVV.EtatMenuActButee{1..5}XVV, system-signal=HS4_ETAT_PRECOND_ET_XVV_BUTEE_{1..5}_HS4_1E8
        data-element=Instance_ASWC_A28.RootCompositionVSM.PRP_SR_EtatMenuActButeeGenXVV.EtatMenuActButeeGenXVV, system-signal=HS4_ETAT_PRECOND_ET_XVV_MENU_XVV_HS4_1E8
        data-element=Instance_ASWC_A28.RootCompositionVSM.PRP_SR_EtatMenuARCSensNiv.EtatMenuARCSensNiv, system-signal=HS7_VSM_INF_PROFILS_ARC_SENS_NIV_HS7_260
        data-element=Instance_ASWC_A28.RootCompositionVSM.PRP_SR_EtatMenuBAAActivation.EtatMenuBAAActivation, system-signal=HS7_VSM_INF_PROFILS_FCT_MENU_VAM_BAA_HS7_260
        data-element=Instance_ASWC_A28.RootCompositionVSM.PRP_SR_EtatMenuBAAAutolocking.EtatMenuBAAAutolocking, system-signal=HS7_VSM_INF_PROFILS_FCT_MENU_BAA_LOCK_HS7_260
        data-element=Instance_ASWC_A28.RootCompositionVSM.PRP_SR_EtatMenuCLIM_PrecondDi1.EtatMenuCLIM_PrecondDi1, system-signal=HS7_VSM_INF_PRG_CLIM_MENU_CLIM_PRECOND_DI_1_HS7_2E0
        data-element=Instance_ASWC_A28.RootCompositionVSM.PRP_SR_EtatMenuCLIM_PrecondDi2.EtatMenuCLIM_PrecondDi2, system-signal=HS7_VSM_INF_PRG_CLIM_MENU_CLIM_PRECOND_DI_2_HS7_2E0
        data-element=Instance_ASWC_A28.RootCompositionVSM.PRP_SR_EtatMenuCLIM_PrecondDi3.EtatMenuCLIM_PrecondDi3, system-signal=HS7_VSM_INF_PRG_CLIM_2_MENU_CLIM_PRECOND_DI_3_HS7_0E0
        data-element=Instance_ASWC_A28.RootCompositionVSM.PRP_SR_EtatMenuCLIM_PrecondDi4.EtatMenuCLIM_PrecondDi4, system-signal=HS7_VSM_INF_PRG_CLIM_2_MENU_CLIM_PRECOND_DI_4_HS7_0E0
        data-element=Instance_ASWC_A28.RootCompositionVSM.PRP_SR_EtatMenuCLIM_PrecondH1.EtatMenuCLIM_PrecondH1, system-signal=HS7_VSM_INF_PRG_CLIM_MENU_CLIM_PRECOND_H_1_HS7_2E0
        data-element=Instance_ASWC_A28.RootCompositionVSM.PRP_SR_EtatMenuCLIM_PrecondH2.EtatMenuCLIM_PrecondH2, system-signal=HS7_VSM_INF_PRG_CLIM_MENU_CLIM_PRECOND_H_2_HS7_2E0
        data-element=Instance_ASWC_A28.RootCompositionVSM.PRP_SR_EtatMenuCLIM_PrecondH3.EtatMenuCLIM_PrecondH3, system-signal=HS7_VSM_INF_PRG_CLIM_2_MENU_CLIM_PRECOND_H_3_HS7_0E0
        data-element=Instance_ASWC_A28.RootCompositionVSM.PRP_SR_EtatMenuCLIM_PrecondH4.EtatMenuCLIM_PrecondH4, system-signal=HS7_VSM_INF_PRG_CLIM_2_MENU_CLIM_PRECOND_H_4_HS7_0E0
        data-element=Instance_ASWC_A28.RootCompositionVSM.PRP_SR_EtatMenuCLIM_PrecondJe1.EtatMenuCLIM_PrecondJe1, system-signal=HS7_VSM_INF_PRG_CLIM_MENU_CLIM_PRECOND_JE_1_HS7_2E0
        data-element=Instance_ASWC_A28.RootCompositionVSM.PRP_SR_EtatMenuCLIM_PrecondJe2.EtatMenuCLIM_PrecondJe2, system-signal=HS7_VSM_INF_PRG_CLIM_MENU_CLIM_PRECOND_JE_2_HS7_2E0
        data-element=Instance_ASWC_A28.RootCompositionVSM.PRP_SR_EtatMenuCLIM_PrecondJe3.EtatMenuCLIM_PrecondJe3, system-signal=HS7_VSM_INF_PRG_CLIM_2_MENU_CLIM_PRECOND_JE_3_HS7_0E0
        data-element=Instance_ASWC_A28.RootCompositionVSM.PRP_SR_EtatMenuCLIM_PrecondJe4.EtatMenuCLIM_PrecondJe4, system-signal=HS7_VSM_INF_PRG_CLIM_2_MENU_CLIM_PRECOND_JE_4_HS7_0E0
        data-element=Instance_ASWC_A28.RootCompositionVSM.PRP_SR_EtatMenuCLIM_PrecondLu1.EtatMenuCLIM_PrecondLu1, system-signal=HS7_VSM_INF_PRG_CLIM_MENU_CLIM_PRECOND_LU_1_HS7_2E0
        data-element=Instance_ASWC_A28.RootCompositionVSM.PRP_SR_EtatMenuCLIM_PrecondLu2.EtatMenuCLIM_PrecondLu2, system-signal=HS7_VSM_INF_PRG_CLIM_MENU_CLIM_PRECOND_LU_2_HS7_2E0
        data-element=Instance_ASWC_A28.RootCompositionVSM.PRP_SR_EtatMenuCLIM_PrecondLu3.EtatMenuCLIM_PrecondLu3, system-signal=HS7_VSM_INF_PRG_CLIM_2_MENU_CLIM_PRECOND_LU_3_HS7_0E0
        data-element=Instance_ASWC_A28.RootCompositionVSM.PRP_SR_EtatMenuCLIM_PrecondLu4.EtatMenuCLIM_PrecondLu4, system-signal=HS7_VSM_INF_PRG_CLIM_2_MENU_CLIM_PRECOND_LU_4_HS7_0E0
        data-element=Instance_ASWC_A28.RootCompositionVSM.PRP_SR_EtatMenuCLIM_PrecondMa1.EtatMenuCLIM_PrecondMa1, system-signal=HS7_VSM_INF_PRG_CLIM_MENU_CLIM_PRECOND_MA_1_HS7_2E0
        data-element=Instance_ASWC_A28.RootCompositionVSM.PRP_SR_EtatMenuCLIM_PrecondMa2.EtatMenuCLIM_PrecondMa2, system-signal=HS7_VSM_INF_PRG_CLIM_MENU_CLIM_PRECOND_MA_2_HS7_2E0
        data-element=Instance_ASWC_A28.RootCompositionVSM.PRP_SR_EtatMenuCLIM_PrecondMa3.EtatMenuCLIM_PrecondMa3, system-signal=HS7_VSM_INF_PRG_CLIM_2_MENU_CLIM_PRECOND_MA_3_HS7_0E0
        data-element=Instance_ASWC_A28.RootCompositionVSM.PRP_SR_EtatMenuCLIM_PrecondMa4.EtatMenuCLIM_PrecondMa4, system-signal=HS7_VSM_INF_PRG_CLIM_2_MENU_CLIM_PRECOND_MA_4_HS7_0E0
        data-element=Instance_ASWC_A28.RootCompositionVSM.PRP_SR_EtatMenuCLIM_PrecondMe1.EtatMenuCLIM_PrecondMe1, system-signal=HS7_VSM_INF_PRG_CLIM_MENU_CLIM_PRECOND_ME_1_HS7_2E0
        data-element=Instance_ASWC_A28.RootCompositionVSM.PRP_SR_EtatMenuCLIM_PrecondMe2.EtatMenuCLIM_PrecondMe2, system-signal=HS7_VSM_INF_PRG_CLIM_MENU_CLIM_PRECOND_ME_2_HS7_2E0
        data-element=Instance_ASWC_A28.RootCompositionVSM.PRP_SR_EtatMenuCLIM_PrecondMe3.EtatMenuCLIM_PrecondMe3, system-signal=HS7_VSM_INF_PRG_CLIM_2_MENU_CLIM_PRECOND_ME_3_HS7_0E0
        data-element=Instance_ASWC_A28.RootCompositionVSM.PRP_SR_EtatMenuCLIM_PrecondMe4.EtatMenuCLIM_PrecondMe4, system-signal=HS7_VSM_INF_PRG_CLIM_2_MENU_CLIM_PRECOND_ME_4_HS7_0E0
        data-element=Instance_ASWC_A28.RootCompositionVSM.PRP_SR_EtatMenuCLIM_PrecondOn1.EtatMenuCLIM_PrecondOn1, system-signal=HS7_VSM_INF_PRG_CLIM_MENU_CLIM_PRECOND_ON_1_HS7_2E0
        data-element=Instance_ASWC_A28.RootCompositionVSM.PRP_SR_EtatMenuCLIM_PrecondOn2.EtatMenuCLIM_PrecondOn2, system-signal=HS7_VSM_INF_PRG_CLIM_MENU_CLIM_PRECOND_ON_2_HS7_2E0
        data-element=Instance_ASWC_A28.RootCompositionVSM.PRP_SR_EtatMenuCLIM_PrecondOn3.EtatMenuCLIM_PrecondOn3, system-signal=HS7_VSM_INF_PRG_CLIM_2_MENU_CLIM_PRECOND_ON_3_HS7_0E0
        data-element=Instance_ASWC_A28.RootCompositionVSM.PRP_SR_EtatMenuCLIM_PrecondOn4.EtatMenuCLIM_PrecondOn4, system-signal=HS7_VSM_INF_PRG_CLIM_2_MENU_CLIM_PRECOND_ON_4_HS7_0E0
        data-element=Instance_ASWC_A28.RootCompositionVSM.PRP_SR_EtatMenuCLIM_PrecondSa1.EtatMenuCLIM_PrecondSa1, system-signal=HS7_VSM_INF_PRG_CLIM_MENU_CLIM_PRECOND_SA_1_HS7_2E0
        data-element=Instance_ASWC_A28.RootCompositionVSM.PRP_SR_EtatMenuCLIM_PrecondSa2.EtatMenuCLIM_PrecondSa2, system-signal=HS7_VSM_INF_PRG_CLIM_MENU_CLIM_PRECOND_SA_2_HS7_2E0
        data-element=Instance_ASWC_A28.RootCompositionVSM.PRP_SR_EtatMenuCLIM_PrecondSa3.EtatMenuCLIM_PrecondSa3, system-signal=HS7_VSM_INF_PRG_CLIM_2_MENU_CLIM_PRECOND_SA_3_HS7_0E0
        data-element=Instance_ASWC_A28.RootCompositionVSM.PRP_SR_EtatMenuCLIM_PrecondSa4.EtatMenuCLIM_PrecondSa4, system-signal=HS7_VSM_INF_PRG_CLIM_2_MENU_CLIM_PRECOND_SA_4_HS7_0E0
        data-element=Instance_ASWC_A28.RootCompositionVSM.PRP_SR_EtatMenuCLIM_PrecondVe1.EtatMenuCLIM_PrecondVe1, system-signal=HS7_VSM_INF_PRG_CLIM_MENU_CLIM_PRECOND_VE_1_HS7_2E0
        data-element=Instance_ASWC_A28.RootCompositionVSM.PRP_SR_EtatMenuCLIM_PrecondVe2.EtatMenuCLIM_PrecondVe2, system-signal=HS7_VSM_INF_PRG_CLIM_MENU_CLIM_PRECOND_VE_2_HS7_2E0
        data-element=Instance_ASWC_A28.RootCompositionVSM.PRP_SR_EtatMenuCLIM_PrecondVe3.EtatMenuCLIM_PrecondVe3, system-signal=HS7_VSM_INF_PRG_CLIM_2_MENU_CLIM_PRECOND_VE_3_HS7_0E0
        data-element=Instance_ASWC_A28.RootCompositionVSM.PRP_SR_EtatMenuCLIM_PrecondVe4.EtatMenuCLIM_PrecondVe4, system-signal=HS7_VSM_INF_PRG_CLIM_2_MENU_CLIM_PRECOND_VE_4_HS7_0E0
        data-element=Instance_ASWC_A28.RootCompositionVSM.PRP_SR_EtatMenuDAAActivation.EtatMenuDAAActivation, system-signal=HS7_VSM_INF_PROFILS_FCT_MENU_DAA_ACTIV_HS7_260
        data-element=Instance_ASWC_A28.RootCompositionVSM.PRP_SR_EtatMenuDSG.EtatMenuDSG, system-signal=HS7_VSM_INF_PROFILS_REINIT_DSG_STATUS_HS7_260
        data-element=Instance_ASWC_A28.RootCompositionVSM.PRP_SR_EtatMenuEclAccomp.EtatMenuEclAccomp, system-signal=HS7_VSM_INF_PROFILS_ECLAIRAGE_ACCOM_HS7_260
        data-element=Instance_ASWC_A28.RootCompositionVSM.PRP_SR_EtatMenuEclAccompTempo.EtatMenuEclAccompTempo, system-signal=HS7_VSM_INF_PROFILS_TEMPO_EXT_PHARE_HS7_260
        data-element=Instance_ASWC_A28.RootCompositionVSM.PRP_SR_EtatMenuEclAdapt.EtatMenuEclAdapt, system-signal=HS7_VSM_INF_PROFILS_ECL_ADAPT_HS7_260
        data-element=Instance_ASWC_A28.RootCompositionVSM.PRP_SR_EtatMenuEclAmbi.EtatMenuEclAmbi, system-signal=HS7_VSM_INF_PROFILS_ECLAI_AMBI_HS7_260
        data-element=Instance_ASWC_A28.RootCompositionVSM.PRP_SR_EtatMenuEclAmbiNiv.EtatMenuEclAmbiNiv, system-signal=HS7_VSM_INF_PROFILS_NIV_AMBIANCE_HS7_260
        data-element=Instance_ASWC_A28.RootCompositionVSM.PRP_SR_EtatMenuEclAuto.EtatMenuEclAuto, system-signal=HS7_VSM_INF_PROFILS_ECLAIRAGE_AUTO_HS7_260
        data-element=Instance_ASWC_A28.RootCompositionVSM.PRP_SR_EtatMenuEclAutoroute.EtatMenuEclAutoroute, system-signal=HS7_VSM_INF_PROFILS_ECL_AUTOROUTE_HS7_260
        data-element=Instance_ASWC_A28.RootCompositionVSM.PRP_SR_EtatMenuEclCaland.EtatMenuEclCaland, system-signal=HS7_VSM_INF_PROFILS_FCT_ECL_CALAND_HS7_260
        data-element=Instance_ASWC_A28.RootCompositionVSM.PRP_SR_EtatMenuEclDeconda.EtatMenuEclDeconda, system-signal=HS7_VSM_INF_PROFILS_ECL_DECONDA_HS7_260
        data-element=Instance_ASWC_A28.RootCompositionVSM.PRP_SR_EtatMenuEclDecondaTempo.EtatMenuEclDecondaTempo, system-signal=HS7_VSM_INF_PROFILS_TEMPO_ECL_DECONDA_HS7_260
        data-element=Instance_ASWC_A28.RootCompositionVSM.PRP_SR_EtatMenuECLI_PPC_ANIM.EtatMenuECLI_PPC_ANIM, system-signal=HS4_VSM_INF_PROFILS_2_FCT_MENU_ECLI_PPC_ANIM_HS4_220
        data-element=Instance_ASWC_A28.RootCompositionVSM.PRP_SR_EtatMenuECLI_PPC_BLOC1.EtatMenuECLI_PPC_BLOC1, system-signal=HS4_VSM_INF_PROFILS_2_FCT_MENU_ECLI_PPC_BLOC1_HS4_220
        data-element=Instance_ASWC_A28.RootCompositionVSM.PRP_SR_EtatMenuECLI_PPC_COL1.EtatMenuECLI_PPC_COL1, system-signal=HS4_VSM_INF_PROFILS_2_FCT_MENU_ECLI_PPC_COLOR1_HS4_220
        data-element=Instance_ASWC_A28.RootCompositionVSM.PRP_SR_EtatMenuECLX_AFS.EtatMenuECLX_AFS, system-signal=HS7_VSM_INF_PROFILS_FCT_ECLX_AFS_HS7_260
        data-element=Instance_ASWC_A28.RootCompositionVSM.PRP_SR_EtatMenuECLX_ARS.EtatMenuECLX_ARS, system-signal=HS7_VSM_INF_PROFILS_FCT_ECLX_ARS_HS7_260
        data-element=Instance_ASWC_A28.RootCompositionVSM.PRP_SR_EtatMenuECLX_ECL_CAFR.EtatMenuECLX_ECL_CAFR, system-signal=HS7_VSM_INF_PROFILS_FCT_MENU_ECLX_ECL_CAFR_HS7_260
        data-element=Instance_ASWC_A28.RootCompositionVSM.PRP_SR_EtatMenuEssuiVitMar.EtatMenuEssuiVitMar, system-signal=HS7_VSM_INF_PROFILS_ESSUI_VIT_MAR_HS7_260
        data-element=Instance_ASWC_A28.RootCompositionVSM.PRP_SR_EtatMenuFARC.EtatMenuFARC, system-signal=HS7_VSM_INF_PROFILS_SELEC_FARC_FA_HS7_260
        data-element=Instance_ASWC_A28.RootCompositionVSM.PRP_SR_EtatMenuFeuxDiurne.EtatMenuFeuxDiurne, system-signal=HS7_VSM_INF_PROFILS_FCT_FEUX_DIURN_O_HS7_260
        data-element=Instance_ASWC_A28.RootCompositionVSM.PRP_SR_EtatMenuFSEAuto.EtatMenuFSEAuto, system-signal=HS7_VSM_INF_PROFILS_SER_FSE_AUTO_HS7_260
        data-element=Instance_ASWC_A28.RootCompositionVSM.PRP_SR_EtatMenuGAV_AMLA.EtatMenuGAV_AMLA, system-signal=HS7_VSM_INF_PROFILS_FCT_MENU_GAV_AMLA_HS7_260
        data-element=Instance_ASWC_A28.RootCompositionVSM.PRP_SR_EtatMenuILV.EtatMenuILV, system-signal=HS7_VSM_INF_PROFILS_FCT_MENU_ILV_ILV_HS7_260
        data-element=Instance_ASWC_A28.RootCompositionVSM.PRP_SR_EtatMenuILV_ETSR.EtatMenuILV_ETSR, system-signal=HS7_VSM_INF_PROFILS_FCT_MENU_ILV_ETSR_HS7_260
        data-element=Instance_ASWC_A28.RootCompositionVSM.PRP_SR_EtatMenuIMA.EtatMenuIMA, system-signal=HS7_VSM_INF_PROFILS_IMA_STATUS_HS7_260
        data-element=Instance_ASWC_A28.RootCompositionVSM.PRP_SR_EtatMenuInfoParamDispo.EtatMenuInfoParamDispo, system-signal=HS7_VSM_INF_PROFILS_DISPO_PARAM_HS7_260
        data-element=Instance_ASWC_A28.RootCompositionVSM.PRP_SR_EtatMenuInfoUniteLangueDispo.EtatMenuInfoUniteLangueDispo, system-signal=HS1_CDE_CMF_56B_DISPO_UNITES_LANGUE_HS1_56B
        data-element=Instance_ASWC_A28.RootCompositionVSM.PRP_SR_EtatMenuInfoUniteLangueDispo.EtatMenuInfoUniteLangueDispo, system-signal=HS4_VSM_INF_PROFILS_DISPO_UNITES_LANGUE_HS4_260
        data-element=Instance_ASWC_A28.RootCompositionVSM.PRP_SR_EtatMenuInfoUniteLangueDispo.EtatMenuInfoUniteLangueDispo, system-signal=HS7_VSM_INF_PROFILS_DISPO_UNITES_LANGUE_HS7_260
        data-element=Instance_ASWC_A28.RootCompositionVSM.PRP_SR_EtatMenuInfoVitLvvDispo.EtatMenuInfoVitLvvDispo, system-signal=HS4_CDE_VIT_LVV_DISPO_INFO_XVV_HS4_267
        data-element=Instance_ASWC_A28.RootCompositionVSM.PRP_SR_EtatMenuInfoVitRvvDispo.EtatMenuInfoVitRvvDispo, system-signal=HS4_CDE_VIT_RVV_DISPO_INFO_XVV_HS4_2A7
        data-element=Instance_ASWC_A28.RootCompositionVSM.PRP_SR_EtatMenuInfoXVVDispo.EtatMenuInfoXVVDispo, system-signal=HS4_ETAT_PRECOND_ET_XVV_DISPO_INFO_XVV_HS4_1E8
        data-element=Instance_ASWC_A28.RootCompositionVSM.PRP_SR_EtatMenuINV_ADSD.EtatMenuINV_ADSD, system-signal=HS4_VSM_INF_PROFILS_2_ETAT_MENU_INVIO_ADSD_HS4_220
        data-element=Instance_ASWC_A28.RootCompositionVSM.PRP_SR_EtatMenuLangueVehicule.EtatMenuLangueVehicule, system-signal=HS7_VSM_INF_PROFILS_LANGUE_VHL_HS7_260
        data-element=Instance_ASWC_A28.RootCompositionVSM.PRP_SR_EtatMenuMotoVolAr.EtatMenuMotoVolAr, system-signal=HS7_VSM_INF_PROFILS_FCT_MOT_VOL_AR_HS7_260
        data-element=Instance_ASWC_A28.RootCompositionVSM.PRP_SR_EtatMenuPresenceARC.EtatMenuPresenceARC, system-signal=HS7_VSM_INF_PROFILS_ARC_SENS_HS7_260
        data-element=Instance_ASWC_A28.RootCompositionVSM.PRP_SR_EtatMenuPRV_MODE.EtatMenuPRV_MODE, system-signal=HS4_VSM_INF_PROFILS_2_FCT_PRIVACY_MODE_HS4_220
        data-element=Instance_ASWC_A28.RootCompositionVSM.PRP_SR_EtatMenuRTAB_EnergyRec.EtatMenuRTAB_EnergyRec, system-signal=HS4_VSM_INF_PRG_RTAB_MENU_RTAB_ENERGY_RECOVER_HS4_160
        data-element=Instance_ASWC_A28.RootCompositionVSM.PRP_SR_EtatMenuRTAB_RechargeHDeb.EtatMenuRTAB_RechargeHDeb, system-signal=HS4_VSM_INF_PRG_RTAB_MENU_RTAB_REC_H_DEBUT_HS4_160
        data-element=Instance_ASWC_A28.RootCompositionVSM.PRP_SR_EtatMenuRTAB_TypeRec.EtatMenuRTAB_TypeRec, system-signal=HS4_VSM_INF_PRG_RTAB_ETAT_MENU_RTAB_TYPE_RECH_HS4_160
        data-element=Instance_ASWC_A28.RootCompositionVSM.PRP_SR_EtatMenuSelecArriere.EtatMenuSelecArriere, system-signal=HS7_VSM_INF_PROFILS_SELEC_ARRIERE_HS7_260
        data-element=Instance_ASWC_A28.RootCompositionVSM.PRP_SR_EtatMenuSelecCabine.EtatMenuSelecCabine, system-signal=HS7_VSM_INF_PROFILS_SELEC_CABINE_HS7_260
        data-element=Instance_ASWC_A28.RootCompositionVSM.PRP_SR_EtatMenuSelecOuvPlip.EtatMenuSelecOuvPlip, system-signal=HS7_VSM_INF_PROFILS_SELEC_OUV_PLIP_HS7_260
        data-element=Instance_ASWC_A28.RootCompositionVSM.PRP_SR_EtatMenuSonPoly.EtatMenuSonPoly, system-signal=HS7_VSM_INF_PROFILS_HARMONIE_SON_HS7_260
        data-element=Instance_ASWC_A28.RootCompositionVSM.PRP_SR_EtatMenuStatusAAS.EtatMenuStatusAAS, system-signal=HS7_VSM_INF_PROFILS_AAS_STATUS_HS7_260
        data-element=Instance_ASWC_A28.RootCompositionVSM.PRP_SR_EtatMenuStatusSAM.EtatMenuStatusSAM, system-signal=HS7_VSM_INF_PROFILS_SAM_STATUS_HS7_260
        data-element=Instance_ASWC_A28.RootCompositionVSM.PRP_SR_EtatMenuTCFG.EtatMenuTCFG, system-signal=HS7_VSM_INF_PROFILS_FCT_TCFG_HS7_260
        data-element=Instance_ASWC_A28.RootCompositionVSM.PRP_SR_EtatMenuUniteConso.EtatMenuUniteConso, system-signal=HS7_VSM_INF_PROFILS_UNITE_CONSO_HS7_260
        data-element=Instance_ASWC_A28.RootCompositionVSM.PRP_SR_EtatMenuUniteDistance.EtatMenuUniteDistance, system-signal=HS1_CDE_CMF_56B_UNITE_DISTANCE_HS1_56B
        data-element=Instance_ASWC_A28.RootCompositionVSM.PRP_SR_EtatMenuUniteDistance.EtatMenuUniteDistance, system-signal=HS4_VSM_INF_PROFILS_UNITE_DISTANCE_HS4_260
        data-element=Instance_ASWC_A28.RootCompositionVSM.PRP_SR_EtatMenuUniteDistance.EtatMenuUniteDistance, system-signal=HS7_VSM_INF_PROFILS_UNITE_DISTANCE_HS7_260
        data-element=Instance_ASWC_A28.RootCompositionVSM.PRP_SR_EtatMenuUniteTemperature.EtatMenuUniteTemperature, system-signal=HS7_VSM_INF_PROFILS_UNITE_TEMPERATURE_HS7_260
        data-element=Instance_ASWC_A28.RootCompositionVSM.PRP_SR_EtatMenuUniteVolume.EtatMenuUniteVolume, system-signal=HS7_VSM_INF_PROFILS_UNITE_VOLUME_HS7_260
        data-element=Instance_ASWC_A28.RootCompositionVSM.PRP_SR_EtatMenuVitesse{1..5}XVV.EtatMenuVitesse{1..5}XVV, system-signal=HS4_ETAT_PRECOND_ET_XVV_VITESSE_{1..5}_HS4_1E8
        data-element=Instance_ASWC_A28.RootCompositionVSM.PRP_SR_EtatMenuVitLvv{1..6}.EtatMenuVitLvv{1..6}, system-signal=HS4_CDE_VIT_LVV_VITESSE_{1..6}_HS4_267
        data-element=Instance_ASWC_A28.RootCompositionVSM.PRP_SR_EtatMenuVitRvv{1..6}.EtatMenuVitRvv{1..6}, system-signal=HS4_CDE_VIT_RVV_VITESSE_{1..6}_HS4_2A7
        data-element=Instance_ASWC_A28.RootCompositionVSM.PRP_SR_EtatMenuVTOR_IRV.EtatMenuVTOR_IRV, system-signal=HS7_VSM_INF_PROFILS_FCT_VTOR_IRV_HS7_260
        data-element=Instance_ASWC_A28.RootCompositionVSM.PRP_SR_SEC_RTAB_RecHDebDeMenuPerso.SEC_RTAB_RecHDebDeMenuPerso, system-signal=HS4_INFOS_ODB_ZEV_DMDM_RTAB_RECHRG_H_DEBUT_HS4_31A
        data-element=Instance_ASWC_A7C.RootCompositionVSM.PRP_SR_BMFPresente.BMFPresente, system-signal=HS4_VSM_INF_CFG_PRES_BOIT_TNB_HS4_361
        data-element=Instance_ASWC_A7C.RootCompositionVSM.PRP_SR_DdeClignoTemCeintAR2D.DdeClignoTemCeintAR2D, system-signal=HS4_CDE_CMB_SIGNALISATION_OUCARD_CLIG_HS4_128
        data-element=Instance_ASWC_A7C.RootCompositionVSM.PRP_SR_DdeClignoTemCeintAR2G.DdeClignoTemCeintAR2G, system-signal=HS4_CDE_CMB_SIGNALISATION_OUCARG_CLIG_HS4_128
        data-element=Instance_ASWC_A7C.RootCompositionVSM.PRP_SR_DdeClignoTemCeintAR2M.DdeClignoTemCeintAR2M, system-signal=HS4_CDE_CMB_SIGNALISATION_OUCARM_CLIG_HS4_128
        data-element=Instance_ASWC_A7C.RootCompositionVSM.PRP_SR_DdeClignoTemCeintAR3D.DdeClignoTemCeintAR3D, system-signal=HS4_CDE_COMBINE_TEMOINS_OUCARD2_CLIG_HS4_168
        data-element=Instance_ASWC_A7C.RootCompositionVSM.PRP_SR_DdeClignoTemCeintAR3G.DdeClignoTemCeintAR3G, system-signal=HS4_CDE_COMBINE_TEMOINS_OUCARG2_CLIG_HS4_168
        data-element=Instance_ASWC_A7C.RootCompositionVSM.PRP_SR_DdeClignoTemCeintCond.DdeClignoTemCeintCond, system-signal=HS4_CDE_CMB_SIGNALISATION_OUCC_CLIG_HS4_128
        data-element=Instance_ASWC_A7C.RootCompositionVSM.PRP_SR_DdeClignoTemCeintPav.DdeClignoTemCeintPav, system-signal=HS4_CDE_CMB_SIGNALISATION_OUCP_CLIG_HS4_128
        data-element=Instance_ASWC_A7C.RootCompositionVSM.PRP_SR_DdeTemoinCeintureAR2D.DdeTemoinCeintureAR2D, system-signal=HS4_CDE_CMB_SIGNALISATION_OUCARD_HS4_128
        data-element=Instance_ASWC_A7C.RootCompositionVSM.PRP_SR_DdeTemoinCeintureAR2G.DdeTemoinCeintureAR2G, system-signal=HS4_CDE_CMB_SIGNALISATION_OUCARG_HS4_128
        data-element=Instance_ASWC_A7C.RootCompositionVSM.PRP_SR_DdeTemoinCeintureAR2M.DdeTemoinCeintureAR2M, system-signal=HS4_CDE_CMB_SIGNALISATION_OUCARM_HS4_128
        data-element=Instance_ASWC_A7C.RootCompositionVSM.PRP_SR_DdeTemoinCeintureAR3D.DdeTemoinCeintureAR3D, system-signal=HS4_CDE_COMBINE_TEMOINS_OUCARD2_HS4_168
        data-element=Instance_ASWC_A7C.RootCompositionVSM.PRP_SR_DdeTemoinCeintureAR3G.DdeTemoinCeintureAR3G, system-signal=HS4_CDE_COMBINE_TEMOINS_OUCARG2_HS4_168
        data-element=Instance_ASWC_A7C.RootCompositionVSM.PRP_SR_DdeTemoinCeintureCond.DdeTemoinCeintureCond, system-signal=HS4_CDE_CMB_SIGNALISATION_OUCC_HS4_128
        data-element=Instance_ASWC_A7C.RootCompositionVSM.PRP_SR_DdeTemoinCeinturePav.DdeTemoinCeinturePav, system-signal=HS4_CDE_CMB_SIGNALISATION_OUCP_HS4_128
        data-element=Instance_ASWC_A7C.RootCompositionVSM.PRP_SR_PresenceConducteurMux.PresenceConducteurMux, system-signal=HS1_BDE_DAT_CLIM_50E_PRES_COND_HS1_50E
        data-element=Instance_ASWC_A7C.RootCompositionVSM.PRP_SR_PresenceConducteurMux.PresenceConducteurMux, system-signal=HS2_DAT_CLIM_50E_PRES_COND_HS2_50E
        data-element=Instance_ASWC_A7D1.RootCompositionVSM.PRP_SR_SAV_DiagJaugeCarbu.SAV_DiagJaugeCarbu, system-signal=HS1_DAT_BSI_412_DIAG_MINI_CARB_HS1_412
        data-element=Instance_ASWC_A7D2.RootCompositionVSM.PRP_SR_CapaciteReservoirJCA.CapaciteReservoirJCA, system-signal=HS4_ETAT_VSM_TEMP_NIVEAU_VOL_RESERVOIR_CARB_HS4_161
        data-element=Instance_ASWC_A7D2.RootCompositionVSM.PRP_SR_MiniCarburant.MiniCarburant, system-signal=HS1_DAT_BSI_412_MINI_CARB_HS1_412
        data-element=Instance_ASWC_A7D2.RootCompositionVSM.PRP_SR_NivCarbAfficheVersCmb.NivCarbAfficheVersCmb, system-signal=HS1_DAT_BSI_54E_NIV_CRB_HS1_54E
        data-element=Instance_ASWC_A7D2.RootCompositionVSM.PRP_SR_NivCarbAfficheVersCmb.NivCarbAfficheVersCmb, system-signal=HS4_ETAT_VSM_TEMP_NIVEAU_NIV_CRB_HS4_161
        data-element=Instance_ASWC_A7D2.RootCompositionVSM.PRP_SR_NivCarbMesureConverti.NivCarbMesureConverti, system-signal=HS1_DAT7_BSI_612_INFO_NIV_CARB_HS1_612
        data-element=Instance_ASWC_A7D3.RootCompositionVSM.PRP_SR_SAV_CompteurEnvoiDeltaCarb.SAV_CompteurEnvoiDeltaCarb, system-signal=HS1_DAT_BSI_432_CPT_VOL_CARB_AJOUTE_HS1_432
        data-element=Instance_ASWC_A7D3.RootCompositionVSM.PRP_SR_SAV_CompteurEnvoiDeltaCarb.SAV_CompteurEnvoiDeltaCarb, system-signal=HS2_DAT_BSI_432_CPT_VOL_CARB_AJOUTE_HS2_432
        data-element=Instance_ASWC_A7D3.RootCompositionVSM.PRP_SR_SAV_VolCarbAjoute.SAV_VolCarbAjoute, system-signal=HS1_DAT_BSI_432_VOL_CARB_AJOUTE_HS1_432
        data-element=Instance_ASWC_A7D3.RootCompositionVSM.PRP_SR_SAV_VolCarbAjoute.SAV_VolCarbAjoute, system-signal=HS2_DAT_BSI_432_VOL_CARB_AJOUTE_HS2_432
        data-element=Instance_ASWC_A7D3.RootCompositionVSM.PRP_SR_VoyRisqueColmatageFAP.VoyRisqueColmatageFAP, system-signal=HS4_CDE_COMBINE_TEMOINS_DMD_ALLUM_FAP_HS4_168
        data-element=Instance_INT.RootCompositionVSM.PRP_IF_resultat.Data_resultat_domaine, system-signal=ARVSW_Resultat_Frame_i_SGL_Resultat_domaine_DIAG_253
        data-element=Instance_INT.RootCompositionVSM.PRP_IF_resultat.Data_resultat_erreurPas, system-signal=ARVSW_Resultat_Frame_i_SGL_Resultat_erreur_DIAG_253
        data-element=Instance_INT.RootCompositionVSM.PRP_IF_resultat.Data_resultat_erreurSWC, system-signal=ARVSW_Resultat_Frame_i_SGL_Resultat_SWC_DIAG_253
        data-element=Instance_INT.RootCompositionVSM.PRP_IF_resultat.Data_resultat_statut, system-signal=ARVSW_Resultat_Frame_i_SGL_Resultat_statut_DIAG_253
        data-element=Instance_INT.RootCompositionVSM.PRP_IF_resultat.Data_resultat_test, system-signal=ARVSW_Resultat_Frame_i_SGL_Resultat_test_DIAG_253
        data-element=Instance_INT.RootCompositionVSM.RP_IF_commande.Data_commande_domaine, system-signal=ARVSW_Commande_Frame_i_SGL_Commande_domaine_DIAG_200
        data-element=Instance_INT.RootCompositionVSM.RP_IF_commande.Data_commande_ordre, system-signal=ARVSW_Commande_Frame_i_SGL_Commande_ordre_DIAG_200
        data-element=Instance_INT.RootCompositionVSM.RP_IF_commande.Data_commande_test, system-signal=ARVSW_Commande_Frame_i_SGL_Commande_test_DIAG_200
        data-element=Instance_SUPV.RootCompositionVSM.PRP_IF_EchoPas.Data_echo_domaine, system-signal=ARVSW_Echo_Frame_i_SGL_Echo_domaine_DIAG_252
        data-element=Instance_SUPV.RootCompositionVSM.PRP_IF_EchoPas.Data_echo_pas, system-signal=ARVSW_Echo_Frame_i_SGL_Echo_pas_DIAG_252
        data-element=Instance_SUPV.RootCompositionVSM.PRP_IF_EchoPas.Data_echo_test, system-signal=ARVSW_Echo_Frame_i_SGL_Echo_test_DIAG_252
        data-element=Instance_ASWC_LPhM.RootCompositionVSM.PRP_SR_OpStatusCanPwt.OpStatusCanPwt, system-signal=HS1_SUPV_BSI_792_ETAT_ELECTR_UCE_HS1_792
      sw-mappings:
        swc to ecu mapping SwToEcuMapping: ecu-instance=VSM
          component:
            RootCompositionVSM.Instance_ASVD1
            RootCompositionVSM.Instance_ASVD2
            RootCompositionVSM.Instance_ASWC_A28
            RootCompositionVSM.Instance_ASWC_A7C
            RootCompositionVSM.Instance_ASWC_A7D{1..3}
            RootCompositionVSM.Instance_ASWC_A7G
            RootCompositionVSM.Instance_BSWC_NvDM_Satellite
            RootCompositionVSM.Instance_PSWC_ParamDefinition
            RootCompositionVSM.Instance_ASWC_ParamServer
            RootCompositionVSM.Instance_ASWC_F3
            RootCompositionVSM.Instance_FAN_ASVD
            RootCompositionVSM.Instance_INT
            RootCompositionVSM.Instance_SUPV
            RootCompositionVSM.Instance_ASWC_LPhM
            RootCompositionVSM.Instance_BSWC_NvDM
            RootCompositionVSM.Instance_BSWC_CSM
            RootCompositionVSM.BswM_OsApp_CORE0_QM_Prototype
            RootCompositionVSM.Instance_WipM
            RootCompositionVSM.Instance_IoHwAb
            RootCompositionVSM.ComM_Prototype
            RootCompositionVSM.DevelopmentErrorTracer_Prototype
            RootCompositionVSM.BswM_OsApp_CORE1_QM_Prototype
    root-software-compositions:
      root sw composition prototype RootCompositionVSM: software-composition=Compo_VSM
package /RootP_Composition
  composition sw component type Compo_VSM
    24 x component:
      Instance_ASVD1: type=ASVD1
      Instance_ASVD2: type=ASVD2
      Instance_ASWC_A28: type=ASWC_A28
      Instance_ASWC_A7C: type=ASWC_A7C
      Instance_ASWC_A7D{1..3}: type=ASWC_A7D{1..3}
      Instance_ASWC_A7G: type=ASWC_A7G
      Instance_BSWC_NvDM_Satellite: type=BSWC_NvDM_Satellite
      Instance_PSWC_ParamDefinition: type=PSWC_ParamDefinition
      Instance_ASWC_ParamServer: type=ASWC_ParamServer
      Instance_ASWC_F3: type=ASWC_F3
      Instance_FAN_ASVD: type=FAN_ASVD
      Instance_INT: type=INT
      Instance_SUPV: type=SUPV
      Instance_ASWC_LPhM: type=ASWC_LPhM
      Instance_BSWC_NvDM: type=BSWC_NvDM
      Instance_BSWC_CSM: type=BSWC_CSM
      BswM_OsApp_CORE0_QM_Prototype: type=BswM_OsApp_CORE0_QM
      ComM_Prototype: type=ComM
      DevelopmentErrorTracer_Prototype: type=DevelopmentErrorTracer
      BswM_OsApp_CORE1_QM_Prototype: type=BswM_OsApp_CORE1_QM
      Instance_WipM: type=WipM
      Instance_IoHwAb: type=IoHwAb
